// TamaDigi - pixel-art tamagotchi inspired by gen 1
// for the Waveshare ESP32-S3-Touch-AMOLED-1.75
//
// Libraries (Library Manager or the Waveshare repo):
//   - "GFX Library for Arduino" (moononournation), with CO5300 QSPI support
//   - "SensorLib" (Lewis He), CST9217 touch driver
//
// Board: ESP32S3 Dev Module | Flash 16MB | PSRAM: OPI PSRAM | USB CDC On Boot: Enabled
//
// The sprites and the species table are generated by tools/sprites.py (emit).

#include <Arduino.h>
#include <Wire.h>
#include "Arduino_GFX_Library.h"
#include "TouchDrvCSTXXX.hpp"
#include "pin_config.h"
#include "species.h"
#include "roster.h"
#include "types.h"
#include "battle.h"
#include "trainers.h"
#include "link.h"
#include "linknow.h"
#include "backs.h"
#include "badges.h"
#include "avatars.h"
#include <stdarg.h>
#include "save.h"
#include "pet.h"
#include "items.h"
#include "inventory.h"
#include "wild.h"
#include "noart.h"
#include "sdmon.h"
#include "rtcbat.h"
#include "nvsinfo.h"
#include "i18n.h"
#include "audio.h"

// Firmware version. Bump this number on every release (and manifest.json for
// the web installer). Shown on the settings screen and over serial at boot.
#define FW_VERSION "2.0.0"

// Set once at boot when a v1.0.0 save was found and replaced, so the first screen
// can say so. RAM only: the save it describes is gone.
bool gOldSaveReplaced = false;

Arduino_DataBus *bus = new Arduino_ESP32QSPI(
  LCD_CS, LCD_SCLK, LCD_SDIO0, LCD_SDIO1, LCD_SDIO2, LCD_SDIO3);
Arduino_CO5300 *panel = new Arduino_CO5300(
  bus, LCD_RESET, 0 /*rotation*/, LCD_WIDTH, LCD_HEIGHT, 6, 0, 0, 0);
// Full framebuffer in PSRAM: we draw everything and then flush() (no flicker)
Arduino_Canvas *gfx = new Arduino_Canvas(LCD_WIDTH, LCD_HEIGHT, panel);

TouchDrvCST92xx touch;
Pet pet;

// animated SD sprite for the current species (if the file exists)
SdMon mon;          // B/W sprite (fallback, and the mini-game when there is no PMD)
PmdMon pmd;         // sprite PMD multi-accion (pantalla principal)
PmdMon evoPmd;      // previous form, only during the digivolution flash
int16_t monFor = -2;
bool monVariantFor = false;

// the creature's on-screen behaviour
struct {
  uint8_t mode = 0;     // 0 idle, 1 paseo, 2 gesto one-shot
  uint8_t act = PMD_IDLE;
  uint32_t t0 = 0;      // start of the current animation
  uint32_t until = 0;   // end of the current state
  float x = 233, targetX = 233;
} beh;
#define PET_GROUND 304  // the pet's ground line
PmdMon galleryPmd;  // large sprite for the gallery detail view (PMD/TPK2, legal)

// digidex gallery
bool galleryOpen = false;
bool galleryDirty = false;
// 16 to a page. Phase 2 of the cutover puts a stage picker in front of this grid;
// until then it lists the forms that have art, in dex order.
#define GAL_PER_PAGE 16
uint8_t galleryPage = 0;    // galleryPages() pages of GAL_PER_PAGE
// ---------------------------------------------------------------------------
// DIGIDEX FILTERS. A view setting, so RAM only -- deliberately NO save field:
// every one of these is derived from data the save already holds, and a filter
// somebody left on is not worth a migration or a line in the backup.
//
// There was a CAUGHT filter here too ("in the party or box right now"). It went
// with the party and box: with one partner it would only ever match one Digimon.
enum : uint8_t { GFILT_ALL = 0, GFILT_RAISED, GFILT_VARIANT, GFILT_COUNT };
uint8_t galleryFilter = GFILT_ALL;
// Published so view_test can walk every filter without keeping its own copy of
// how many there are -- a test that restates a count silently stops covering the
// mode somebody adds next.
uint8_t galleryFilterCount() { return GFILT_COUNT; }
int16_t galleryDetail = 0;  // dex in the detail view, 0 = grid

bool screenOff = false;       // short press of the PWR button
// Cached from nvsLowOnSpace(), refreshed at boot and on the HEALTH heartbeat
// rather than every frame -- nvs_get_stats() is not free, and drawSaveWarning()
// runs on every render. See nvsinfo.cpp: a full partition is erased WHOLE on
// the next boot, so this is the only advance notice a player ever gets.
bool gNvsLow = false;
bool cardOpen = false;        // the creature's card (vertical swipe)
bool kbOpen = false;
enum : uint8_t { KB_PET = 0, KB_TRAINER };
uint8_t kbTarget = KB_PET;          // keyboard for renaming the creature
char nameBuf[12] = "";
uint8_t nameLen = 0;
#define CARD_PROGRESS_PAGE 3
#define CARD_PAGES 4   // profile, stats, moves, progress -- medals moved to
                       // the player card, where the totals already live
uint8_t cardPage = 0;         // 0 perfil, 1 stats+medallas
// Menu overlay: opened by tapping the pet's name on the main screen. The
// horizontal swipe is already taken by the Digidex (it pages through 10 pages
// internally), so a hub on that axis would be ambiguous; the header was inert
// and is the only free surface left.
bool menuOpen = false;
#define MENU_X 73
// Four rows: PARTY (since removed) and GYMS came out, since a swipe now reaches
// the tiles directly. Sized to the bezel -- the panel is 320 wide, so 160 from
// the centre, and sqrt(233^2 - 160^2) = 169 means it can only span y 64..402.
#define MENU_Y 70
#define MENU_W 320
#define MENU_H 326
#define MENU_ROW_H 44
#define MENU_ROW_GAP 6
// 6 rows: STATS / BAG / DIGIDEX / SETTINGS / RETIRE / CLOSE. The row height came
// down from 52 to fit the sixth: the panel spans 70..396, and the round display
// gives a half-width of 166 there against the 160 a row needs, so the corners
// stay on glass. Anything taller does not -- at 6 rows of 52 it would reach 413
// and the bottom corners would fall off the bezel.
#define MENU_ROWS 6
#define MENU_ROW_Y(i) (MENU_Y + 16 + (i) * (MENU_ROW_H + MENU_ROW_GAP))


bool clockOpen = false;       // clock-setting screen (swipe down)
int clockH = 12, clockM = 0;  // time being edited
// Settings is paged: 0 is the clock, 1 is sound/volume/brightness/language and
// the reset. Declared up here with the other screen state because openClock()
// resets both, and uiRimTarget() pages it -- both of which sit above the
// settings screen's own section.
#define CLOCK_PAGES 2
uint8_t clockPage = 0;
// The reset confirm, on the settings screen. Its own flag rather than another
// choiceKind: that dialog is drawn over the MAIN screen, and this one is modal
// over settings.
bool resetConfirm = false;

// bath scene: foam over the creature, cleaned when it pops
uint32_t bathUntil = 0;
bool bathPending = false;
struct { int16_t x, y; uint8_t r, ph; } bubbles[14];
uint32_t feedMenuUntil = 0;   // food picker open until this millis

// "taps" mini-game: keep the ball in the air
bool gameOpen = false;
uint32_t gameOverUntil = 0;
// The ball game used to run until you missed three times or walked away, so a
// session had no length and the reward no shape. The bag is 10 s and the
// reaction test 15 s; this sits between them, and whichever comes first --
// the clock or three misses -- ends it.
#define GAME_MS 20000UL
uint32_t gameUntil = 0;
float ballX, ballY, ballVX, ballVY, gamePetX;
uint8_t gameScore, gameMisses;
float hitX, hitY;             // last hit (impact ring)
uint32_t hitTime = 0;
bool gameNewHi = false;

// The memory game. Declared here with the other minigame flags because loop()
// and uiCurrentScreen() read it thousands of lines before its own section.
bool memoOpen = false;

// training bag (trains strength)
bool sackOpen = false;
uint32_t sackUntil = 0, sackOverUntil = 0;
uint16_t sackHits = 0;
float sackShake = 0;
uint8_t sackGain = 0;
bool sackNewHi = false;

// training submenu (the 5th icon): routes to the tamer for each stat.
// DEF has no minigame -- it rises on its own from good wellbeing -- so its row
// is informational and does not respond to a tap.
bool trainOpen = false;

// move picker, opened from the MOVES card page. Most learnsets are level 0, so
// a "you learned a skill" prompt would almost never fire -- the skill set
// is edited on demand instead.
bool movePickOpen = false;
uint8_t movePickSlot = 0;   // which of the 4 slots is being replaced
uint8_t movePickPage = 0;
#define MOVE_ROW_Y(i) (96 + (i) * 58)
#define MOVE_PICK_PER_PAGE 5
#define MOVE_PICK_MAX (MOVE_SLOTS + 32)   // the slots, plus more than a form ever offers
#define MOVE_PICK_Y(i) (76 + (i) * 58)
// level-up learn prompt: modal, and deliberately without a timeout -- it
// decides what the creature is for the rest of its life.
#define LEARN_ROW_Y(i) (104 + (i) * 56)
#define LEARN_SKIP_Y 334

// ---------- battle ----------
// The move menu is a 2x2 grid rather than four stacked rows: the round panel
// has to fit both creatures, both HP bars and the menu, and four full-width
// rows do not leave room for the sprites.
bool battleOpen = false;

enum : uint8_t {
  SCR_STARTER = 0, SCR_GALLERY, SCR_MOVEPICK,
  SCR_KEYBOARD, SCR_CARD, SCR_PLAYER, SCR_CLOCK, SCR_GYM,
  SCR_EXPLORE, SCR_LAN, SCR_BATTLE, SCR_WIN, SCR_LEARN, SCR_TRAIN, SCR_MENU,
  SCR_BAGSCR, SCR_GAME, SCR_MAIN, SCR_TRANSFER, SCR_COUNT
};
extern const char *const SCREEN_NAME[SCR_COUNT];   // const is internal linkage in C++

// Declared HERE, above every use. tools/emu/build.sh generates a proto.h with
// every prototype at the top, so the emulator compiled these happily while
// arduino-cli -- which relies on the IDE's auto-prototyping and does not always
// produce one -- did not. A green emulator build is not proof the firmware
// builds; only arduino-cli is.
void bootReport();
uint8_t uiCurrentScreen();
// The gesture model, defined next to uiCurrentScreen() but used by handleTouch()
// ~1000 lines above it.
int uiTileIndex();
void uiTileGo(int i);
void onRim(int dir);
uint8_t uiRimPages();
uint8_t uiRimPage();
bool uiOnRim(int16_t x, int16_t y);
float uiRimAngle(int16_t x, int16_t y);
void uiDrawRimBar();
void uiChrome();
uint8_t learnableList(uint16_t *out, uint8_t max);
// Declared here because the confirm dialogs' draw and tap code use it ~5000
// lines above where it is defined. The emulator generates a proto.h and would
// compile it either way; arduino-cli would not, and that has shipped once.
void uiConfirmRects(int *b1Top, int *b1Bot, int *b2Top, int *b2Bot);
// The bag and wild encounters are defined ~3000 lines below render() and the
// touch handler that reach them. arduino-cli does not always auto-prototype,
// and the emulator's generated proto.h would hide that -- see the note above.
void renderBag();
void bagTap(int16_t x, int16_t y);
uint8_t bagPages();
bool startWildBattle(bool hard);
// A boss row starts its fight directly now that there is no team picker in
// between, so onTap() calls this ~2000 lines above its definition.
void startTrainerBattle(uint8_t idx, bool hard);
// The Digidex filter. Reached by uiRimTarget(), ~4000 lines above where it is
// defined, because the number of PAGES depends on it -- and non-static so a test
// can drive the firmware's own answer instead of recomputing it.
bool galleryPass(int16_t dex);
uint16_t galleryCount();
int16_t galleryAt(uint16_t visual);
uint8_t galleryPages();
const char *galleryFilterName();
void galleryClampPage();
// The memory game. render() and onTap() reach these ~2000 lines above where they
// are defined, and arduino-cli does not always auto-prototype.
void startMemoGame();
void renderMemo();
void memoTap(int16_t x, int16_t y);
void leaveMemo();
void memoPadPos(int i, int *cx, int *cy);
int memoPadAt(int16_t x, int16_t y);
uint8_t galleryFilterCount();
// The derived personality's name, and today's checklist. Both are read by the
// card and the player screen, which sit either side of where they are defined.
const char *personalityName();
int uiGoalCount();
bool uiGoalMet(int i);
int uiGoalsMet();
void drawConfirmPanel(const char *q, const char *sub1, const char *sub2,
                      uint16_t subCol, const char *o1, uint16_t c1, uint16_t t1,
                      const char *o2, uint16_t c2, uint16_t t2);
const char *const SCREEN_NAME[SCR_COUNT] = {
  "starter", "gallery", "movepick",
  "keyboard", "card", "player", "clock", "gym",
  "explore", "lan", "battle", "win", "learn", "train", "menu",
  "bag", "minigame", "main", "transfer"
};

// Badge art for a boss, or nullptr past the eight area bosses.
static const BadgeArt *badgeArtFor(uint8_t i) {
  return i < TRAINER_GYMS ? &BADGES_ART[i] : nullptr;
}

// Does this boss have badge art? Split out with a primitive return type so the
// tests can ask: the emulator's genproto.py emits every prototype ABOVE the
// includes, where the BadgeArt struct does not exist yet.
bool badgeArtExists(uint8_t i) { return badgeArtFor(i) != nullptr; }

Combatant btlYou, btlFoe;
bool btlOver = false;
bool btlWon = false;
bool btlNewBadge = false;
uint32_t btlWinUntil = 0;   // the win screen is up
// A tamer fight is 1-on-1: your partner against the boss's one Digimon. (It
// used to be a run of 1v1s with both sides queueing a squad, attrition being the
// difficulty curve; the party and the boss teams were removed by design.)
// The ladder is now sequential: a boss opens once the previous one is beaten,
// tracked per difficulty so hard mode is its own run. This replaces the earlier
// "no gating, attrition is the gate" rule -- with both ladders level-capped,
// nothing stopped you opening with Lance and simply losing, which read as a
// dead end rather than a challenge.
// reaction test (trains SPEED)
bool spdOpen = false;
uint32_t spdUntil = 0, spdOverUntil = 0, spdBorn = 0;
int16_t spdX = 0, spdY = 0;
uint16_t spdHits = 0, spdMisses = 0;
uint8_t spdGain = 0;
bool spdNewHi = false;

bool gymOpen = false;
bool gymHard = false;   // which ladder the list is showing

// LAN battle. `lanOpen` is the pairing screen; once both partners are known the
// normal battle screen takes over with btlLink set.
bool lanOpen = false;
Link lan;
static void drawBtlBack();
static void btlLinkPoll();   // defined with the battle code, called from render()
static void btlResolve(uint16_t yourMove);
uint8_t btlMyAct = 0;        // host: our own action, latched until theirs lands
// Which ladder the boss screen and the current fight belong to. The battle keeps
// its own copy so that leaving the boss list mid-fight cannot retarget the badge.
// The smallest a button may be. Three separate "hard to hit" reports -- the
// battle grid's bottom row, the party screen's BOX, and the LAN button -- were
// all the same mistake: a control sized to fit its label rather than a finger.
//
// 44 is the number everyone quotes, but it is 44 POINTS. This panel is 466 px
// across 1.75 in = 266 ppi, so a pixel is 0.095 mm and 44 px is 4.2 mm, under
// half a fingertip. It survives as the HARD FLOOR because several laid-out
// screens cannot grow without being redesigned, but nothing new may use it.
#define UI_TAP_MIN 44
// 9 mm -- what watchOS and Wear OS both land on -- in this panel's pixels.
// Every control laid out from here on is held to THIS by hit_test.
#define UI_TAP_FINGER 94

// The confirm panel, in ONE place. The digivolve/farewell/retire dialog on the
// main screen and the settings reset both draw it, and hit_test asserts against
// the same numbers through
// uiConfirmRects(). Copies of this geometry in the tap handler are exactly how
// a YES button ends up somewhere the drawing is not.
#define CONFIRM_X 73
#define CONFIRM_Y 156
#define CONFIRM_W 320
#define CONFIRM_H 188
#define CONFIRM_BTN_X 93
#define CONFIRM_BTN_W 280
#define CONFIRM_BTN_H 52
#define CONFIRM_B1_Y 206
#define CONFIRM_B2_Y 268


bool gShowAllAvatars = false;  // emulator screenshot aid, never set on hardware
// Emulator-only console commands. A RUNTIME FLAG, not a #ifdef, and deliberately:
// tests/run.sh compiles these same sources twice -- once with g++ for the
// emulator and once with arduino-cli for the board -- and treats any divergence
// between the two as the bug it is hunting. A -D would give the firmware build
// different code to compile, which is exactly what that check exists to catch.
// So the board COMPILES this and simply never sets the flag; main_sdl.cpp does.
// Same shape as gShowAllAvatars above, for the same reason.
bool gEmuDebug = false;
uint8_t btlTrainGain = 0;    // what the win trained, for the win screen
uint8_t btlTrainWhich = 0;
bool btlLink = false;      // this fight is against another device
bool btlLinkHost = false;
static bool gymUnlocked(uint8_t idx, bool hard) {
  return idx == 0 || pet.hasBadge(idx - 1, hard);
}

// The LAN screen remembers which button the player pressed.
static void lanOffer(bool host);
bool lanWantHost = true;
bool playerOpen = false;
// The badges, then the medals, then TODAY's checklist.
uint8_t playerPage = 0;
#define PLAYER_PAGES 3
uint8_t gymPage = 0;
#define GYM_ROWS 5
#define GYM_ROW_Y(i) (110 + (i) * 50)
#define GYM_ROW_H 44
#define GYM_ROW_INSET 18   // how far a row stops short of the glass, so the
                           // arc scrollbar at RIM_BAR_R has its own lane
void gymRowRect(int i, int *x, int *y, int *w, int *h);
// LAN remains attached to the tamer ladder; Explore is a peer destination on
// the tile axis and no longer hides behind GYMS.
#define GYMBTN_Y 380
#define GYMBTN_W 190
#define GYMBTN_H UI_TAP_MIN
#define GYMBTN_X (CX - GYMBTN_W / 2)
int8_t btlTrainer = -1;      // index into TRAINERS, -1 = a one-off fight
bool btlHard = false;

// ---------------------------------------------------------------------------
// The bag, and wild encounters.
bool exploreOpen = false;
bool exploreHard = false;
#define EXPLORE_DIF_Y 272
#define EXPLORE_DIF_H UI_TAP_MIN
#define EXPLORE_BTN_X 78
#define EXPLORE_BTN_Y 326
#define EXPLORE_BTN_W 310
#define EXPLORE_BTN_H 72
#define EXPLORE_BTN_PAD 11
bool bagOpen = false;
uint8_t bagPage = 0;
#define BAG_PER_PAGE 5
#define BAG_ROW_Y(i) (112 + (i) * 58)

// A wild fight is a different fight, not a tamer fight with a flag: the foe
// can run, and RUN is a roll rather than a certainty. Every one
// of those is asked through btlWild, so there is no second opinion about what
// kind of battle is on screen.
bool btlWild = false;
// What was rolled, for the WILD console command.
int16_t wildDex = 0;
uint8_t wildLvl = 1;
bool wildVariant = false;
// What a win handed over, for the settlement lines on the win screen.
ItemKey wildDrops[4] = { ITEM_NONE, ITEM_NONE, ITEM_NONE, ITEM_NONE };
uint8_t wildDropN = 0;
uint8_t btlBagPage = 0;

// Animation. Deliberately built on the thumbnails the screen already draws
// rather than on PmdMon: three PmdMon blobs are live already, and the battle
// has to stay graceful on a board with no SD at all (S_NO_SPRITES). Index 0 is
// you, 1 is the foe.
uint32_t btlLungeUntil[2] = { 0, 0 };   // acted: leans toward the opponent
uint32_t btlHitUntil[2] = { 0, 0 };     // was hit: jitters and flashes
uint16_t btlHpShown[2] = { 0, 0 };      // bars ease toward the real value
// Two streamed sprites, so the creatures can actually swing and flinch. They
// cost ~135 KB of PSRAM each on average and are freed when the fight ends. The
// player's side is NOT the global `pmd`: its level may be capped, and the
// global one keeps drawing the main screen.
PmdMon btlPmd[2];
int16_t btlPmdDex[2] = { 0, 0 };
// A fainted creature sinks out of frame over BTL_FAINT_MS.
uint32_t btlFaintUntil[2] = { 0, 0 };
#define BTL_FAINT_MS 700
// battle menu: 0 = FIGHT/BAG/RUN, 1 = the moves, 3 = the bag. 2 was the switch
// list; with one Digimon a side there is nothing to switch to.
uint8_t btlMenu = 0;
#define BTL_LUNGE_MS 260
#define BTL_HIT_MS 420
char btlMsg[6][64];        // a 15-letter name and a 30-letter skill both have to fit
uint8_t btlMsgCount = 0;   // queued lines; a tap shows the next
#define BTL_CELL_W 160
#define BTL_CELL_H 54
#define BTL_GRID_X 69
#define BTL_GRID_Y 270
#define BTL_GRID_H (BTL_CELL_H * 2 + 8)
#define BTL_CELL_X(i) (BTL_GRID_X + ((i) % 2) * (BTL_CELL_W + 8))
#define BTL_CELL_Y(i) (BTL_GRID_Y + ((i) / 2) * (BTL_CELL_H + 8))

// A cell's HIT area is bigger than the cell that is drawn. On the board the two
// bottom buttons were much harder to hit than the top two: the drawn cells are
// only 44 px tall, there was an 8 px dead gap between the rows, and everything
// below the bottom row was dead too -- so a finger landing low, or a touch panel
// reading a few pixels high, missed entirely. Nothing else is tappable in this
// area while the grid is open, so the slop costs nothing.
//
// The gap between the two rows and the two columns is split down the middle, and
// the bottom row additionally claims the empty space beneath it.
#define BTL_HIT_PAD 4
// The bottom row keeps extra room downward, but not so much that it reaches the
// BACK bar below it -- the mistake made once already with BOX and CLOSE.
#define BTL_HIT_BOTTOM 6
// BACK, under the grid: the move and bag screens had no way out except
// choosing something.
// The boss list's EASY/HARD pill. It was 24 px tall, which is half a fingertip.
// Sits between the title and the first boss row. At 72 with a 44 px height it
// ran to 116 and overlapped the first row, which begins at 110 -- introduced
// when the pill was enlarged to a real tap target.
#define GYMDIF_Y 60
#define GYMDIF_H UI_TAP_MIN
#define BTL_BACK_W 190
#define BTL_BACK_H UI_TAP_MIN
#define BTL_BACK_X (233 - BTL_BACK_W / 2)
#define BTL_BACK_Y 396
#define BTL_HIT_X0(i) (BTL_CELL_X(i) - BTL_HIT_PAD)
// The far edges stop one pixel short so the four boxes TILE: the gap between
// two cells is split down the middle with no pixel left over and none shared.
#define BTL_HIT_X1(i) (BTL_CELL_X(i) + BTL_CELL_W + BTL_HIT_PAD - 1)
#define BTL_HIT_Y0(i) (BTL_CELL_Y(i) - BTL_HIT_PAD)
#define BTL_HIT_Y1(i) (BTL_CELL_Y(i) + BTL_CELL_H - 1 + \
                       ((i) / 2 ? BTL_HIT_BOTTOM : BTL_HIT_PAD))

// Which cell a point falls in, or -1. Exposed (not static) so a test can sweep
// the panel and prove there are no dead pixels between the cells -- the bug that
// made the bottom row hard to press was a gap, not a wrong rectangle.
int btlCellIndexAt(int16_t x, int16_t y);

// Used by BOTH the move grid and the switch grid. They had a copy each of the
// same rectangle test, which is exactly how two halves of one control drift.
static inline bool btlCellHit(int i, int16_t x, int16_t y) {
  return x >= BTL_HIT_X0(i) && x <= BTL_HIT_X1(i) &&
         y >= BTL_HIT_Y0(i) && y <= BTL_HIT_Y1(i);
}
// The training menu, now FOUR rows: the memory game joined the three stat
// tamers. Retuned rather than stretched -- at the old 56 px pitch a fourth row
// would end at y 442, and the panel is bounded by the glass, not by taste.
//
// The panel is 312 wide, so its corners sit 156 from the centre, and the BOTTOM
// pair is what binds: sqrt(233^2 - 156^2) = 173, so the panel cannot reach past
// y = 233 + 173 = 406. At 326 tall it ends at 404 and its worst corner is at
// radius 231 of 233. The first attempt at this was 332 tall and put those corners
// at 236 -- off the glass, which is the mistake the boss ladder made before
// uiSafeHalfWidthFor() existed, so the numbers above are checked rather than
// judged. Rows are UI_TAP_MIN tall with a 10 px gap.
#define TRAIN_X (CX - 156)
#define TRAIN_Y 78
#define TRAIN_W 312
#define TRAIN_H 326
#define TRAIN_ROW_H UI_TAP_MIN
#define TRAIN_ROW_GAP 10
#define TRAIN_ROW_Y(i) (TRAIN_Y + 46 + (i) * (TRAIN_ROW_H + TRAIN_ROW_GAP))
// FOUR, and referred to by name: the tap handler used to compare `i` against
// literals, which is how removing an icon once silently made BATH the wake button.
#define TRAIN_ROWS 4
#define TRAIN_ROW_ATK 0
#define TRAIN_ROW_SPE 1
#define TRAIN_ROW_DEF 2
#define TRAIN_ROW_MEMO 3

// Settings page 2's rows. See the essay above renderClockOptions().
#define SET_ROWS 5
#define SET_ROW_H UI_TAP_MIN
#define SET_ROW_GAP 10
#define SET_ROW_Y(i) (92 + (i) * (SET_ROW_H + SET_ROW_GAP))
#define SET_ROW_INSET 16
#define SET_SOUND 0
#define SET_VOL   1
#define SET_BRIGHT 2
#define SET_LANG  3
#define SET_RESET 4

// The memory game. See the essay above startMemoGame().
#define MEMO_PADS 4
#define MEMO_MAX 16          // sixteen is far past what anyone will reach
#define MEMO_FLASH_MS 420    // how long each pad lights while showing
#define MEMO_GAP_MS 180      // and the dark gap between them
#define MEMO_R 62            // pad radius
#define MEMO_RING 116        // how far the pads sit from the centre
#define MEMO_INPUT_MS 4000   // per-tap patience: a pause is not a wrong answer

// Today's care checklist rows. See the essay above renderPlayerGoals().
#define GOAL_ROW_H UI_TAP_MIN
#define GOAL_ROW_GAP 8
#define GOAL_ROW_Y(i) (104 + (i) * (GOAL_ROW_H + GOAL_ROW_GAP))

// the 9 species with their own sprite in flash (fallback without SD): dex -> index

#define CX 233  // centre of the round screen
#define CY 233
#define UI_R 233   // the glass is a CIRCLE, and every full-width layout must ask
#define HEADER_NAME_Y 52
#define HEADER_NAME_H 24
#define PET_CY 202  // vertical centre of the sprite

// Half the usable width at row y: the chord of the panel at that height.
//
// A layout that picks ONE width for every row is wrong twice -- it wastes the
// middle, where the full 466 px is available, and it hangs the corners of its
// top and bottom rows off the glass. Both had shipped: the boss ladder drew five
// identical 326 px rows over y 110..374, where the real chord runs 448 down to
// 372. Derive it, never restate it; this is the only place the circle is solved.
int uiSafeHalfWidth(int y) {
  int dy = y - CY;
  if (dy <= -UI_R || dy >= UI_R) return 0;
  return (int)sqrtf((float)(UI_R * UI_R - dy * dy));
}

// The narrower of the two chords a box spanning y0..y1 must fit inside. A
// rounded row is widest at its vertical middle, but its CORNERS are what leave
// the circle, so it has to be sized by its worst edge rather than its centre.
int uiSafeHalfWidthFor(int y0, int y1) {
  int a = uiSafeHalfWidth(y0), b = uiSafeHalfWidth(y1);
  return a < b ? a : b;
}

// An arc segment: Arduino_GFX has no arc primitive, so it is stamped from
// overlapping dots. Angles are degrees clockwise from 12 o'clock.
void uiArc(int cx, int cy, int r, int a0, int a1, int w, uint16_t col) {
  if (a1 < a0) { int t = a0; a0 = a1; a1 = t; }
  int rad = w / 2;
  if (rad < 1) rad = 1;
  int n = (int)(((a1 - a0) * 0.01745f * r) / rad) + 1;   // dots must overlap
  for (int i = 0; i <= n; i++) {
    float ang = ((float)a0 + (float)(a1 - a0) * (float)i / (float)n - 90.0f) * 0.01745329f;
    gfx->fillCircle(cx + (int)(cosf(ang) * r), cy + (int)(sinf(ang) * r), rad, col);
  }
}

// The gesture model. Its tables and handlers live down beside uiCurrentScreen(),
// but handleTouch() and onSwipe() sit ~1000 lines above them.
#define TILE_COUNT 5   // PLAYER . [PET] . EXPLORE . GYM . DEX
#define TILE_PET 1
#define RIM_R0 186     // a drag starting outside this radius pages, not swipes
#define RIM_STEP 20    // degrees of arc per page
#define RIM_BAR_R 222  // where the arc scrollbar is drawn
// 2 to 5 o'clock. Angles are clockwise from 12, so this is the right flank --
// the top is the title's and the bottom is the tile dots'.
#define RIM_BAR_A0 55
#define RIM_BAR_A1 145

// A boss row's rectangle -- as wide as the panel allows AT ITS OWN HEIGHT, so
// the ladder bulges in the middle instead of throwing away 66 px there and
// hanging its top and bottom corners off the glass. The draw path and the tap
// path both ask this; they used to share the literals 70 and 396.
void gymRowRect(int i, int *x, int *y, int *w, int *h) {
  int ry = GYM_ROW_Y(i);
  int half = uiSafeHalfWidthFor(ry, ry + GYM_ROW_H) - GYM_ROW_INSET;
  if (x) *x = CX - half;
  if (y) *y = ry;
  if (w) *w = half * 2;
  if (h) *h = GYM_ROW_H;
}

static const uint16_t INK_K = 0x18C4;  // spriteColor('k')

// icon buttons following the bottom arc of the round screen
// (the outer ones sit higher so they stay inside the circle)
struct Btn {
  int16_t cx, cy;
  const char *const *icon;
};
// Five across the arc: spacing tightened 62 -> 54 so the outer pair stays far
// enough in to keep its old y. Lifting them instead would have run the row into
// the ENE/HYG bars, which end at y=361 -- the buttons are 52 tall, so any centre
// above 387 overlaps them.
// Four, not five. The ball had its own icon here until it became DEFENCE's
// tamer and moved into the training menu -- at which point tapping it just
// opened the same menu the dumbbell does, two icons for one destination.
//
// They sit on the panel's curve: y = 372 - dx^2/1100, the outer pair lifted so
// the row stays on glass. At 80 px and 88 px apart the outermost reaches radius
// 220 of 233 -- the row cannot grow again without losing an icon, because four
// UI_TAP_FINGER targets need 392 px of chord and reach radius 222.
#define BTN_COUNT 4
// Referred to by NAME, never by literal index. Removing the ball icon shifted
// every index by one and drawButtons() still had `i != 2` meaning LIGHT -- which
// silently made the BATH button the one that wakes the pet.
#define BTN_FOOD  0
#define BTN_LIGHT 1
#define BTN_BATH  2
#define BTN_TRAIN 3
Btn buttons[BTN_COUNT] = {
  {  92, 352, SPR_ICON_FOOD },   // eat
  { 186, 370, SPR_ICON_LIGHT },  // luz
  { 280, 370, SPR_ICON_CLEAN },  // bano
  { 374, 352, SPR_ICON_TRAIN },  // train
};
// The GRAPHIC is 72 px and the HIT AREA is 94. They were the same 80 px, which
// looked heavy without actually reaching the finger floor -- the usual answer
// here is a target bigger than the thing it draws, which is what the battle
// grid and the egg pill already do. At a 94 px pitch the four hit discs are
// exactly tangent: no overlap to make a tap ambiguous, no gap to swallow one.
#define BTN_HALF 36
#define BTN_HIT 47

// egg cracks ('k' pixels over the sprite)
static const uint8_t CRACK1[][2] = { {15,8},{16,9},{15,10} };
static const uint8_t CRACK2[][2] = { {11,13},{12,14},{11,15},{20,12},{19,13},{20,14} };
// night-mode stars
static const uint16_t STARS[][2] = { {120,140},{330,120},{370,210},{95,230},{280,90},{160,95} };

bool wasPressed = false;
// starter choice (first game): BOTAMON / AGUMON / BETAMON, 3 rows
// The In-Training I forms that can be drawn, from pet.cpp's starterForms(), which is
// also the egg pool. On public art that is Punimon, Botamon and Poyomon.
#define STARTER_SHOWN 3
int16_t starterOf(uint8_t i) {
  int16_t forms[STARTER_SHOWN];
  const uint8_t n = starterForms(forms, STARTER_SHOWN);
  return i < n && i < STARTER_SHOWN ? forms[i] : 0;
}
uint8_t starterCountShown() {
  int16_t forms[STARTER_SHOWN];
  const uint8_t n = starterForms(forms, STARTER_SHOWN);
  return n < STARTER_SHOWN ? n : STARTER_SHOWN;
}

#define STARTER_ROW_Y 110
#define STARTER_ROW_H 70
#define STARTER_ROW_GAP 8
// digivolution CTA button (centred, mid-screen)
#define EVO_BTN_W 256
#define EVO_BTN_H 64
#define EVO_BTN_X (CX - EVO_BTN_W / 2)
#define EVO_BTN_Y 172
// farewell CTA button (wider: it carries the name + a line)
#define FAR_BTN_W 408
#define FAR_BTN_H 58
#define FAR_BTN_X (CX - FAR_BTN_W / 2)
#define FAR_BTN_Y 176

// The food popup. It had its rectangle written out twice -- once where it is
// drawn and once in the tap handler -- which is the shape that drifts the
// moment either moves, and it had to move: the home row grew up into it.
#define FEED_MENU_X 101
#define FEED_MENU_Y 236
#define FEED_MENU_W 264
#define FEED_MENU_H 64
// the CST9217 signals on the INT pin when there is touch data; we use it to avoid
// reading the I2C bus while the chip is asleep (that read hung for ~1s)
volatile bool gTouchIrq = false;
void IRAM_ATTR touchIsr() { gTouchIrq = true; }
uint32_t lastRender = 0;
// AMOLED protection: dim on inactivity
uint32_t lastInteract = 0;
uint8_t dimStage = 0;        // 0 awake, 1 dimmed (90s), 2 nearly off (5min)

// ---------------------------------------------------------------------------
// BRIGHTNESS: the player's setting, and what the panel is actually showing.
//
// The setting is a CEILING on the automatic ladder, not a replacement for it.
// The dim stages and the sleep dimming are AMOLED protection rather than
// preferences -- a setting that overrode them would let somebody park a static
// screen at full brightness for a week -- so the level raises or lowers the
// attended brightness and the ladder still walks down from wherever that lands.
//
// gBrightLevel is persisted under "brt", exactly as the volume is under "vol",
// and BRIGHT_DEFAULT is chosen so that brightBase() returns the numbers this
// firmware has always used. An existing save has no "brt" key, reads the
// default, and behaves bit-identically -- which is the whole requirement: a
// missing setting must mean today's behaviour, never zero.
#define BRIGHT_LEVELS 10
#define BRIGHT_DEFAULT 7
uint8_t gBrightLevel = BRIGHT_DEFAULT;
// What the panel is set to RIGHT NOW. It used to be a function-local static
// inside updateBrightness(), which meant the one fact "the screen is dark" was
// unreachable from anywhere else -- and made the setting unable to take effect,
// since a level change that happened to compute the same target was cached away.
uint8_t gBrightNow = 255;

// The attended, undimmed brightness for a level. THE one place the setting turns
// into a number.
uint8_t brightBase(uint8_t level, bool usb) {
  if (level < 1) level = 1;
  if (level > BRIGHT_LEVELS) level = BRIGHT_LEVELS;
  const uint8_t v = usb ? 180 : 145;     // what it has always been at the default
  if (level >= BRIGHT_DEFAULT)
    return (uint8_t)(v + (uint16_t)(255 - v) * (level - BRIGHT_DEFAULT) /
                             (BRIGHT_LEVELS - BRIGHT_DEFAULT));
  // Below the default it scales down, with a floor: 0 belongs to the PWR button,
  // and a settings screen able to reach it could leave a player with a black
  // panel and no visible way back.
  const uint16_t lo = (uint16_t)v * level / BRIGHT_DEFAULT;
  return (uint8_t)(lo < 8 ? 8 : lo);
}

void brightLoad() {
  Preferences p;
  if (!p.begin("tamadigi", true)) return;
  uint8_t v = p.getUChar("brt", BRIGHT_DEFAULT);
  p.end();
  if (v < 1 || v > BRIGHT_LEVELS) v = BRIGHT_DEFAULT;   // junk reads as default
  gBrightLevel = v;
}

void brightSetLevel(uint8_t level) {
  if (level < 1) level = 1;
  if (level > BRIGHT_LEVELS) level = BRIGHT_LEVELS;
  gBrightLevel = level;
  gBrightNow = 255;      // force updateBrightness() to re-apply on the next pass
  Preferences p;
  if (!p.begin("tamadigi", false)) return;
  p.putUChar("brt", gBrightLevel);
  p.end();
}
bool swallowGesture = false; // the touch that wakes the screen does nothing else
uint32_t holdStart = 0;     // long press on the creature
uint32_t confirmUntil = 0;  // "release?" dialog active until this millis
uint8_t choiceKind = 0;     // decision dialog: 0 none, 1 digivolution, 2 farewell,
                            // 3 retirement, 4 de-digivolution
// Which earlier form the card's button offers. Declining moves it on, the way
// "keep form" moves the digivolution offer to the next branch.
uint8_t devolvePick = 0;
#define DEVO_OPTIONS_MAX 16
int16_t devolveTarget() {
  int16_t open[DEVO_OPTIONS_MAX];
  const uint8_t n = pet.devolveOptions(open, DEVO_OPTIONS_MAX);
  return n ? open[devolvePick % n] : 0;
}
#define DEVO_BTN_W 240
#define DEVO_BTN_H UI_TAP_MIN
#define DEVO_BTN_X (CX - DEVO_BTN_W / 2)
#define DEVO_BTN_Y 386   // under the page dots, where the back hint would be
uint32_t choiceUntil = 0;   // closes by itself at this millis
int16_t tX0, tY0, tXl, tYl; // gesture in progress (start and last position)
uint32_t tStart = 0;
bool holdFired = false;
// Rim-drag state. Decided at touch-down: a gesture that starts outside RIM_R0
// is a scroll for its whole life, and never also resolves as a swipe or a tap.
bool rimActive = false;
bool rimMoved = false;
float rimA0 = 0;
int rimSteps = 0;

// A factory reset has emptied NVS and we are waiting to restart into a new game.
// Nothing may write the in-RAM creature back over it in the meantime.
bool saveInhibited = false;

// Flush a pending save because power is about to go away: the PWR key on its way
// to the AXP2101's hardware cut, the battery's low warning, or a software
// restart. THE single answer for all three, so the one case where it must NOT
// happen cannot be forgotten by whoever adds the fourth -- see CLAUDE.md § "A
// rule enforced in one path but not in its twin", which is a list of what
// happens when three callers each keep their own copy of a guard.
//
// Deliberately ignores the dim/off gate that the periodic autosave in loop()
// obeys. That gate exists so a ~1 s flash write is never visible mid-animation;
// a visible stutter is a far smaller price than the last few minutes of a
// creature's life.
void flushBeforePowerLoss(const char *why) {
  if (saveInhibited) return;
  if (!pet.savePending()) return;
  Serial.printf("save: flushing (%s)\n", why);
  pet.flushSave();
}

void setup() {
  Serial.setRxBufferSize(8192);  // the SD transfer arrives in 2 KB blocks
  Serial.begin(115200);
  // CRITICAL: without this, Serial.print BLOCKS the game when no
  // serial monitor is open on the host (the USB CDC TX buffer fills up
  // and nobody drains it) -> with timeout 0 the messages are dropped
  Serial.setTxTimeoutMs(0);
  Serial.printf("TamaDigi fw v%s\n", FW_VERSION);
  bootReport();   // why the last run ended, and what it was doing
  // BEFORE anything opens the game namespace or loads a creature into RAM. A
  // wipe asked for on the previous run finishes here, where there is no window
  // for the old creature to be written back over it. See save.h § RESET_NS.
  resetRecover();
  // Before the bag and the pet read the namespace: see save.h.
  gOldSaveReplaced = saveReplaceOld();
  loadLang();  // saved language (ES by default)
  brightLoad();  // saved brightness (default: the usual one)
  Wire.begin(IIC_SDA, IIC_SCL);
  // CST9217 (touch), AXP2101 (PMU) and PCF85063 (RTC) share this I2C bus.
  // Safety net for PMU/RTC (SensorLib does NOT honour this timeout on the
  // touch chip; the sleeping-touch hang is solved by gating on INT, see
  // handleTouch).
  Wire.setTimeOut(50);

  // CRITICAL: power the panel rail (BLDO1 = OLED VDD 3.3V) BEFORE
  // initialising the display. If the PMU was reset (full drain), this rail
  // stays OFF and the screen looks black even though the rest of the board works.
  pmuEnablePanel();

  // QSPI at 80MHz (40 by default): flushing the framebuffer is the fps
  // bottleneck (~56ms at 40MHz). If the panel ever shows garbage, drop to 40M.
  if (!gfx->begin(80000000)) Serial.println("gfx->begin() failed");
  // The player's own level, not a literal 180: booting to full brightness and
  // then dropping to a dim setting a frame later is a flash in the eye every
  // time the device starts. usbPresent() is not readable yet -- the PMU is set
  // up further down -- so this takes the battery figure and the first
  // updateBrightness() corrects it if the cable is in.
  gBrightNow = brightBase(gBrightLevel, false);
  panel->setBrightness(gBrightNow);

  touch.setPins(TP_RESET, TP_INT);
  bool touchOk = false;
  for (int i = 0; i < 3 && !touchOk; i++) {  // sometimes fails on the first attempt
    touchOk = touch.begin(Wire, 0x5A, IIC_SDA, IIC_SCL);
    if (!touchOk) delay(150);
  }
  if (!touchOk) Serial.println("CST9217 no detectado");
  // begin() leaves the chip in command mode (it reads the ID and stays there);
  // a hardware reset is needed before it reports touches again
  touch.reset();
  touch.setMaxCoordinates(LCD_WIDTH, LCD_HEIGHT);
  touch.setMirrorXY(true, true);  // the panel is mounted rotated 180 degrees
  // active-low INT: fires when there is data. Gates the I2C reads (see loop)
  pinMode(TP_INT, INPUT_PULLUP);
  attachInterrupt(digitalPinToInterrupt(TP_INT), touchIsr, FALLING);

  bag.begin();
  pet.begin();
  sdBegin();
  thumbs.load();

  // real clock: apply the time spent powered off
  rtcBegin();
  batBegin();
  pwrSetup();
  uint32_t e = rtcEpoch();
  if (e == 0) {
    // CLOCK_EPOCH_FLOOR, not a literal: the same number is what clockVerdict()
    // treats as the earliest real time, and two copies of it would let the seed
    // drift below the floor that judges it.
    rtcSetEpoch(CLOCK_EPOCH_FLOOR);  // blank RTC: seed it (the absolute time does not
    e = rtcEpoch();                  // matter, only the differences)
    Serial.println("RTC had no time: seeded, no offline progression this time");
  }
  pet.syncClock(e);

  audioBegin();  // ES8311 + I2S + amplifier (plays a start-up jingle)

  // After everything has loaded, so the figure reflects a real save rather than
  // an empty one. A full partition is erased WHOLE by the core on the next boot,
  // so this number trending down over a soak test is the only warning there is.
  nvsReport("boot");
  gNvsLow = nvsLowOnSpace();

  // Covers the SOFTWARE restarts -- ESP.restart() after an IMPORT, and the one
  // the serial console does. It does NOT cover the AXP2101's 4-second hardware
  // power-off, which tells the firmware nothing at all; that is what the
  // long-press flush in loop() is for.
  esp_register_shutdown_handler([]() { flushBeforePowerLoss("shutdown"); });

  lastInteract = millis();
}

// A sprite pack is streaming in over USB. The game stands aside -- no game frames,
// no taps, no per-file sprite reload or version rescan -- so the board spends its
// time on the card. Never over a fight or a minigame: their render paths pump the
// link and apply training, so those keep the old, slower behaviour.
bool transferMode() {
  return sdTransferAt && millis() - sdTransferAt < SD_TRANSFER_IDLE_MS &&
         !battleOpen && !lan.live() && !gameOpen && !sackOpen && !spdOpen && !memoOpen;
}

// load/unload the SD sprite when the species changes
void ensureMon() {
  bool sdReload = sdDirty && !transferMode();
  if (pet.speciesId == monFor && monVariantFor == pet.variant && !sdReload) return;
  sdDirty = false;
  // A NEW CREATURE IS ON THE PANEL: let it speak. This one hook covers hatching,
  // digivolving and swapping the focused creature, because all three arrive here --
  // which is better than three call sites that could drift apart.
  //
  // monFor starts at -2, the "nothing loaded yet" sentinel, and that case is
  // deliberately silent: a cry on every boot is a device that shouts when you turn
  // it on. -1 is an egg, which has no voice either.
  if (monFor != -2 && pet.speciesId >= 1 && pet.speciesId != monFor)
    audioCry(pet.speciesId);
  monFor = pet.speciesId;
  monVariantFor = pet.variant;
  mon.unload();
  pmd.unload();
  beh.x = beh.targetX = 233;
  beh.mode = 0;
  beh.until = 0;
  if (pet.speciesId >= 1 && pet.speciesId <= DEX_COUNT) {
    pmd.load(pet.speciesId, pet.variant);          // principal: PMD
    if (!pmd.loaded) mon.load(pet.speciesId, pet.variant);  // fallback: B/W
  }
}

void loop() {
  uint32_t now = millis();
  pet.update(now);

  // The link is pumped here rather than from the LAN screen, because it has to
  // keep running through the battle too: linkNowPoll() drains what the radio
  // parked on the WiFi task, and tick() is what resends a lost packet and gives
  // up on a peer that has gone quiet.
  if (lan.live()) {
    linkNowPoll();
    lan.tick(now);
  }

  // chime when the creature becomes ready to digivolve
  // (including on waking up). canEvolveNow is false while asleep.
  static bool wasEvoReady = false;
  bool evoReady = pet.wantEvolveButton();
  if (evoReady && !wasEvoReady) sfxPlay(SFX_MEDAL);
  wasEvoReady = evoReady;
  // grim warning when the creature is about to run away from neglect
  static bool wasRunReady = false;
  bool runReady = pet.canRunawayNow();
  if (runReady && !wasRunReady) sfxPlay(SFX_DENY);
  wasRunReady = runReady;

  handleTouch();
  handleSerial();
  ensureMon();

  // A sprite pack can arrive long after the card was mounted: the web installer
  // streams it over PUT into the FIRMWARE THAT IS ALREADY RUNNING. gArtPack was
  // computed once in sdBegin(), so without this the pack a player just spent ten
  // minutes downloading stayed unused until they rebooted -- indistinguishable,
  // from the player's side, from the download having failed.
  // Quietly, because the host is still parsing this serial stream -- and once per
  // transfer rather than after every file, which cost 27 lookups in /mons each time.
  if (sdArtDirty && !transferMode()) {
    sdArtDirty = false;
    sdScanArtPack(false);
  }
  // The same, for the gallery: thumbs.bin is read in setup(), so a copy that arrived
  // over PUT drew nothing new until a restart.
  if (sdThumbsDirty && !transferMode()) {
    sdThumbsDirty = false;
    thumbs.load();
  }

  // The PMU latches its interrupts: they are ALL read at once (pwrPoll) and the
  // accessors below consume what it saw. See rtcbat.cpp: two independent
  // polls would clear each other's bits.
  static uint32_t lastPwr = 0;
  if (now - lastPwr > 250) {
    lastPwr = now;
    pwrPoll();
    if (pwrShortPressed()) {
      screenOff = !screenOff;
      pet.setScreenOff(screenOff);   // asleep only if it is also night
      if (!screenOff) lastInteract = now;
    }
    // The hold is on its way to the AXP2101's own power-off, and the firmware
    // gets no second warning. Flush NOW, ignoring the dim/off gate below: that
    // gate exists so a ~1 s flash write is never visible mid-animation, and a
    // visible stutter is a much smaller price than the last few minutes of a
    // creature's life. Same for the battery's low warning.
    if (pwrLongPressed()) flushBeforePowerLoss("pwr long press");
    if (batLowWarning()) flushBeforePowerLoss("battery low");
  }

  updateBrightness(now);

  // flush the periodic autosave ONLY with the screen dimmed/off or while
  // asleep: an NVS write freezes both cores for ~1s (flash cache off),
  // and here there is no animation to stutter and no finger waiting. After 90s
  // of inactivity the screen already dims, so it flushes right away; active
  // use persists anyway through each action's own save (eat/play/...).
  if (pet.savePending() && (screenOff || dimStage >= 1 || pet.sleeping)) {
    pet.flushSave();
  }

  // note the real time every 30 s (persisted with every game save)
  static uint32_t lastClock = 0;
  if (now - lastClock > 30000) {
    lastClock = now;
    uint32_t e = rtcEpoch();
    if (e) pet.lastSeenEpoch = e;
  }

  // health heartbeat every 5 min (for the soak test; dropped if no monitor)
  static uint32_t lastHealth = 0;
  if (now - lastHealth > 300000) {
    lastHealth = now;
    Serial.printf("HEALTH up=%lus heap=%u min=%u save=%s\n",
                  (unsigned long)(now / 1000), ESP.getFreeHeap(),
                  ESP.getMinFreeHeap(), pet.saveHealthy() ? "ok" : "BROKEN");
    // NVS headroom rides the same heartbeat as the heap, and for the same
    // reason: the value on its own says little, the trend over a soak says
    // everything. See nvsinfo.cpp for what running out costs.
    nvsReport("health");
    gNvsLow = nvsLowOnSpace();
  }

  // 85 ms in the game/bag: a safe margin so the redraw does not trample the DMA
  // send of the previous frame (at 40-65 ms they overlapped and flashed black; with
  // large sprites drawing takes longer, so leave headroom)
  //
  // WITH THE PANEL DARK THE CADENCE STRETCHES; IT DOES NOT STOP. Skipping
  // render() outright is the obvious optimisation and it is wrong, because this
  // sketch advances real state inside its render paths: renderBattle() pumps the
  // LAN turn (btlLinkPoll), renderGame/renderSack/renderSpeed are what APPLY a
  // finished session's training and close it, renderGallery consumes
  // galleryDirty, and three modal timers -- the food menu, the release confirm,
  // and the choice dialog -- only expire in render(). Returning
  // early would freeze a linked fight, silently discard a training session, and
  // strand a dialog open until something else redrew.
  //
  // So the frame still happens, just far less often, and anything with motion or
  // a peer waiting on it keeps its full rate.
  uint32_t period = (gameOpen || sackOpen || spdOpen || memoOpen) ? 85 : 100;
  if (gBrightNow == 0 && !battleOpen && !gameOpen && !sackOpen && !spdOpen && !memoOpen)
    period = 500;
  // The one pause, and transferMode() already excludes the fights and minigames above.
  if (transferMode()) period = 1000;
  if (now - lastRender >= period) {
    lastRender = now;
    render();
  }
}

// brightness by sleep + inactivity (AMOLED protection)
void updateBrightness(uint32_t now) {
  // visible events wake the screen by themselves
  if (pet.evolving() || pet.ceremony || pet.eating() || pet.showHeart()) {
    lastInteract = now;
  }
  uint32_t idle = now - lastInteract;
  dimStage = (idle > 300000) ? 2 : (idle > 90000) ? 1 : 0;
  const uint8_t base = brightBase(gBrightLevel, usbPresent());
  uint8_t target = pet.sleeping ? 25 : base;
  if (dimStage == 1) target = pet.sleeping ? 10 : 60;
  else if (dimStage == 2) target = 8;
  // The setting is a CEILING. Without this a low level would still be overridden
  // upwards by the dim ladder's own numbers -- at level 1 the base is ~20 and
  // dimStage 1's flat 60 would make an idle screen BRIGHTER than an attended one.
  if (target > base) target = base;
  if (screenOff) target = 0;
  if (target != gBrightNow) {
    gBrightNow = target;
    panel->setBrightness(target);
  }
}

// ---------- serial console (SD provisioning + debugging) ----------

void handleSerial() {
  if (!Serial.available()) return;
  String line = Serial.readStringUntil('\n');
  line.trim();
  if (line.length() == 0) return;
  if (sdSerialCommand(line)) return;

  if (line == "HATCH") {
    pet.eggTap(); pet.eggTap(); pet.eggTap();
    Serial.println("DONE");
  } else if (line.startsWith("SPEC ")) {
    int n = line.substring(5).toInt();
    if (n >= 1 && n <= DEX_COUNT) {
      pet.prevSpeciesId = pet.speciesId;
      pet.speciesId = n;
      pet.formAgeMin = pet.ageMinutes;
      pet.relearnFromLevel();
      Serial.printf("species #%d %s\n", n, TS_DEX_TBL[n].name);
    }
    Serial.println("DONE");
  } else if (line.startsWith("LVL ")) {
    // level() is 1 + age/rate, so the age for level N is (N-1) rates -- this
    // used to set N and hand back N+1, which is a poor thing for a command
    // named LVL to do when it is what every balance check is anchored on.
    long want = line.substring(4).toInt();
    if (want < 1) want = 1;
    if (want > MAX_LEVEL) want = MAX_LEVEL;
    pet.ageMinutes = (uint32_t)(want - 1) * MINUTES_PER_LEVEL;
    pet.saveNow();
    Serial.printf("lvl=%u\n", pet.level());
  } else if (line == "MAX" && gEmuDebug) {
    // MAX: the fully-raised creature, in one command. LVL 100 + IV 31 x4 + TR at
    // the ceiling + no care mistakes, which is otherwise four commands in the
    // right order -- TR has to come after IV, because trMaxFor() is what caps it.
    //
    // EMULATOR ONLY, gated on gEmuDebug. Not because it is dangerous but because
    // it is not earned: this is a game about raising something slowly, and a
    // one-word cheat on a board would be a way to skip the whole point of it by
    // accident. The board still compiles this; see the flag's note.
    //
    // Deliberately BEFORE any startsWith("MA...") branch would go, and an exact
    // match, so it cannot shadow a future command.
    pet.ivAtk = pet.ivDef = pet.ivSpe = pet.ivHp = 31;
    pet.trAtk = pet.trMaxAtk();
    pet.trDef = pet.trMaxDef();
    pet.trSpe = pet.trMaxSpe();
    pet.ageMinutes = (uint32_t)(MAX_LEVEL - 1) * MINUTES_PER_LEVEL;
    pet.careMistakes = 0;
    pet.relearnFromLevel();          // a level 100 creature knows level 100 moves
    pet.saveNow();
    Serial.printf("lvl=%u iv=31/31/31/31 tr=%u/%u/%u\n", pet.level(),
                  pet.trAtk, pet.trDef, pet.trSpe);
    Serial.println("DONE");
  } else if (line.startsWith("MISS ")) {
    // MISS <n>: sets the care mistakes -- "descuidos", the desc= on STATS.
    // Each one pushes every digivolution threshold up a level, so a creature that
    // was neglected early digivolves late; MISS 0 forgives that. Its sibling
    // commands are IV, TR and LVL.
    long m = line.substring(5).toInt();
    if (m < 0) m = 0;
    if (m > 255) m = 255;
    pet.careMistakes = (uint8_t)m;
    pet.saveNow();
    Serial.printf("desc=%u\n", pet.careMistakes);
  } else if (line.startsWith("TR ")) {
    // TR <atk> <def> <spe>: sets the TRAINING (this game's EVs), for testing a
    // fully-raised creature without playing the minigames for an hour. Each is
    // clamped to trMaxFor(iv), the same IV-bound ceiling the games enforce, so
    // this cannot produce a creature the player could not have raised.
    int v[3] = { 0, 0, 0 };
    int n = sscanf(line.c_str() + 3, "%d %d %d", &v[0], &v[1], &v[2]);
    if (n >= 1) {
      int a = v[0], d = (n >= 2) ? v[1] : v[0], e = (n >= 3) ? v[2] : v[0];
      pet.trAtk = (uint8_t)(a < 0 ? 0 : (a > pet.trMaxAtk() ? pet.trMaxAtk() : a));
      pet.trDef = (uint8_t)(d < 0 ? 0 : (d > pet.trMaxDef() ? pet.trMaxDef() : d));
      pet.trSpe = (uint8_t)(e < 0 ? 0 : (e > pet.trMaxSpe() ? pet.trMaxSpe() : e));
      pet.saveNow();
    }
    Serial.printf("tr=%u/%u/%u topes=%u/%u/%u\n", pet.trAtk, pet.trDef, pet.trSpe,
                  pet.trMaxAtk(), pet.trMaxDef(), pet.trMaxSpe());
  } else if (line.startsWith("IV ")) {
    // IV <str> <def> <spd> <vit>: sets the individual values (tests).
    // "IV 31 31 31 31" shows the ceiling; "IV 8 8 8 8" the floor.
    int v[4] = { 16, 16, 16, 16 };
    int n = sscanf(line.c_str() + 3, "%d %d %d %d", &v[0], &v[1], &v[2], &v[3]);
    if (n >= 1) {
      for (int i = 0; i < 4; i++) v[i] = v[i] < 0 ? 0 : (v[i] > 31 ? 31 : v[i]);
      pet.ivAtk = v[0];
      pet.ivDef = (n >= 2) ? v[1] : v[0];
      pet.ivSpe = (n >= 3) ? v[2] : v[0];
      pet.ivHp = (n >= 4) ? v[3] : v[0];
      if (pet.trAtk > pet.trMaxAtk()) pet.trAtk = pet.trMaxAtk();
      if (pet.trDef > pet.trMaxDef()) pet.trDef = pet.trMaxDef();
      if (pet.trSpe > pet.trMaxSpe()) pet.trSpe = pet.trMaxSpe();
    }
    pet.saveNow();   // IV used to change RAM only and never write
    Serial.printf("iv=%u/%u/%u/%u topes=%u/%u/%u\n", pet.ivAtk, pet.ivDef,
                  pet.ivSpe, pet.ivHp, pet.trMaxAtk(), pet.trMaxDef(), pet.trMaxSpe());
    Serial.println("DONE");
  } else if (line.startsWith("TIME ")) {
    uint32_t e = (uint32_t)line.substring(5).toInt();
    rtcSetEpoch(e);
    pet.setClock(e);
    Serial.printf("rtc=%u\n", rtcEpoch());
    Serial.println("DONE");
  } else if (line.startsWith("RTCSET ")) {  // RTC only (simulate power-offs in tests)
    rtcSetEpoch((uint32_t)line.substring(7).toInt());
    Serial.printf("rtc=%u\n", rtcEpoch());
    Serial.println("DONE");
  } else if (line == "TIME") {
    Serial.printf("rtc=%u\n", rtcEpoch());
    Serial.println("DONE");
  } else if (line == "GAL") {
    galleryOpen = !galleryOpen;
    galleryDetail = 0;
    galleryDirty = true;
    if (!galleryOpen) galleryPmd.unload();
    Serial.println("DONE");
  } else if (line == "EGGS") {
    // simulate 20 egg rolls (does not change the game state)
    for (int i = 0; i < 20; i++) {
      int16_t d = pet.pickEggSpecies();
      Serial.printf("%d:%s ", d, TS_DEX_TBL[d].name);
    }
    Serial.println();
    Serial.println("DONE");
  } else if (line == "BAG") {
    for (uint8_t i = 0; i < bag.distinctCount(); i++) {
      ItemKey k = bag.keyAt(i);
      Serial.printf("%u:%s x%u\n", k, itemEntry(k).name, bag.count(k));
    }
    Serial.println("DONE");
  } else if (line.startsWith("GIVE ")) {
    // GIVE <key> [n]: stock the bag, so items can be exercised without grinding
    // wild wins first.
    int key = 0, n = 1;
    if (sscanf(line.c_str() + 5, "%d %d", &key, &n) >= 1 &&
        itemValid((ItemKey)key)) {
      uint8_t got = bag.add((ItemKey)key, (uint8_t)(n > 0 ? n : 1));
      Serial.printf("%s x%u (+%u)\n", ITEM_TBL[key].name,
                    bag.count((ItemKey)key), got);
    } else {
      Serial.println("bad item");
    }
    Serial.println("DONE");
  } else if (line == "WILD" || line == "WILD HARD") {
    bool hard = (line == "WILD HARD");
    if (startWildBattle(hard))
      Serial.printf("wild %s Lv.%u%s\n", TS_DEX_TBL[wildDex].name,
                    wildLvl, wildVariant ? " *VARIANT*" : "");
    else
      Serial.println("no encounter (egg, ceremony, or no sprite pack)");
    Serial.println("DONE");
  } else if (line.startsWith("EGG ")) {
    // EGG <dex> [variant]: hatch a chosen Digimon right now. The variant IV
    // guarantee only applies at hatch time, so this is the only way to
    // exercise them on hardware (VARIANT below just toggles the flag afterwards).
    int dex = 0, sh = 0;
    int n = sscanf(line.c_str() + 4, "%d %d", &dex, &sh);
    if (n >= 1 && dex >= 1 && dex <= DEX_COUNT) {
      pet.dbgHatchAs(dex, sh != 0);
      Serial.printf("%s%s iv=%u/%u/%u/%u\n", TS_DEX_TBL[dex].name,
                    pet.variant ? " *VARIANT*" : "", pet.ivAtk, pet.ivDef,
                    pet.ivSpe, pet.ivHp);
    }
    Serial.println("DONE");
  } else if (line.startsWith("BATTLE")) {
    // BATTLE <dex> [level] -- the only way in until the tamer roster exists
    int dex = 0, lvl = 0;
    int n = sscanf(line.c_str() + 6, "%d %d", &dex, &lvl);
    if (n >= 1 && dex >= 1 && dex <= DEX_COUNT) {
      startBattle(dex, lvl > 0 ? (uint8_t)lvl : pet.level());
      Serial.printf("battle vs %s Lv.%u\n", TS_DEX_TBL[dex].name, btlFoe.level);
    } else {
      Serial.println("usage: BATTLE <dex> [level]");
    }
    Serial.println("DONE");
  } else if (line == "VARIANT") {  // toggles the current one's variant (tests)
    pet.variant = !pet.variant;
    Serial.printf("variant=%d\n", pet.variant);
    Serial.println("DONE");
  } else if (line.startsWith("NICK ")) {
    pet.rename(line.substring(5).c_str());
    Serial.printf("nick=%s\n", pet.nick);
    Serial.println("DONE");
  } else if (line == "CAREDAY") {  // simulate a new cared-for day (tests)
    pet.setClock(pet.lastSeenEpoch + 86400);
    pet.caress();
    Serial.printf("streak=%u bond=%u medals=0x%X\n", pet.streak, pet.bond, pet.medals);
    Serial.println("DONE");
  } else if (line == "BYE") {
    pet.startFarewell();
    Serial.println("DONE");
  } else if (line == "RUN") {
    pet.startRunaway();
    Serial.println("DONE");
  } else if (line == "BEEP") {
    sfxPlay(SFX_HATCH);  // audio test
    Serial.println("DONE");
  } else if (line == "ABANDON") {
    pet.dbgRunawayReady();  // force the "ready to run away" state (button test)
    Serial.println("DONE");
  } else if (line == "EXPORT") {
    // Prints the whole save as a block of IMPORT commands. Pasting that block
    // back is the restore -- there is no separate format to get wrong, and no
    // single 2000-character line for a terminal to mangle.
    //
    // saveExport() reads the checkpoints only (see save.cpp) -- those are what
    // save() and persist() write on every change, so nothing needs forcing
    // fresh here first.
    static uint8_t buf[SAVE_TRANSFER_MAX];
    size_t n = saveExport(buf, sizeof(buf));
    if (!n) { Serial.println("EXPORT FAIL"); return; }
    Serial.printf("# TamaDigi save, %u bytes. Paste this whole block back.\n",
                  (unsigned)n);
    for (size_t i = 0; i < n; i += 48) {
      Serial.print("IMPORT ");
      for (size_t j = i; j < i + 48 && j < n; j++) Serial.printf("%02X", buf[j]);
      Serial.println();
    }
    Serial.println("IMPORT");        // the empty one commits
  } else if (line.startsWith("IMPORT")) {
    // IMPORT <hex>   append a chunk
    // IMPORT         commit what has been appended
    static uint8_t in[SAVE_TRANSFER_MAX];
    static size_t inN = 0;
    String hex = line.substring(6);
    hex.trim();
    if (hex.length()) {
      if (hex.length() & 1) { Serial.println("IMPORT ODD"); inN = 0; return; }
      for (size_t i = 0; i + 1 < (size_t)hex.length(); i += 2) {
        if (inN >= sizeof(in)) { Serial.println("IMPORT FULL"); inN = 0; return; }
        auto nyb = [](char c) -> int {
          if (c >= '0' && c <= '9') return c - '0';
          if (c >= 'A' && c <= 'F') return c - 'A' + 10;
          if (c >= 'a' && c <= 'f') return c - 'a' + 10;
          return -1;
        };
        const char *hs = hex.c_str();
        int hi = nyb(hs[i]), lo = nyb(hs[i + 1]);
        if (hi < 0 || lo < 0) { Serial.println("IMPORT BAD"); inN = 0; return; }
        in[inN++] = (uint8_t)((hi << 4) | lo);
      }
      Serial.println("IMPORT MORE");
      return;                        // wait for the next chunk or commit
    }
    if (!inN) { Serial.println("IMPORT EMPTY"); return; }
    bool ok = saveImport(in, inN);
    Serial.println(ok ? "IMPORT OK" : "IMPORT REJECTED");
    inN = 0;
    if (ok) { Serial.println("DONE"); delay(100); ESP.restart(); }
  } else if (line == "WIPE") {
    pet.factoryReset();     // wipe NVS and restart -> new game (starter choice)
    // Set BEFORE the restart, because the restart runs the shutdown handler, and
    // that handler's whole job is to flush a pending save. Without this it would
    // write the creature that was just deleted straight back into the empty NVS.
    saveInhibited = true;
    Serial.println("DONE");
    delay(100);
    ESP.restart();
  } else if (line == "REG") {
    Serial.printf("digidex %u/%u:", pet.registeredCount(), DEX_COUNT);
    for (int i = 1; i <= DEX_COUNT; i++)
      if (pet.isRegistered(i)) Serial.printf(" %d", i);
    Serial.println();
    Serial.println("DONE");
  } else if (line == "HEALTH") {
    Serial.printf("up=%lus heap=%u min=%u sd=%d mon=%d\n",
                  (unsigned long)(millis() / 1000), ESP.getFreeHeap(),
                  ESP.getMinFreeHeap(), sdReady, pmd.loaded || mon.loaded);
    // PSRAM is where the sprites and the framebuffer live, so a memory problem
    // shows up here long before it shows up in the heap figure above.
    Serial.printf("psram=%u screen=%s btlspr=%d/%d\n", (unsigned)ESP.getFreePsram(),
                  SCREEN_NAME[uiCurrentScreen() % SCR_COUNT],
                  btlPmd[0].loaded ? 1 : 0, btlPmd[1].loaded ? 1 : 0);
    // The same two lines the periodic heartbeat prints. Typed on a board is when
    // you actually want them, and a console HEALTH that reported LESS than the
    // automatic one is § "A rule enforced in one path but not in its twin".
    Serial.printf("save=%s pending=%d\n", pet.saveHealthy() ? "ok" : "BROKEN",
                  pet.savePending() ? 1 : 0);
    nvsReport("health");
    gNvsLow = nvsLowOnSpace();
    Serial.println("DONE");
  } else if (line == "STATS") {
    // A stable per-board label, for the web installer's backup history so two
    // devices' saves can be told apart. The efuse MAC is fixed in silicon and
    // needs no storage. It is NOT a secret and NOTHING is authorised by it --
    // which is why the installer keeps its history in the browser rather than
    // on a server keyed by this.
    Serial.printf("board=%012llX\n", ESP.getEfuseMac());
    // Its own line: the installer matches board= as a whole line, and older pages must still.
    Serial.printf("fw=%s\n", FW_VERSION);
    Serial.printf("spec=%d nv=%u com=%u fel=%u ene=%u lim=%u desc=%u sd=%d mon=%d bat=%d usb=%d rtc=%u\n",
                  pet.speciesId, pet.level(), pet.fullness, pet.joy, pet.energy,
                  pet.hygiene, pet.careMistakes, sdReady, mon.loaded,
                  batPercent(), usbPresent(), rtcEpoch());
    Serial.printf("peso=%u fue=%u def=%u vel=%u vit=%u baya=%d\n",
                  pet.weight, pet.atkStat(), pet.defStat(), pet.speStat(),
                  pet.vitStat(), pet.berryKnown);
    Serial.printf("iv=%u/%u/%u/%u tr=%u/%u/%u topes=%u/%u/%u\n",
                  pet.ivAtk, pet.ivDef, pet.ivSpe, pet.ivHp,
                  pet.trAtk, pet.trDef, pet.trSpe,
                  pet.trMaxAtk(), pet.trMaxDef(), pet.trMaxSpe());
    Serial.printf("variant=%d streak=%u/%u bond=%u medals=0x%X(%u) nick=%s\n",
                  pet.variant, pet.streak, pet.bestStreak, pet.bond, pet.medals,
                  pet.totalMedals, pet.nick);
    Serial.println("DONE");
  }
}

// ---------- touch input ----------

bool inPetZone(int16_t x, int16_t y) {
  return x > 110 && x < 356 && y > 95 && y < 310;
}

// a touch resolves on finger LIFT, to tell a tap from a swipe
void handleTouch() {
  static uint32_t lastPoll = 0;
  if (millis() - lastPoll < 20) return;  // 50 Hz is plenty for a finger
  lastPoll = millis();
  // only touch the bus if the chip signalled on INT or the finger is still down (we
  // need to detect the lift). Reading a sleeping CST9217 hung for ~1s and
  // froze the whole loop; SensorLib ignores Wire's timeout.
  if (!gTouchIrq && !wasPressed) return;
  gTouchIrq = false;
  int16_t x, y;
  bool pressed = touch.getPoint(&x, &y, 1) > 0;

  // training bag: every tap counts immediately (mash fast)
  if (sackOpen) {
    if (pressed && !wasPressed) {
      lastInteract = millis();
      if (y < 72) leaveSack();       // tap the top = leave, keeping what was earned
      else sackTap();
    }
    wasPressed = pressed;
    return;
  }

  if (pressed && !wasPressed) {  // gesture starts
    tX0 = tXl = x;
    tY0 = tYl = y;
    tStart = millis();
    holdFired = false;
    // A drag that STARTS on the rim is a scroll, not a swipe. Deciding it at
    // touch-down rather than on release is what keeps it unambiguous: the
    // finger never has to be told afterwards what it meant.
    rimActive = uiOnRim(x, y) && uiRimPages() > 1;
    rimA0 = uiRimAngle(x, y);
    rimSteps = 0;
    rimMoved = false;
    swallowGesture = (dimStage > 0) || screenOff || transferMode();  // waking or mid-transfer: no action
    if (screenOff) pet.setScreenOff(false);        // waking the screen wakes it
    screenOff = false;
    lastInteract = millis();
  } else if (pressed) {  // still pressed
    tXl = x;
    tYl = y;
    if (rimActive && !swallowGesture) {
      float d = uiRimAngle(x, y) - rimA0;
      while (d > 180.0f) d -= 360.0f;
      while (d < -180.0f) d += 360.0f;
      if (d > 6.0f || d < -6.0f) rimMoved = true;
      int want = (int)(d / RIM_STEP);
      while (rimSteps < want) { onRim(1); rimSteps++; }
      while (rimSteps > want) { onRim(-1); rimSteps--; }
    }
    // long press without moving on the creature -> release dialog
    //
    // Gated on the MAIN screen, not on a hand-maintained list of screens to
    // exclude. That list had gallery/card/keyboard/clock on it and nothing
    // else, so the hold still fired on the (since removed) party and box, boss,
    // battle, player and menu screens -- every one of which draws something
    // inside inPetZone. On the party screen it was genuinely dangerous: holding
    // a party slot opened "release the live pet?", and that dialog's YES box sat
    // on top of party slot 4.
    // One question with one answer, so a new screen cannot be forgotten.
    if (!holdFired && !swallowGesture && uiCurrentScreen() == SCR_MAIN && millis() - tStart > 3000 &&
        abs(tXl - tX0) < 30 && abs(tYl - tY0) < 30 && inPetZone(tX0, tY0) &&
        !pet.isEgg() && !confirmUntil && !pet.ceremony) {
      confirmUntil = millis() + 10000;
      holdFired = true;
    }
  } else if (wasPressed) {  // finger lifted: resolve the gesture
    lastInteract = millis();
    int dx = tXl - tX0, dy = tYl - tY0;
    uint32_t dt = millis() - tStart;
    if (rimMoved) { rimActive = false; wasPressed = pressed; return; }   // it was a scroll
    if (!holdFired && !swallowGesture) {
      if (abs(dx) > 80 && abs(dy) < 70 && dt < 800) onSwipe(dx > 0 ? 1 : -1);
      else if (abs(dy) > 80 && abs(dx) < 70 && dt < 800) onSwipeV(dy > 0 ? 1 : -1);
      else if (dt < 1500 && abs(dx) < 40 && abs(dy) < 40) onTap(tX0, tY0);
    }
    rimActive = false;
  }
  wasPressed = pressed;
}

// deslizar vertical: DOWN is back, UP is deeper.
//
// One meaning per direction, on every screen. It used to be a per-screen
// grab-bag -- vertical closed some screens, changed version on others, and on
// the main screen down opened the player card while up opened the creature's.
// The player card is a tile now, so down is free to mean the one thing a round
// UI most needs and never had: a back gesture that works everywhere.

void openClock();  // prototype

void onSwipeV(int dir) {
  if (pet.awaitingStarter()) return;  // blocked during the starter choice
  if (menuOpen) { menuOpen = false; return; }   // any swipe closes the menu
  if (battleOpen) return;   // no swiping out of a fight
  const bool back = dir > 0;

  // Modals and sheets: down backs out, up has nowhere deeper to go.
  if (lanOpen)      { if (back) { lanLeave(); lanOpen = false; } return; }
  if (trainOpen)    { if (back) trainOpen = false; return; }
  if (bagOpen)      { if (back) bagOpen = false; return; }
  if (movePickOpen) { if (back) movePickOpen = false; return; }
  // Either minigame exits on a swipe, keeping what was earned. A swipe cannot
  // be confused with a ball hit -- the gesture resolver separates them -- which
  // the header tap no longer could once the ball became hittable up there.
  if (gameOpen) { leaveGame(); return; }
  if (sackOpen) { leaveSack(); return; }
  if (spdOpen)  { leaveSpeed(); return; }
  if (memoOpen) { leaveMemo(); return; }
  if (kbOpen || pet.ceremony) return;
  if (clockOpen) {
    // The confirm is a level of depth: down dismisses it rather than leaving the
    // screen out from under it. A swipe must never be able to CONFIRM a wipe,
    // only decline one.
    if (resetConfirm) { if (back) resetConfirm = false; return; }
    if (back) clockOpen = false;
    return;
  }

  if (exploreOpen) { if (back) uiTileGo(TILE_PET); return; }

  if (gymOpen) { if (back) uiTileGo(TILE_PET); return; }
  if (galleryOpen) {
    if (galleryDetail) {
      if (back) { galleryDetail = 0; galleryPmd.unload(); galleryDirty = true; }
      return;
    }
    if (back) uiTileGo(TILE_PET);
    return;
  }
  if (playerOpen) { if (back) uiTileGo(TILE_PET); return; }
  if (cardOpen) { if (back) cardOpen = false; return; }

  // The pet tile itself. UP is its detail sheet; DOWN is already home.
  if (!back && !pet.isEgg() && !confirmUntil && !feedMenuUntil) {
    cardOpen = true;
    cardPage = 0;
  }
}

// Every primary button's height, so a test can hold them all to UI_TAP_MIN
// instead of waiting for somebody to report the next one by hand.
void uiButtonHeights(int *out, int max, int *n) {
  // What a control is worth is what you can HIT, not what it draws: the home
  // icons are a 72 px graphic inside a 94 px disc.
  const int h[] = { GYMBTN_H,
                    BTL_CELL_H + BTL_HIT_PAD * 2,
                    EXPLORE_BTN_H + EXPLORE_BTN_PAD * 2, BTN_HIT * 2,
                    // The memory game's pads. COMPACT controls, like everything
                    // else here -- a disc you aim at, so height is the whole
                    // story. Full-width list rows are a different shape and are
                    // held to a different rule; see uiRowHeights() below.
                    MEMO_R * 2 };
  int c = (int)(sizeof(h) / sizeof(h[0]));
  if (c > max) c = max;
  for (int i = 0; i < c; i++) out[i] = h[i];
  if (n) *n = c;
}

// FULL-WIDTH LIST ROWS, which are a different class from the discs and pills
// above and have to be judged differently.
//
// A row spans the whole panel, so at 44 px tall it is still a ~276 x 44 target --
// far easier to hit than a 44 px button, and nothing about it is ambiguous
// because there is nothing beside it to hit instead. They also CANNOT reach
// UI_TAP_FINGER where they live: five settings rows at 94 px would need 520 px on
// a 466 px panel, and four training rows would need 416 before the header. So
// they are held to the hard 44 px floor and not to the finger floor.
//
// Published so that floor is enforced rather than assumed -- the training menu's
// pitch was just retuned to fit a fourth row, which is exactly the change that
// could have quietly dropped it under.
void uiRowHeights(int *out, int max, int *n) {
  const int h[] = { MENU_ROW_H, TRAIN_ROW_H, SET_ROW_H, GOAL_ROW_H, GYM_ROW_H };
  int c = (int)(sizeof(h) / sizeof(h[0]));
  if (c > max) c = max;
  for (int i = 0; i < c; i++) out[i] = h[i];
  if (n) *n = c;
}

// The boss list's difficulty pill against its first boss row. Enlarging the
// pill to a real tap target once pushed it straight over that row -- the third
// overlap of this kind, after the old party screen's BOX/CLOSE and the battle
// grid against BACK.
// Which home icon is the only one live while the pet sleeps, and where it is.
// Exposed so a test can prove it is the LIGHT: removing an icon once shifted
// every index and quietly made the BATH button the wake-up button.
// Asleep, the LIGHT is the only live icon -- it is what wakes the pet. Both the
// draw path and the tap path ask THIS, so a greyed button can never still be
// tappable and the greying can never point at the wrong icon.
bool uiButtonDisabled(int i) { return pet.sleeping && i != BTN_LIGHT; }

int uiSleepButton(int *cx, int *cy) {
  if (cx) *cx = buttons[BTN_LIGHT].cx;
  if (cy) *cy = buttons[BTN_LIGHT].cy;
  return BTN_LIGHT;
}

void uiButtonAt(int i, int *cx, int *cy, int *half) {
  if (i < 0 || i >= BTN_COUNT) return;
  if (cx) *cx = buttons[i].cx;
  if (cy) *cy = buttons[i].cy;
  if (half) *half = BTN_HALF;
}

void gymHeaderRects(int *pillTop, int *pillBot, int *rowTop) {
  if (pillTop) *pillTop = GYMDIF_Y;
  if (pillBot) *pillBot = GYMDIF_Y + GYMDIF_H;
  if (rowTop) *rowTop = GYM_ROW_Y(0);
}

// Exposed so hit_test can hold every control to the finger floor without
// keeping its own copy of the number it is enforcing.
int uiTapFinger() { return UI_TAP_FINGER; }

// The home icons' TAP radius, which is larger than the graphic they draw.
int uiButtonHitR() { return BTN_HIT; }

// swipe: dir +1 = to the right
//
// HORIZONTAL IS THE TILE AXIS, and nothing else. Every screen used to keep its
// own opinion in here -- some paged, some closed, and several paged and THEN
// closed off the end, which is one gesture meaning two things and is exactly
// how the same paging bug shipped four times. Paging moved to the rim
// (onRim), which is what frees this axis to mean one thing.
void onSwipe(int dir) {
  // First boot has no axis yet: nothing exists but the starter choice.
  if (pet.awaitingStarter()) return;
  if (menuOpen) { menuOpen = false; return; }   // any swipe closes the menu
  if (battleOpen) return;   // no swiping out of a fight

  int t = uiTileIndex();
  if (t >= 0) {
    // A sheet drawn on top of a tile closes first; the axis is underneath it.
    if (galleryDetail) { galleryDetail = 0; galleryPmd.unload(); galleryDirty = true; return; }
    if (pet.ceremony || confirmUntil) return;
    int n = t - dir;   // the content follows the finger
    // IT BUMPS. This is the whole point of the axis: a horizontal swipe can no
    // longer close anything, so it cannot be confused with paging.
    if (n < 0 || n >= TILE_COUNT) { sfxPlay(SFX_DENY); return; }
    uiTileGo(n);
    return;
  }

  // Off the axis are modals -- pickers, sheets, minigames. None of them page
  // any more, so here horizontal simply backs out.
  if (trainOpen) { trainOpen = false; return; }
  if (bagOpen) { bagOpen = false; return; }
  if (movePickOpen) { movePickOpen = false; return; }
  if (gameOpen) { leaveGame(); return; }   // swipe out, keeping what you earned
  if (spdOpen) { leaveSpeed(); return; }
  if (memoOpen) { leaveMemo(); return; }
  if (kbOpen || clockOpen) return;
  if (cardOpen) { cardOpen = false; return; }
}

void onTap(int16_t x, int16_t y) {
  if (pet.awaitingStarter()) {  // first game: choose a starter
    for (int i = 0; i < starterCountShown(); i++) {
      int ry = STARTER_ROW_Y + i * (STARTER_ROW_H + STARTER_ROW_GAP);
      if (x >= 70 && x <= 396 && y >= ry && y <= ry + STARTER_ROW_H) {
        gOldSaveReplaced = false;
        pet.chooseStarter(starterOf((uint8_t)i));
        sfxPlay(SFX_TAP);
        break;
      }
    }
    return;
  }
  if (battleOpen) {
    battleTap(x, y);
    return;
  }
  if (exploreOpen) {
    if (y >= EXPLORE_DIF_Y && y <= EXPLORE_DIF_Y + EXPLORE_DIF_H) {
      exploreHard = !exploreHard;
      sfxPlay(SFX_TAP);
      return;
    }
    if (x >= EXPLORE_BTN_X - EXPLORE_BTN_PAD &&
      x <= EXPLORE_BTN_X + EXPLORE_BTN_W + EXPLORE_BTN_PAD &&
      y >= EXPLORE_BTN_Y - EXPLORE_BTN_PAD &&
      y <= EXPLORE_BTN_Y + EXPLORE_BTN_H + EXPLORE_BTN_PAD) {
      if (!startWildBattle(exploreHard)) { sfxPlay(SFX_DENY); return; }
      exploreOpen = false;
      sfxPlay(SFX_TAP);
    }
    return;
  }
  if (bagOpen) {
    bagTap(x, y);
    return;
  }
  if (playerOpen) {
    if (playerPage == 0 && y >= 32 && y < 68) {   // the name: rename yourself
      openKeyboardFor(KB_TRAINER);
      sfxPlay(SFX_TAP);
      return;
    }
    // the avatar is the only other live target; everything else backs out
    if (playerPage == 0 && x > CX - 40 && x < CX + 40 && y > 70 && y < 146) {
      pet.avatar = (uint8_t)((pet.avatar + 1) % AVATAR_COUNT);
      pet.saveNow();
      sfxPlay(SFX_TAP);
      return;
    }
    playerOpen = false;
    return;
  }
  if (lanOpen) {
    lanTap(x, y);
    return;
  }
  if (gymOpen) {
    if (y >= GYMDIF_Y && y <= GYMDIF_Y + GYMDIF_H) {   // the difficulty pill
      gymHard = !gymHard;
      sfxPlay(SFX_TAP);
      return;
    }
    if (x >= GYMBTN_X && x <= GYMBTN_X + GYMBTN_W &&
        y >= GYMBTN_Y && y <= GYMBTN_Y + GYMBTN_H) {
      gymOpen = false;
      lan.state = LINK_OFF;
      lanOpen = true;
      sfxPlay(SFX_TAP);
      return;
    }
    for (int i = 0; i < GYM_ROWS; i++) {
      uint8_t idx = gymPage * GYM_ROWS + i;
      if (idx >= TRAINER_COUNT) break;
      int rx, ry, rw, rh;
      gymRowRect(i, &rx, &ry, &rw, &rh);
      if (x < rx || x > rx + rw || y < ry || y > ry + rh) continue;
      if (!gymUnlocked(idx, gymHard)) { sfxPlay(SFX_DENY); return; }
      // An egg has nobody to send. With one partner there is no team to pick,
      // so a boss row starts the fight directly (it used to open a picker).
      if (pet.isEgg() || pet.ceremony != CER_NONE) { sfxPlay(SFX_DENY); return; }
      sfxPlay(SFX_TAP);
      gymOpen = false;
      startTrainerBattle(idx, gymHard);
      return;
    }
    gymOpen = false;
    return;
  }
  if (pet.hasLearnOffer()) {
    for (int i = 0; i < MOVE_SLOTS; i++) {
      int ry = LEARN_ROW_Y(i);
      if (x < 70 || x > 396 || y < ry || y > ry + 50) continue;
      sfxPlay(SFX_TAP);
      pet.acceptLearn(i);
      return;
    }
    if (x >= 70 && x <= 396 && y >= LEARN_SKIP_Y && y <= LEARN_SKIP_Y + 44) {
      sfxPlay(SFX_TAP);
      pet.declineLearn();
    }
    return;   // modal: nothing else on screen responds until it is answered
  }
  if (trainOpen) {
    bool inPanel = (x >= TRAIN_X && x <= TRAIN_X + TRAIN_W &&
                    y >= TRAIN_Y && y <= TRAIN_Y + TRAIN_H);
    if (!inPanel) { trainOpen = false; return; }   // tap outside = back to the pet
    for (int i = 0; i < TRAIN_ROWS; i++) {
      int ry = TRAIN_ROW_Y(i);
      if (x < TRAIN_X + 18 || x > TRAIN_X + TRAIN_W - 18) continue;
      if (y < ry || y > ry + TRAIN_ROW_H) continue;
      sfxPlay(SFX_TAP);
      trainOpen = false;
      if (i == TRAIN_ROW_ATK) startSack();
      else if (i == TRAIN_ROW_SPE) startSpeedGame();
      else if (i == TRAIN_ROW_DEF) startGame();   // the ball game trains DEF
      else startMemoGame();                       // and this one trains neither
      return;
    }
    return;
  }
  // The menu is modal and has three independent ways out: the CLOSE row, a tap
  // anywhere on the dimmed area outside the panel, and any swipe (see onSwipe).
  // Deliberately no timeout: a menu that vanishes while you read it is worse
  // than one that lingers.
  if (menuOpen) {
    bool inPanel = (x >= MENU_X && x <= MENU_X + MENU_W &&
                    y >= MENU_Y && y <= MENU_Y + MENU_H);
    if (!inPanel) { menuOpen = false; return; }   // tap outside = back to the pet
    for (int i = 0; i < MENU_ROWS; i++) {
      int ry = MENU_ROW_Y(i);
      if (x < MENU_X + 18 || x > MENU_X + MENU_W - 18) continue;
      if (y < ry || y > ry + MENU_ROW_H) continue;
      sfxPlay(SFX_TAP);
      menuOpen = false;
      if (i == 0) { cardOpen = true; cardPage = 1; }   // straight to the stats page
      else if (i == 1) { bagOpen = true; bagPage = 0; }
      else if (i == 2) { galleryOpen = true; galleryPage = 0; galleryDetail = 0; galleryDirty = true; }
      else if (i == 3) { openClock(); }
      else if (i == 4) {
        if (!pet.canRetireNow()) { sfxPlay(SFX_DENY); return; }
        choiceKind = 3; choiceUntil = millis() + 12000;
      }
      return;                                     // i == 5 is CLOSE: just shut
    }
    return;
  }
  if (movePickOpen) {
    uint16_t all[MOVE_PICK_MAX];
    uint8_t n = learnableList(all, MOVE_PICK_MAX);
    for (uint8_t i = 0; i < MOVE_PICK_PER_PAGE; i++) {
      uint8_t idx = movePickPage * MOVE_PICK_PER_PAGE + i;
      if (idx >= n) break;
      int ry = MOVE_PICK_Y(i);
      if (x < 70 || x > 396 || y < ry || y > ry + 50) continue;
      sfxPlay(SFX_TAP);
      // Swapping for a move already in another slot would silently duplicate
      // it, so trade the two slots instead of overwriting.
      uint16_t *tgt = pickTargetMoves();
      for (int s = 0; s < MOVE_SLOTS; s++)
        if (tgt[s] == all[idx] && s != movePickSlot) tgt[s] = tgt[movePickSlot];
      tgt[movePickSlot] = all[idx];
      pet.saveNow();
      movePickOpen = false;
      return;
    }
    movePickOpen = false;   // tap anywhere else = back to the moves page
    return;
  }
  if (galleryOpen) {
    galleryTap(x, y);
    return;
  }
  if (kbOpen) {
    keyboardTap(x, y);
    return;
  }
  if (clockOpen) {
    clockTap(x, y);
    return;
  }
  if (pet.ceremony) return;  // no buttons during the farewell
  if (cardOpen) {
    if (cardPage == 0 && y < 84) openKeyboard();  // tap the name = rename
    else if (cardPage == CARD_PROGRESS_PAGE && devolveTarget() &&
             x >= DEVO_BTN_X && x <= DEVO_BTN_X + DEVO_BTN_W &&
             y >= DEVO_BTN_Y && y <= DEVO_BTN_Y + DEVO_BTN_H) {
      cardOpen = false;
      choiceKind = 4; choiceUntil = millis() + 12000;
      sfxPlay(SFX_TAP);
    } else if (cardPage == 2) {
      for (int i = 0; i < MOVE_SLOTS; i++) {   // tap a slot to change it
        int ry = MOVE_ROW_Y(i);
        if (x < 70 || x > 396 || y < ry || y > ry + 50) continue;
        sfxPlay(SFX_TAP);
        movePickSlot = i;
        movePickPage = 0;
        movePickOpen = true;
        return;
      }
      cardOpen = false;            // anywhere else on the page still exits
    } else {
      cardOpen = false;
    }
    return;
  }
  if (spdOpen) {
    spdTap(x, y);
    return;
  }
  if (memoOpen) {
    memoTap(x, y);
    return;
  }
  if (gameOpen) {
    gameTap(x, y);
    return;
  }
  if (choiceKind) {          // decision dialog: action button (top) / keep (bottom)
    int c1t, c1b, c2t, c2b;
    uiConfirmRects(&c1t, &c1b, &c2t, &c2b);
    const bool inX = (x >= CONFIRM_BTN_X && x <= CONFIRM_BTN_X + CONFIRM_BTN_W);
    bool b1 = inX && y >= c1t && y <= c1b;   // action
    bool b2 = inX && y >= c2t && y <= c2b;   // keep / stay together
    if (choiceKind == 1) {                 // digivolution
      if (b1) { int16_t old = pet.speciesId; pet.evolve(); evoPmd.load(old, pet.variant); }
      else if (b2) pet.declineEvolve();
    } else if (choiceKind == 3) {          // retirement on request
      if (b1) pet.startRetire();
      // b2 is simply "no": nothing to decline, the row is always there
    } else if (choiceKind == 4) {          // de-digivolution
      if (b1) {
        int16_t old = pet.speciesId;
        if (pet.devolve(devolveTarget())) evoPmd.load(old, pet.variant);
      } else if (b2) {
        devolvePick++;
      }
    } else if (choiceKind == 2) {          // farewell
      if (b1) pet.startFarewell();
      else if (b2) pet.declineFarewell();
    }
    choiceKind = 0;
    return;
  }
  if (confirmUntil) {        // "release?" dialog: YES / NO
    if (millis() < confirmUntil && x >= 118 && x <= 218 && y >= 252 && y <= 304) {
      pet.release();
    }
    confirmUntil = 0;
    return;
  }
  if (feedMenuUntil) {       // food picker
    if (millis() < feedMenuUntil && y >= FEED_MENU_Y && y <= FEED_MENU_Y + FEED_MENU_H &&
        x >= FEED_MENU_X && x <= FEED_MENU_X + FEED_MENU_W) {
      int item = (x - FEED_MENU_X) / (FEED_MENU_W / 4);
      if (item > 3) item = 3;
      if (item == 3) pet.feedCandy();
      else pet.feedBerry(item);
      sfxPlay(SFX_EAT);
    }
    feedMenuUntil = 0;
    return;
  }
  if (pet.isEgg()) {
    pet.eggTap();
    sfxPlay(SFX_TAP);
    return;
  }
  // digivolution button: opens the digivolve/keep dialog
  if (pet.wantEvolveButton() && x >= EVO_BTN_X && x <= EVO_BTN_X + EVO_BTN_W &&
      y >= EVO_BTN_Y && y <= EVO_BTN_Y + EVO_BTN_H) {
    choiceKind = 1; choiceUntil = millis() + 12000;
    return;
  }
  // ending buttons (same box): runaway goes straight ahead; farewell opens a dialog.
  //
  // The runaway does NOT ask, deliberately. A pet you have to authorise to
  // leave is not really at stake, and neglect having teeth is the whole premise.
  // What was actually wrong is that a night's sleep could reach this state at
  // all -- fixed where it belongs, in the drain, by having the creature put
  // itself to bed (Pet::tick, autoSleep).
  if (x >= FAR_BTN_X && x <= FAR_BTN_X + FAR_BTN_W &&
      y >= FAR_BTN_Y && y <= FAR_BTN_Y + FAR_BTN_H) {
    if (pet.canRunawayNow()) { pet.startRunaway(); return; }
    if (pet.wantFarewellButton()) { choiceKind = 2; choiceUntil = millis() + 12000; return; }
  }
  for (int i = 0; i < BTN_COUNT; i++) {
    int dx = x - buttons[i].cx, dy = y - buttons[i].cy;
    if (dx * dx + dy * dy <= BTN_HIT * BTN_HIT) {
      if (uiButtonDisabled(i)) { sfxPlay(SFX_DENY); return; }
      sfxPlay(SFX_TAP);
      if (i == BTN_FOOD) feedMenuUntil = millis() + 6000;
      else if (i == BTN_LIGHT) pet.toggleLight();
      else if (i == BTN_BATH) startBath();
      else trainOpen = true;
      return;
    }
  }
  // tapping the name/status band opens the menu. This band was inert before,
  // and it sits clear of inPetZone (which starts at y 95).
  if (y >= 28 && y < 94) {
    menuOpen = true;
    sfxPlay(SFX_TAP);
    return;
  }
  // tap the creature = pet it
  if (inPetZone(x, y)) {
    pet.caress();
    if (!pet.sleeping) sfxPlay(SFX_HEART);
  }
}

// ---------- render ----------

bool gNight = false;  // real night (by the clock) or asleep: set by render()
uint16_t inkColor() { return gNight ? UI_INK_NIGHT : UI_INK; }

// ---------- background scene: the type's biome + the RTC's real time ----------

#define C565(r, g, b) ((uint16_t)((((r) >> 3) << 11) | (((g) >> 2) << 5) | ((b) >> 3)))
#define HORIZON 232  // line where the sky meets the ground

uint16_t lerp565(uint16_t a, uint16_t b, int i, int n) {
  if (n <= 0) return a;
  int ar = (a >> 11) & 31, ag = (a >> 5) & 63, ab = a & 31;
  int br = (b >> 11) & 31, bg = (b >> 5) & 63, bb = b & 31;
  return (uint16_t)((((ar + (br - ar) * i / n) << 11)) |
                    (((ag + (bg - ag) * i / n) << 5)) | (ab + (bb - ab) * i / n));
}

// hour of the day 0-23 (from the real time cached every 30s; 13 if there is no clock)
int sceneHour() {
  uint32_t e = pet.lastSeenEpoch;
  return e ? (int)((e / 3600) % 24) : 13;
}

// each biome's ground by day (at night it blends toward the night blue)
static const uint16_t BIOME_SOIL[6] = {
  C565(0x7e, 0xc0, 0x7f),  // 0 pradera
  C565(0xdc, 0xca, 0x94),  // 1 playa (arena)
  C565(0x4f, 0x8a, 0x55),  // 2 bosque
  C565(0x8a, 0x55, 0x44),  // 3 volcan
  C565(0xa8, 0x90, 0x6a),  // 4 montana
  C565(0xe6, 0xee, 0xf5),  // 5 nieve
};

void drawClouds(uint32_t now, uint16_t col) {
  for (int k = 0; k < 2; k++) {
    int cx = (int)((now / 50 + k * 250) % 560) - 40;
    int cy = 70 + k * 34;
    gfx->fillCircle(cx, cy, 16, col);
    gfx->fillCircle(cx + 18, cy + 3, 13, col);
    gfx->fillCircle(cx - 15, cy + 4, 12, col);
  }
}

void drawScene(uint8_t biome, uint32_t now, bool night) {
  int h = sceneHour();
  uint16_t top, bot;
  if (night)            { top = C565(0x0c, 0x12, 0x24); bot = C565(0x1e, 0x26, 0x46); }
  else if (h < 8)       { top = C565(0xd1, 0x6a, 0x86); bot = C565(0xf3, 0xb8, 0x7c); }  // dawn
  else if (h < 18)      { top = C565(0x8f, 0xc8, 0xea); bot = C565(0xdc, 0xee, 0xe6); }  // day
  else                  { top = C565(0xc7, 0x5a, 0x4a); bot = C565(0xf0, 0xae, 0x64); }  // dusk

  // sky in bands
  for (int y = 0; y < HORIZON; y += 8)
    gfx->fillRect(0, y, 466, 8, lerp565(top, bot, y, HORIZON));

  // sun or moon
  if (night) {
    gfx->fillCircle(360, 78, 24, C565(0xe8, 0xee, 0xf5));
    gfx->fillCircle(370, 72, 22, lerp565(top, bot, 78, HORIZON));  // crescent
    for (auto &st : STARS) gfx->fillRect(st[0], st[1], 4, 4, UI_WHITE);
  } else if (h < 18) {
    gfx->fillCircle(360, 84, 26, h < 8 ? C565(0xff, 0xd9, 0x8a) : C565(0xff, 0xe7, 0x9f));
    drawClouds(now, C565(0xff, 0xff, 0xff));
  } else {
    gfx->fillCircle(233, HORIZON - 6, 34, C565(0xff, 0xf1, 0xc8));  // setting sun
  }

  // the beach's sea: a strip of water above the sand
  uint16_t soil = BIOME_SOIL[biome < 6 ? biome : 0];
  if (night) soil = lerp565(soil, C565(0x16, 0x1c, 0x30), 9, 16);
  if (biome == 1) {
    uint16_t sea = night ? C565(0x1c, 0x34, 0x52) : C565(0x4f, 0x96, 0xc4);
    gfx->fillRect(0, HORIZON - 26, 466, 26, sea);
    for (int i = 0; i < 3; i++) {
      int wy = HORIZON - 22 + i * 7;
      uint16_t fc = night ? C565(0x3a, 0x58, 0x78) : C565(0xbf, 0xe6, 0xf5);
      gfx->fillRect(60 + ((now / 60 + i * 30) % 60), wy, 26, 2, fc);
      gfx->fillRect(300 - ((now / 60 + i * 20) % 60), wy, 26, 2, fc);
    }
  }

  // ground
  gfx->fillRect(0, HORIZON, 466, 466 - HORIZON, soil);
  uint16_t hill = lerp565(soil, night ? C565(0x0c, 0x12, 0x24) : C565(0xff, 0xff, 0xff), 3, 16);
  gfx->fillRoundRect(-60, HORIZON - 14, 586, 60, 30, hill);

  // biome details
  uint16_t dk = lerp565(soil, C565(0x10, 0x18, 0x20), night ? 11 : 7, 16);
  if (biome == 2) {  // forest: conifers in silhouette
    for (int tx : { 60, 150, 360, 416 }) {
      gfx->fillTriangle(tx, HORIZON - 46, tx - 16, HORIZON, tx + 16, HORIZON, dk);
      gfx->fillTriangle(tx, HORIZON - 60, tx - 12, HORIZON - 28, tx + 12, HORIZON - 28, dk);
    }
  } else if (biome == 3) {  // volcano: rocks and embers
    gfx->fillTriangle(70, HORIZON, 40, HORIZON + 30, 100, HORIZON + 30, dk);
    gfx->fillTriangle(400, HORIZON + 4, 372, HORIZON + 30, 430, HORIZON + 30, dk);
    if (!night)
      for (int e = 0; e < 4; e++)
        gfx->fillRect(120 + e * 70, HORIZON + 8 + (e % 2) * 6, 4, 4, C565(0xff, 0x9b, 0x3a));
  } else if (biome == 4) {  // mountain: peaks in the background
    gfx->fillTriangle(140, HORIZON - 50, 60, HORIZON, 220, HORIZON, dk);
    gfx->fillTriangle(330, HORIZON - 38, 250, HORIZON, 410, HORIZON, dk);
  } else if (biome == 5 && !night) {  // nieve: copos cayendo
    for (int f = 0; f < 10; f++) {
      int fx = (f * 53 + now / 40) % 466;
      int fy = (f * 90 + now / 18) % HORIZON;
      gfx->fillRect(fx, fy, 3, 3, UI_WHITE);
    }
  } else if (biome == 0) {  // meadow: tufts of grass
    for (int gx : { 80, 175, 300, 395 })
      for (int b = -1; b <= 1; b++)
        gfx->fillRect(gx + b * 5, HORIZON + 6, 2, 8 + (b == 0 ? 4 : 0), dk);
  }
}

// first game: choose a starter from BOTAMON / AGUMON / BETAMON
void renderStarterSelect() {
  gfx->fillScreen(RGB565_BLACK);
  gfx->fillCircle(CX, CY, 231, UI_BG_DAY);
  const char *t = T(S_CHOOSE_STARTER);
  gfx->setTextColor(UI_INK);
  gfx->setTextSize(2);
  gfx->setCursor(CX - strlen(t) * 6, 68);
  gfx->print(t);
  for (int i = 0; i < starterCountShown(); i++) {
    int16_t d = starterOf(i);
    const uint16_t accent = dexAccent(d);
    int ry = STARTER_ROW_Y + i * (STARTER_ROW_H + STARTER_ROW_GAP);
    gfx->fillRoundRect(70, ry, 326, STARTER_ROW_H, 14, lerp565(accent, UI_WHITE, 6, 8));
    gfx->drawRoundRect(70, ry, 326, STARTER_ROW_H, 14, accent);
    const uint8_t *th = thumbs.get(d);     // the starter's thumbnail (if the SD is ready)
    if (th) drawThumb(th, 76, ry - 5, 3, false);
    gfx->setTextColor(UI_INK);
    gfx->setTextSize(3);
    gfx->setCursor(178, ry + 24);
    gfx->print(TS_DEX_TBL[d].name);
  }
  // No hatchling can be drawn: the pack is not on the card. Saying so is the only way
  // off this screen, which a first boot has no other way past.
  if (!starterCountShown()) {
    gfx->setTextColor(UI_TEXT_BAD);
    gfx->setCursor(CX - (int)strlen(T(S_NEED_PACK)) * 6, 200);
    gfx->setTextSize(2);
    gfx->print(T(S_NEED_PACK));
  }
  // A v1.0.0 save cannot be carried forward. A player who just updated has to be told
  // why their partner is gone, on the panel: they are not watching the serial port.
  if (gOldSaveReplaced) {
    gfx->setTextColor(UI_TEXT_BAD);
    gfx->setTextSize(1);
    gfx->setCursor(CX - (int)strlen(T(S_OLD_SAVE)) * 3, 354);
    gfx->print(T(S_OLD_SAVE));
    gfx->setCursor(CX - (int)strlen(T(S_OLD_SAVE2)) * 3, 366);
    gfx->print(T(S_OLD_SAVE2));
  }
  gfx->flush();
}

// ---------- crash breadcrumbs ----------
//
// "It has a mini crash" is not a bug report you can act on, because the board
// never says WHY it restarted. These three live in RTC memory, which survives
// a panic, a watchdog and a software reset -- everything except pulling the
// power -- so the next boot can say what the firmware was doing when it died.
//
// Written every frame. That is one word to RTC RAM per render, which costs
// nothing next to a full-screen redraw, and it means the crumb always names
// the screen that was actually on the panel rather than the last one opened.
#define CRUMB_MAGIC 0x7AABE10C
RTC_NOINIT_ATTR uint32_t gCrumbMagic;
RTC_NOINIT_ATTR uint32_t gCrumbScreen;
RTC_NOINIT_ATTR uint32_t gCrumbHeap;


// Which screen is on the panel RIGHT NOW, in the same order render() tests.
uint8_t uiCurrentScreen() {
  if (transferMode()) return SCR_TRANSFER;
  if (pet.awaitingStarter()) return SCR_STARTER;
  if (galleryOpen) return SCR_GALLERY;
  if (movePickOpen) return SCR_MOVEPICK;
  if (bagOpen) return SCR_BAGSCR;
  if (kbOpen) return SCR_KEYBOARD;
  if (cardOpen) return SCR_CARD;
  if (playerOpen) return SCR_PLAYER;
  if (clockOpen) return SCR_CLOCK;
  if (btlWinUntil) return SCR_WIN;
  if (battleOpen) return SCR_BATTLE;
  if (lanOpen) return SCR_LAN;
  if (exploreOpen) return SCR_EXPLORE;
  if (gymOpen) return SCR_GYM;
  if (pet.hasLearnOffer()) return SCR_LEARN;
  if (gameOpen || sackOpen || spdOpen || memoOpen) return SCR_GAME;
  if (trainOpen) return SCR_TRAIN;
  if (menuOpen) return SCR_MENU;
  return SCR_MAIN;
}

// ---------------------------------------------------------------------------
// The tile axis and the rim.
//
// Two rules replace the pile of per-screen opinions that used to live in
// onSwipe(), and between them they close the bug this project shipped FOUR
// times -- a paged screen that CLOSED instead of paging:
//
//   HORIZONTAL is the tile axis. Five peer screens with the pet near the middle,
//   and it BUMPS at the ends. It can no longer close anything, so the gesture
//   that means "next page" and the gesture that means "exit" are different
//   gestures, which they never were before.
//
//   THE RIM is paging. A drag that starts outside RIM_R0 pages whatever is in
//   front of you, and CLAMPS at both ends. This is what frees the horizontal
//   axis -- A and C only work as a pair, and this is the joint.
//
// Vertical stays depth: up opens, down goes back.

// One table, so uiTileIndex() and uiTileGo() cannot disagree about the axis.
//
// PLAYER . [PET] . EXPLORE . GYM . DEX -- yours on the left, the world on the
// right. Exploration is a primary loop, not a boss action, so it gets the first
// world-facing stop and the main screen can name it directly. PARTY used to sit
// between PLAYER and the pet; with one partner there is no party to show.
static const uint8_t TILE[TILE_COUNT] = { SCR_PLAYER, SCR_MAIN, SCR_EXPLORE, SCR_GYM, SCR_GALLERY };

int uiTileIndex() {
  uint8_t s = uiCurrentScreen();
  for (int i = 0; i < TILE_COUNT; i++)
    if (TILE[i] == s) return i;
  return -1;   // not on the axis: a modal, a minigame, a fight
}

// Jump to tile i. Every stop on the axis is a top-level screen, so this closes
// the others rather than stacking on them.
void uiTileGo(int i) {
  if (i < 0) i = 0;
  if (i >= TILE_COUNT) i = TILE_COUNT - 1;
  exploreOpen = gymOpen = galleryOpen = playerOpen = false;
  galleryDetail = 0;
  switch (TILE[i]) {
    case SCR_GYM: gymOpen = true; gymPage = 0; break;
    case SCR_EXPLORE: exploreOpen = true; break;
    case SCR_GALLERY:
      galleryOpen = true; galleryPage = 0;
      galleryDirty = true;
      break;
    case SCR_PLAYER: playerOpen = true; playerPage = 0; break;
    default: break;   // the pet tile is everything else being shut
  }
  sfxPlay(SFX_TAP);
}

// ---------- the rim ----------

// The paged screens as ONE table: which variable holds the page, and how many
// there are. Three separate switches over the same list -- one to draw the
// scrollbar, one to page, one for the test -- is precisely the shape CLAUDE.md
// warns about, so draw, input and test all come through here.
static uint8_t *uiRimTarget(uint8_t *pages) {
  uint8_t n = 1;
  uint8_t *p = nullptr;
  switch (uiCurrentScreen()) {
    case SCR_GYM:     p = &gymPage;     n = (TRAINER_COUNT + GYM_ROWS - 1) / GYM_ROWS; break;
    // galleryPages(): with a filter on, the grid is shorter, and paging past the
    // filtered end draws an empty screen.
    case SCR_GALLERY: p = &galleryPage; n = galleryPages(); break;
    case SCR_PLAYER:  p = &playerPage;  n = PLAYER_PAGES; break;
    case SCR_BAGSCR:  p = &bagPage;     n = bagPages(); break;
    case SCR_CARD:    p = &cardPage;    n = CARD_PAGES; break;
    // Settings became two pages when brightness and the reset arrived; the rim
    // is how every other paged screen here works, and uiDrawRimBar() reads the
    // same table, so the second page advertises itself with no new control.
    case SCR_CLOCK:   p = &clockPage;   n = CLOCK_PAGES; break;
    case SCR_MOVEPICK: {
      uint16_t all[MOVE_PICK_MAX];
      uint8_t k = learnableList(all, MOVE_PICK_MAX);
      p = &movePickPage;
      n = k ? (uint8_t)((k + MOVE_PICK_PER_PAGE - 1) / MOVE_PICK_PER_PAGE) : 1;
      break;
    }
    default: break;
  }
  if (pages) *pages = n ? n : 1;
  return p;
}

uint8_t uiRimPages() {
  uint8_t n = 1;
  uiRimTarget(&n);
  return n;
}

uint8_t uiRimPage() {
  uint8_t *p = uiRimTarget(nullptr);
  return p ? *p : 0;
}

// dir > 0 is clockwise, which is forwards.
void onRim(int dir) {
  uint8_t n = 1;
  uint8_t *p = uiRimTarget(&n);
  if (!p || n < 2) return;
  int v = (int)(*p) + dir;
  if (v < 0) v = 0;
  if (v >= n) v = n - 1;          // CLAMPS: the rim can never close a screen
  if (v == (int)(*p)) return;
  *p = (uint8_t)v;
  if (uiCurrentScreen() == SCR_GALLERY) galleryDirty = true;
  sfxPlay(SFX_TAP);
}

bool uiOnRim(int16_t x, int16_t y) {
  int dx = x - CX, dy = y - CY;
  return dx * dx + dy * dy >= RIM_R0 * RIM_R0;
}

float uiRimAngle(int16_t x, int16_t y) {
  return atan2f((float)(y - CY), (float)(x - CX)) * 57.29578f;
}

// ---------- the chrome that makes both of the above visible ----------
#define TILE_DOT_Y 440

static inline uint16_t uiChromeInk() {
  return uiCurrentScreen() == SCR_MAIN ? inkColor() : UI_INK;
}

// The tile axis, drawn on every screen that is on it. Five bound gestures that
// nothing on the panel mentions would be built, reachable and completely invisible.
void uiDrawTileDots() {
  int t = uiTileIndex();
  if (t < 0) return;
  uint16_t ink = uiChromeInk();
  if (t == TILE_PET) {
    char left[28], right[24];
    snprintf(left, sizeof(left), "< %s", T(S_TRAINER));
    snprintf(right, sizeof(right), "%s >", T(S_EXPLORE));
    gfx->setTextColor(ink);
    gfx->setTextSize(2);
    gfx->setCursor(CX - 8 - (int)strlen(left) * 12, 408);
    gfx->print(left);
    gfx->setCursor(CX + 8, 408);
    gfx->print(right);
  }
  for (int i = 0; i < TILE_COUNT; i++) {
    int x = CX - (TILE_COUNT - 1) * 13 + i * 26;
    if (i == t) gfx->fillRoundRect(x - 9, TILE_DOT_Y - 3, 18, 7, 3, ink);
    else gfx->fillCircle(x, TILE_DOT_Y, 3, UI_TRACK);
  }
}

// The arc scrollbar, at 2-4 o'clock, replacing the dot rows the paged screens
// used to carry. A straight bar is at its thinnest exactly where a list is
// longest, and dots show position without showing extent. Both this and the
// rim drag read uiRimTarget(), so they cannot disagree about where you are.
void uiDrawRimBar() {
  uint8_t n = uiRimPages();
  if (n < 2) return;
  uint8_t p = uiRimPage();
  if (p >= n) p = n - 1;
  int span = RIM_BAR_A1 - RIM_BAR_A0;
  int thumb = span / n;
  if (thumb < 9) thumb = 9;
  int a0 = RIM_BAR_A0 + (span - thumb) * (int)p / (int)(n - 1);
  uiArc(CX, CY, RIM_BAR_R, RIM_BAR_A0, RIM_BAR_A1, 7, UI_TRACK);
  uiArc(CX, CY, RIM_BAR_R, a0, a0 + thumb, 7, uiChromeInk());
}

// Called by every renderer that is on the axis or pages, immediately before it
// flushes. One call, so a screen either has the chrome or visibly does not.
void uiChrome() {
  uiDrawTileDots();
  uiDrawRimBar();
}

void renderExplore() {
  int h = sceneHour();
  gNight = pet.sleeping || h < 6 || h >= 20;
  drawScene(pet.isEgg() ? 0 : dexBiome(pet.speciesId), millis(), gNight);

  gfx->fillRoundRect(78, 28, 310, 54, 14, UI_BG_DAY);
  gfx->drawRoundRect(78, 28, 310, 54, 14, UI_INK);
  gfx->setTextColor(UI_INK);
  gfx->setTextSize(3);
  gfx->setCursor(CX - (int)strlen(T(S_EXPLORE)) * 9, 44);
  gfx->print(T(S_EXPLORE));

  drawMap(SPR_ICON_PLAY, 16, CX - 40, 112, 5, false);

  const char *dif = T(exploreHard ? S_HARD : S_EASY);
  int dw = (int)strlen(dif) * 12 + 48;
  if (dw < 140) dw = 140;
  gfx->fillRoundRect(CX - dw / 2, EXPLORE_DIF_Y, dw, EXPLORE_DIF_H, 12,
                     exploreHard ? UI_BAR_BAD : UI_TRACK);
  gfx->setTextColor(exploreHard ? UI_BG_DAY : UI_INK);
  gfx->setTextSize(2);
  gfx->setCursor(CX - (int)strlen(dif) * 6, EXPLORE_DIF_Y + 14);
  gfx->print(dif);

  bool live = !pet.isEgg() && pet.ceremony == CER_NONE;
  gfx->fillRoundRect(EXPLORE_BTN_X, EXPLORE_BTN_Y, EXPLORE_BTN_W, EXPLORE_BTN_H,
                     16, live ? UI_BAR_OK : UI_TRACK);
  gfx->drawRoundRect(EXPLORE_BTN_X, EXPLORE_BTN_Y, EXPLORE_BTN_W, EXPLORE_BTN_H,
                     16, live ? UI_INK : UI_INK_SOFT);
  gfx->setTextColor(live ? UI_WHITE : UI_INK_SOFT);
  gfx->setTextSize(3);
  gfx->setCursor(CX - (int)strlen(T(S_EXPLORE)) * 9, EXPLORE_BTN_Y + 24);
  gfx->print(T(S_EXPLORE));
  uiChrome();
  gfx->flush();
}

static void crumbDrop() {
  gCrumbMagic = CRUMB_MAGIC;
  gCrumbScreen = uiCurrentScreen();
  gCrumbHeap = ESP.getFreeHeap();
}

static const char *resetReasonName(int r) {
  switch (r) {
    case ESP_RST_POWERON:  return "power on";
    case ESP_RST_EXT:      return "reset pin";
    case ESP_RST_SW:       return "software (our own restart)";
    case ESP_RST_PANIC:    return "PANIC -- a crash";
    case ESP_RST_INT_WDT:  return "INTERRUPT WATCHDOG";
    case ESP_RST_TASK_WDT: return "TASK WATCHDOG -- something blocked too long";
    case ESP_RST_WDT:      return "watchdog";
    case ESP_RST_BROWNOUT: return "BROWNOUT -- the supply sagged";
    case ESP_RST_DEEPSLEEP: return "deep sleep";
    default: return "unknown";
  }
}

// Printed once at boot. On a clean start it is one line; after a crash it says
// which screen was up and how much heap was left, which is the whole point.
void bootReport() {
  int r = (int)esp_reset_reason();
  bool bad = (r == ESP_RST_PANIC || r == ESP_RST_INT_WDT ||
              r == ESP_RST_TASK_WDT || r == ESP_RST_WDT || r == ESP_RST_BROWNOUT);
  Serial.printf("boot: reset=%s heap=%u psram=%u\n", resetReasonName(r),
                (unsigned)ESP.getFreeHeap(), (unsigned)ESP.getFreePsram());
  if (bad && gCrumbMagic == CRUMB_MAGIC) {
    Serial.printf("CRASH: it died on the '%s' screen with heap=%u\n",
                  gCrumbScreen < SCR_COUNT ? SCREEN_NAME[gCrumbScreen] : "?",
                  (unsigned)gCrumbHeap);
  } else if (bad) {
    Serial.println("CRASH: no breadcrumb (RTC memory was lost too)");
  }
  gCrumbMagic = 0;   // one report per crash, not on every later boot
}

// Dark on purpose: it can sit on an AMOLED for the length of a whole install.
void renderTransfer() {
  gfx->fillScreen(RGB565_BLACK);
  gfx->setTextColor(UI_INK_NIGHT);
  gfx->setTextSize(2);
  gfx->setCursor(CX - (int)strlen(T(S_XFER)) * 6, 160);
  gfx->print(T(S_XFER));
  char n[32];
  snprintf(n, sizeof(n), T(S_XFER_FMT), (unsigned)sdTransferFiles);
  gfx->setTextSize(3);
  gfx->setCursor(CX - (int)strlen(n) * 9, 212);
  gfx->print(n);
  gfx->setTextColor(UI_SCROLL_NIGHT);
  gfx->setTextSize(2);
  gfx->setCursor(CX - (int)strlen(T(S_XFER_HINT)) * 6, 290);
  gfx->print(T(S_XFER_HINT));
  gfx->flush();
}

void render() {
  crumbDrop();   // so a crash can name the screen it happened on
  if (transferMode()) {
    renderTransfer();
    return;
  }
  if (pet.awaitingStarter()) {  // first game: choose a starter
    renderStarterSelect();
    return;
  }
  if (galleryOpen) {
    renderGallery();
    return;
  }
  if (movePickOpen) {
    renderMovePick();
    return;
  }
  if (gameOpen) {
    renderGame();
    return;
  }
  if (bagOpen) {
    renderBag();
    return;
  }
  if (sackOpen) {
    renderSack();
    return;
  }
  if (spdOpen) {
    renderSpeed();
    return;
  }
  if (memoOpen) {
    renderMemo();
    return;
  }
  if (trainOpen) {
    renderTrain();
    return;
  }
  if (kbOpen) {
    renderKeyboard();
    return;
  }
  if (clockOpen) {
    renderClock();
    return;
  }
  if (battleOpen) {
    btlLinkPoll();
    renderBattle();
    return;
  }
  if (lanOpen) {
    renderLan();
    return;
  }
  if (exploreOpen) {
    renderExplore();
    return;
  }
  if (gymOpen) {
    renderGyms();
    return;
  }
  if (playerOpen) {
    renderPlayer();
    return;
  }
  if (pet.hasLearnOffer()) {
    renderLearn();
    return;
  }
  if (cardOpen) {
    renderCard();
    return;
  }
  int h = sceneHour();
  gNight = pet.sleeping || h < 6 || h >= 20;
  // drawScene covers the full 466x466: no fillScreen(BLACK) beforehand, so
  // an overlapping DMA flush never captures half-black (anti-flicker)
  drawScene(pet.isEgg() ? 0 : dexBiome(pet.speciesId), millis(), gNight);

  if (pet.ceremony) {
    const TsDexEntry &d = TS_DEX_TBL[pet.speciesId];
    const char *msg = (pet.ceremony == CER_FAREWELL) ? T(S_FAREWELL)
                      : (pet.ceremony == CER_RUNAWAY) ? T(S_RUNAWAY)
                                                      : T(S_GOODBYE);
    drawHeader(d.name, dexAccent(pet.speciesId), msg);
    drawCeremony();
    gfx->flush();
    return;
  }

  if (pet.isEgg()) {
    drawHeader(T(S_EGG_HDR), inkColor(), eggMsg());
    int s = 5, x = CX - 16 * s, y = PET_CY - 16 * s;
    drawMap(SPR_EGG, SPRITE_H, x, y, s, false);
    if (pet.eggCracks() >= 1)
      for (auto &c : CRACK1) gfx->fillRect(x + c[0] * s, y + c[1] * s, s, s, INK_K);
    if (pet.eggCracks() >= 2)
      for (auto &c : CRACK2) gfx->fillRect(x + c[0] * s, y + c[1] * s, s, s, INK_K);
    char reg[24];
    snprintf(reg, sizeof(reg), T(S_DIGIDEX_FMT), pet.registeredCount(), DEX_COUNT);
    gfx->fillRect(0, 312, 466, 154, gNight ? UI_BG_NIGHT : UI_BG_DAY);
    gfx->setTextColor(inkColor());
    gfx->setTextSize(2);
    gfx->setCursor(CX - strlen(reg) * 6, 344);
    gfx->print(reg);

    // Which generation this egg comes from. It lives HERE rather than in the
    // settings screen because this is the only moment it does anything: the
    // Digimon is decided when the egg appears, so choosing the version is
    // something you do to the egg in front of you.
  } else {
    const TsDexEntry &d = TS_DEX_TBL[pet.speciesId];
    char name[28];
    const char *base = pet.nick[0] ? pet.nick : d.name;
    snprintf(name, sizeof(name), T(S_NAME_FMT), pet.variant ? "*" : "", base, pet.level());
    drawHeader(name, gNight ? UI_INK_NIGHT : dexAccent(pet.speciesId), statusMsg());
    drawStreakBadge();
    drawPet();
    drawBath();
    drawPoops();
    // bottom panel: a clean base for the bars and buttons over the landscape
    gfx->fillRect(0, 312, 466, 154, gNight ? UI_BG_NIGHT : UI_BG_DAY);
    drawBars();
    drawButtons();
    drawCelebration();
    if (pet.wantEvolveButton()) drawEvolveButton();        // red CTA: evolve
    else if (pet.canRunawayNow()) drawRunawayButton();     // grim CTA: runaway (neglect)
    else if (pet.wantFarewellButton()) drawFarewellButton();  // golden CTA: farewell
  }

  if (pet.sleeping) {
    gfx->setTextColor(UI_INK_NIGHT);
    gfx->setTextSize(3);
    gfx->setCursor(320, 130);
    gfx->print("Zz");
  }

  // food picker
  if (feedMenuUntil) {
    if (millis() > feedMenuUntil) {
      feedMenuUntil = 0;
    } else {
      gfx->fillRoundRect(FEED_MENU_X, FEED_MENU_Y, FEED_MENU_W, FEED_MENU_H, 14, UI_WHITE);
      gfx->drawRoundRect(FEED_MENU_X, FEED_MENU_Y, FEED_MENU_W, FEED_MENU_H, 14, inkColor());
      drawMap(SPR_ICON_FOOD, 16, FEED_MENU_X + 9, FEED_MENU_Y + 8, 3, false);
      drawMap(SPR_ICON_BERRY_B, 16, FEED_MENU_X + 75, FEED_MENU_Y + 8, 3, false);
      drawMap(SPR_ICON_BERRY_G, 16, FEED_MENU_X + 141, FEED_MENU_Y + 8, 3, false);
      drawMap(SPR_ICON_CANDY, 16, FEED_MENU_X + 207, FEED_MENU_Y + 8, 3, false);
    }
  }

  // "release?" dialog (long press on the creature)
  if (confirmUntil) {
    if (millis() > confirmUntil) {
      confirmUntil = 0;
    } else {
      gfx->fillRoundRect(94, 168, 278, 152, 16, UI_WHITE);
      gfx->drawRoundRect(94, 168, 278, 152, 16, UI_INK);
      char q[28];
      snprintf(q, sizeof(q), T(S_RELEASE_FMT), TS_DEX_TBL[pet.speciesId].name);
      gfx->setTextColor(UI_INK);
      gfx->setTextSize(2);
      gfx->setCursor(CX - strlen(q) * 6, 196);
      gfx->print(q);
      gfx->fillRoundRect(118, 252, 100, 52, 12, UI_BAR_OK);
      gfx->setTextColor(UI_WHITE);
      gfx->setCursor(118 + (100 - (int)strlen(T(S_YES)) * 12) / 2, 270);
      gfx->print(T(S_YES));
      gfx->fillRoundRect(248, 252, 100, 52, 12, UI_BAR_BAD);
      gfx->setCursor(248 + (100 - (int)strlen(T(S_NO)) * 12) / 2, 270);
      gfx->print(T(S_NO));
    }
  }

  // decision dialog (evolve/keep, say goodbye/stay together)
  if (choiceKind) {
    if (millis() > choiceUntil) choiceKind = 0;
    else drawChoiceDialog();
  }

  uiChrome();
  if (menuOpen) drawMenu();

  gfx->flush();
}

// ---------- mini-game: taps with the ball ----------

void startGame() {
  if (pet.isEgg() || pet.sleeping || pet.ceremony) return;
  gameOpen = true;
  gameOverUntil = 0;
  gameUntil = millis() + GAME_MS;
  gameScore = 0;
  gameMisses = 0;
  gameNewHi = false;
  hitTime = 0;
  gamePetX = 233;
  respawnBall();
}

void respawnBall() {
  ballX = 150 + random(166);
  ballY = 96;
  float sp = 1.6f + gameScore * 0.05f;  // livelier as you progress
  if (sp > 4.0f) sp = 4.0f;
  ballVX = random(2) ? sp : -sp;
  ballVY = 0;
}

// Leaving a minigame early banks what was actually earned rather than voiding
// it. Quitting used to forfeit everything, which mattered little when the ball
// game trained a stat you could grind back -- but it is now purely about
// happiness, and a pet that just played should be happier for it. The
// gameOver/over guards stop a swipe during the results screen paying twice.
void leaveGame() {
  if (!gameOverUntil) pet.playResult(gameScore);
  gameOpen = false;
}
void leaveSack() {
  if (!sackOverUntil) pet.trainStrength(sackHits);
  sackOpen = false;
}
void leaveSpeed() {
  if (!spdOverUntil) pet.trainSpeed(spdHits);
  spdOpen = false;
}

void gameTap(int16_t x, int16_t y) {
  if (gameOverUntil) return;
  // The ball is checked BEFORE the quit strip. The ball bounces inside a circle
  // of radius 205 about the centre, so it reaches y=28 -- well inside the y<72
  // header. Reaching up to hit a high ball used to abandon the game instead,
  // silently forfeiting the score, the speed training and the record.
  float dx = ballX - x, dy = ballY - y;
  bool onBall = (dx * dx + dy * dy < 74 * 74);
  if (!onBall && y < 72) {  // tap the top = leave, keeping what was earned
    leaveGame();
    return;
  }
  if (onBall) {  // the ball was tapped!
    gameScore++;
    sfxPlay(SFX_PLAY);
    // softer hit: a moderate push that grows slowly with the score
    float lift = 6.6f + (gameScore > 16 ? 3.5f : gameScore * 0.22f);
    ballVY = -lift;
    ballVX += dx * 0.12f;
    if (ballVX > 6.5f) ballVX = 6.5f;
    if (ballVX < -6.5f) ballVX = -6.5f;
    hitX = ballX;
    hitY = ballY;
    hitTime = millis();
  }
}

void stepGame() {
  float grav = 0.40f + gameScore * 0.013f;  // falls a little faster each time
  if (grav > 0.80f) grav = 0.80f;
  ballVY += grav;
  ballX += ballVX;
  ballY += ballVY;
  // bounce off the circular wall
  float dx = ballX - CX, dy = ballY - CY;
  float d = sqrtf(dx * dx + dy * dy);
  if (d > 205) {
    float nx = dx / d, ny = dy / d;
    float dot = ballVX * nx + ballVY * ny;
    if (dot > 0) {
      ballVX = (ballVX - 2 * dot * nx) * 0.85f;
      ballVY = (ballVY - 2 * dot * ny) * 0.85f;
    }
    ballX = CX + nx * 205;
    ballY = CY + ny * 205;
  }
  // the clock, or three misses, whichever lands first
  if (gameUntil && millis() >= gameUntil && !gameOverUntil) {
    gameNewHi = (gameScore > pet.gameHi);
    pet.playResult(gameScore);
    sfxPlay(gameNewHi && gameScore > 0 ? SFX_MEDAL : SFX_LEVEL);
    gameOverUntil = millis() + 4000;
    return;
  }
  if (ballY > 384) {  // hit the ground
    if (++gameMisses >= 3) {
      gameNewHi = (gameScore > pet.gameHi);
      pet.playResult(gameScore);  // update the record and give happiness
      sfxPlay(gameNewHi && gameScore > 0 ? SFX_MEDAL : SFX_LEVEL);
      gameOverUntil = millis() + 4000;
    } else {
      respawnBall();
    }
  }
  // the creature follows it along the bottom
  float chase = (ballX - gamePetX) * 0.12f;
  if (chase > 7) chase = 7;
  if (chase < -7) chase = -7;
  gamePetX += chase;
}

// ---------- training bag (trains strength) ----------

void startSack() {
  if (pet.isEgg() || pet.sleeping || pet.ceremony) return;
  sackOpen = true;
  sackUntil = millis() + 10000;
  sackOverUntil = 0;
  sackHits = 0;
  sackShake = 0;
  sackNewHi = false;
}

void sackTap() {
  if (millis() >= sackUntil) return;  // time is already up
  sackHits++;
  sackShake = 16;  // shake the bag
}

void drawGameScene();  // prototype (defined further down)

void renderSack() {
  uint32_t now = millis();
  drawGameScene();  // habitat background
  bool night = sceneHour() < 6 || sceneHour() >= 20;
  uint16_t ink = night ? UI_INK_NIGHT : UI_INK;

  // result screen
  if (sackOverUntil) {
    if (now > sackOverUntil) { sackOpen = false; return; }
    char b[20];
    snprintf(b, sizeof(b), T(S_HITS_FMT), sackHits);
    gfx->setTextColor(ink);
    gfx->setTextSize(4);
    gfx->setCursor(CX - strlen(b) * 12, 150);
    gfx->print(b);
    char g[18];
    snprintf(g, sizeof(g), T(S_STR_GAIN_FMT), sackGain);
    gfx->setTextColor(UI_BAR_BAD);
    gfx->setTextSize(3);
    gfx->setCursor(CX - strlen(g) * 9, 210);
    gfx->print(g);
    gfx->setTextSize(2);
    if (sackNewHi && sackHits > 0) {
      gfx->setTextColor(UI_BAR_WARN);
      gfx->setCursor(CX - strlen(T(S_NEW_RECORD)) * 6, 256);
      gfx->print(T(S_NEW_RECORD));
    } else {
      char r[18];
      snprintf(r, sizeof(r), T(S_RECORD_FMT), pet.strHi);
      gfx->setTextColor(ink);
      gfx->setCursor(CX - strlen(r) * 6, 256);
      gfx->print(r);
    }
    gfx->flush();
    return;
  }

  // the 10 s are over: apply the training
  if (now >= sackUntil) {
    sackNewHi = (sackHits > pet.strHi);
    sackGain = pet.trainStrength(sackHits);
    sfxPlay(sackNewHi ? SFX_MEDAL : SFX_PLAY);
    sackOverUntil = now + 3500;
    gfx->flush();
    return;
  }

  // mashing in progress
  sackShake *= 0.84f;
  int off = (int)(sackShake * sinf(now * 0.05f));
  int sx = CX + off, top = 86, sy = 150;
  gfx->fillRect(CX - 3, 56, 6, top - 56, ink);          // gancho/cuerda
  gfx->fillRect(sx - 4, top - 30, 8, 34, ink);          // cadena
  gfx->fillRoundRect(sx - 42, top, 84, 150, 26, C565(0xb5, 0x3a, 0x3a));  // saco
  gfx->fillRoundRect(sx - 42, top, 84, 22, 18, C565(0x7e, 0x28, 0x28));   // tapa
  gfx->drawRoundRect(sx - 42, top, 84, 150, 26, ink);
  gfx->fillRect(sx - 42, top + 70, 84, 4, C565(0x7e, 0x28, 0x28));        // costura

  // hit counter
  char buf[8];
  snprintf(buf, sizeof(buf), "%u", sackHits);
  gfx->setTextColor(ink);
  gfx->setTextSize(6);
  gfx->setCursor(CX - strlen(buf) * 18, 268);
  gfx->print(buf);

  gfx->setTextSize(2);
  gfx->setCursor(CX - strlen(T(S_HIT_FAST)) * 6, 322);
  gfx->print(T(S_HIT_FAST));

  // time bar
  uint32_t left = sackUntil - now;
  int bw = 280, fw = (int)((uint32_t)bw * left / 10000);
  gfx->fillRoundRect(CX - bw / 2, 350, bw, 16, 5, UI_TRACK);
  if (fw > 2) gfx->fillRoundRect(CX - bw / 2, 350, fw, 16, 5, UI_BAR_OK);

  gfx->flush();
}

// mini-game background: the creature's habitat (sky by hour + the biome's ground)
void drawGameScene() {
  int hh = sceneHour();
  bool night = hh < 6 || hh >= 20;
  uint16_t top, bot;
  if (night)       { top = C565(0x0c, 0x12, 0x24); bot = C565(0x1e, 0x26, 0x46); }
  else if (hh < 8) { top = C565(0xd1, 0x6a, 0x86); bot = C565(0xf3, 0xb8, 0x7c); }
  else if (hh < 18){ top = C565(0x8f, 0xc8, 0xea); bot = C565(0xdc, 0xee, 0xe6); }
  else             { top = C565(0xc7, 0x5a, 0x4a); bot = C565(0xf0, 0xae, 0x64); }
  int hor = 376;
  for (int y = 0; y < hor; y += 8)
    gfx->fillRect(0, y, 466, 8, lerp565(top, bot, y, hor));
  if (night)
    for (auto &st : STARS) gfx->fillRect(st[0], st[1], 4, 4, UI_WHITE);
  uint8_t bio = pet.isEgg() ? 0 : dexBiome(pet.speciesId);
  uint16_t soil = BIOME_SOIL[bio < 6 ? bio : 0];
  if (night) soil = lerp565(soil, C565(0x16, 0x1c, 0x30), 9, 16);
  gfx->fillRect(0, hor, 466, 466 - hor, soil);
}

void renderGame() {
  // no fillScreen(BLACK): drawGameScene covers the full 466x466. If the
  // previous flush's DMA is still reading the buffer, it sees valid content (not
  // half-drawn black), which was the flicker at 25 fps.
  bool night = sceneHour() < 6 || sceneHour() >= 20;
  uint16_t ink = night ? UI_INK_NIGHT : UI_INK;

  if (gameOverUntil) {
    drawGameScene();
    if (millis() > gameOverUntil) {
      gameOpen = false;
      return;
    }
    char buf[22];
    snprintf(buf, sizeof(buf), T(S_SCORE_FMT), gameScore);
    gfx->setTextColor(ink);
    gfx->setTextSize(4);
    gfx->setCursor(CX - strlen(buf) * 12, 160);
    gfx->print(buf);
    gfx->setTextSize(2);
    if (gameNewHi && gameScore > 0) {
      gfx->setTextColor(UI_BAR_WARN);
      gfx->setCursor(CX - strlen(T(S_NEW_RECORD)) * 6, 214);
      gfx->print(T(S_NEW_RECORD));
    } else {
      char rec[20];
      snprintf(rec, sizeof(rec), T(S_RECORD_FMT), pet.gameHi);
      gfx->setTextColor(ink);
      gfx->setCursor(CX - strlen(rec) * 6, 214);
      gfx->print(rec);
    }
    const char *msg = gameScore >= 10 ? T(S_GREAT_JOY) : T(S_PLUS_JOY);
    gfx->setTextColor(ink);
    gfx->setCursor(CX - strlen(msg) * 6, 250);
    gfx->print(msg);
    gfx->flush();
    return;
  }

  drawGameScene();
  stepGame();

  // score, record and lives
  char buf[8];
  snprintf(buf, sizeof(buf), "%u", gameScore);
  gfx->setTextColor(ink);
  gfx->setTextSize(4);
  gfx->setCursor(CX - strlen(buf) * 12, 30);
  gfx->print(buf);
  char rec[12];
  snprintf(rec, sizeof(rec), T(S_REC_FMT), pet.gameHi);
  gfx->setTextSize(2);
  gfx->setCursor(CX - strlen(rec) * 6, 76);
  gfx->print(rec);
  for (int i = 0; i < 3; i++) {
    if (i < 3 - gameMisses) gfx->fillCircle(180 + i * 28, 104, 6, UI_BAR_BAD);
    else gfx->drawCircle(180 + i * 28, 104, 6, UI_TRACK);
  }
  // The clock, drawn like the bag's and the reaction test's so all three games
  // read the same way. Thin and near the rim: the middle belongs to the ball.
  if (!gameOverUntil) {
    uint32_t now2 = millis();
    uint32_t left = (gameUntil > now2) ? gameUntil - now2 : 0;
    int bw = 200, fw = (int)((uint32_t)bw * left / GAME_MS);
    gfx->fillRoundRect(CX - bw / 2, 124, bw, 10, 4, UI_TRACK);
    if (fw > 2)
      gfx->fillRoundRect(CX - bw / 2, 124, fw, 10, 4,
                         left < 5000 ? UI_BAR_WARN : UI_BAR_OK);
  }

  if (pmd.loaded) {
    uint8_t act = (ballX > gamePetX + 4) ? PMD_WALKR : (ballX < gamePetX - 4) ? PMD_WALKL : PMD_IDLE;
    if (!pmd.has(act)) act = PMD_IDLE;
    drawPmdAct(act, (int)gamePetX, 394, millis(), true, false, 3);
  } else if (mon.loaded) {
    int s = (mon.h * 2 > 130) ? 1 : 2;
    int w = mon.w * s, h = mon.h * s;
    uint16_t fm = mon.frameMs ? mon.frameMs : 100;
    uint16_t fi = (millis() / fm) % mon.frames;
    const uint8_t *fr = mon.data + (uint32_t)fi * mon.w * mon.h;
    int px = (int)gamePetX - w / 2, py = 394 - h;
    for (int r = 0; r < mon.h; r++)
      for (int c = 0; c < mon.w; c++) {
        uint8_t idx = fr[r * mon.w + c];
        if (idx == 0xFF) continue;
        gfx->fillRect(px + c * s, py + r * s, s, s, mon.pal[idx]);
      }
  }

  // impact ring that expands and fades (soft feedback for the hit)
  uint32_t ht = millis() - hitTime;
  if (hitTime && ht < 260) {
    int rad = 22 + (int)(ht / 6);
    gfx->drawCircle((int)hitX, (int)hitY, rad, C565(0xff, 0xe7, 0x9f));
    gfx->drawCircle((int)hitX, (int)hitY, rad - 2, C565(0xff, 0xd9, 0x8a));
  }

  // the ball
  drawMap(SPR_ICON_PLAY, 16, (int)ballX - 24, (int)ballY - 24, 3, false);

  gfx->flush();
}

// ---------- the creature's card (vertical swipe) ----------

// one row of the card: label, bar, value and (if iv != IV_NONE) the
// individual value that sets that stat's ceiling
// (no default argument: Arduino's prototype generator drops them
// and calls that omit it would not compile)
#define IV_NONE 0xFF
void drawCardStat(int y, const char *label, uint16_t val, uint16_t maxBar,
                  uint16_t color, uint8_t iv) {
  gfx->setTextColor(UI_INK);
  gfx->setTextSize(2);
  gfx->setCursor(70, y);
  gfx->print(label);
  // The bar used to start at 112, which leaves 42px for a label drawn at size 2
  // -- three characters. BOND (EN), LIEN (FR) and LACO (PT) are four, so the
  // label ran under the bar. 132 fits five, with the bar narrowed to keep the
  // number clear of it.
  int bw = 130;
  int fw = (int)val * bw / maxBar;
  if (fw > bw) fw = bw;
  gfx->fillRoundRect(132, y + 2, bw, 11, 3, UI_TRACK);
  if (fw > 2) gfx->fillRoundRect(132, y + 2, fw, 11, 3, color);
  char num[8];
  snprintf(num, sizeof(num), "%u", val);
  gfx->setCursor(272, y);
  gfx->print(num);
  if (iv != IV_NONE) {
    char b[10];
    snprintf(b, sizeof(b), T(S_IV_FMT), iv);
    // a perfect IV is highlighted: it is the lucky roll the player hunts for
    gfx->setTextColor(iv >= 31 ? UI_BAR_WARN : UI_TRACK);
    gfx->setCursor(344, y);
    gfx->print(b);
  }
}

// ---------- on-screen clock setting (swipe down) ----------
// The user sets their LOCAL time by eye; the firmware uses it as is, so
// there is no time zone to manage. Keeps the day (does not break streak/age).

void openClock() {
  uint32_t e = pet.lastSeenEpoch ? pet.lastSeenEpoch : rtcEpoch();
  clockH = (e / 3600) % 24;
  clockM = (e / 60) % 60;
  clockOpen = true;
  clockPage = 0;         // always opens on the clock, never on wherever it was
  resetConfirm = false;  // and never with a wipe half-asked
}

void applyClock() {
  uint32_t base = pet.lastSeenEpoch ? pet.lastSeenEpoch : rtcEpoch();
  uint32_t e = (base / 86400) * 86400 + (uint32_t)clockH * 3600 + (uint32_t)clockM * 60;
  rtcSetEpoch(e);
  pet.setClock(e);
  clockOpen = false;
}

void drawClockBtn(int x, int y, const char *l) {
  gfx->fillRoundRect(x, y, 58, 58, 12, UI_WHITE);
  gfx->drawRoundRect(x, y, 58, 58, 12, UI_INK);
  gfx->setTextColor(UI_INK);
  gfx->setTextSize(4);
  gfx->setCursor(x + 17, y + 15);
  gfx->print(l);
}

// ---------------------------------------------------------------------------
// SETTINGS IS TWO PAGES NOW, and it had to become two.
//
// It was one, and full: the clock took the top half and a single 30 px strip at
// y 296 carried the sound switch, the volume mixer and the language pill across
// 34..432 with nothing between them. There was no room for brightness, let alone
// an in-game reset, and the strip's controls were already only 30 px tall --
// under the finger floor CLAUDE.md section 4 keeps warning about.
//
// It pages through the RIM, like every other paged screen, so no new gesture is
// invented and the arc scrollbar advertises the second page by itself. Splitting
// on the OK button is what makes the split honest: only the TIME needs applying,
// and everything on page 1 takes effect the moment it is touched.
//
// CLOCK_PAGES and clockPage live up with the other screen state, because
// uiRimTarget() reaches them ~900 lines above here.

// Page 1's rows. As wide as the glass allows AT THEIR OWN HEIGHT, the same rule
// gymRowRect() follows -- one width for every row wastes the middle and hangs the
// bottom row's corners off the bezel.
// Its metrics live up with the other layout constants, because uiButtonHeights()
// holds SET_ROW_H to the finger floor ~1700 lines above here.
// The -/+ pair on a stepper row sits at its two ends, so the label and the bar
// own the middle.
#define SET_STEP_W 54

// One answer for where a settings row is, asked by the draw path, the tap path
// and hit_test. Three copies of this arithmetic is how a control ends up
// somewhere its graphic is not.
void setRowRect(int i, int *x, int *y, int *w, int *h) {
  int ry = SET_ROW_Y(i);
  int half = uiSafeHalfWidthFor(ry, ry + SET_ROW_H) - SET_ROW_INSET;
  if (x) *x = CX - half;
  if (y) *y = ry;
  if (w) *w = half * 2;
  if (h) *h = SET_ROW_H;
}
int uiSettingsRowCenterY(int i) { return SET_ROW_Y(i) + SET_ROW_H / 2; }
int uiSettingsRows() { return SET_ROWS; }

// The training menu's geometry and the memory game's pads, published for hit_test
// so it holds them to the finger floor and the round bezel without keeping its own
// copy of either -- a test that restates a layout proves the transcription and
// then drifts from it.
int uiTrainRows() { return TRAIN_ROWS; }
int uiTrainRowH() { return TRAIN_ROW_H; }
int uiTrainRowTop(int i) { return TRAIN_ROW_Y(i); }
int uiTrainPanelTop() { return TRAIN_Y; }
int uiTrainPanelBot() { return TRAIN_Y + TRAIN_H; }
int uiTrainPanelHalfW() { return TRAIN_W / 2; }
int uiMemoPads() { return MEMO_PADS; }
int uiMemoPadR() { return MEMO_R; }

static const char *const LANG_CODES[LANG_COUNT] = { "ES", "EN", "FR", "DE", "IT", "PT" };

// Page 0: the clock. Unchanged, minus the controls that moved to page 1.
static void renderClockTime() {
  gfx->setTextColor(UI_INK);
  gfx->setTextSize(3);
  gfx->setCursor(CX - strlen(T(S_SET_TIME)) * 9, 44);
  gfx->print(T(S_SET_TIME));

  char t[8];
  snprintf(t, sizeof(t), "%02d:%02d", clockH, clockM);
  gfx->setTextSize(7);
  gfx->setCursor(CX - 105, 108);
  gfx->print(t);

  drawClockBtn(104, 190, "-");  // hour -
  drawClockBtn(170, 190, "+");  // hour +
  drawClockBtn(252, 190, "-");  // min -
  drawClockBtn(318, 190, "+");  // min +
  gfx->setTextSize(2);
  gfx->setTextColor(UI_INK_SOFT);
  gfx->setCursor(120, 256);
  gfx->print(T(S_HOUR));
  gfx->setCursor(276, 256);
  gfx->print(T(S_MIN));

  gfx->fillRoundRect(133, 340, 200, 48, 14, UI_BAR_OK);
  gfx->setTextColor(UI_BG_DAY);
  gfx->setTextSize(3);
  gfx->setCursor(CX - 18, 352);
  gfx->print("OK");

  gfx->setTextColor(UI_INK_SOFT);
  gfx->setTextSize(2);
  gfx->setCursor(CX - strlen(T(S_CLOCK_CANCEL)) * 6, 410);
  gfx->print(T(S_CLOCK_CANCEL));
}

// A stepper row: label, a level bar, and -/+ at the two ends. Volume and
// brightness are the same control over different state, so they are drawn by the
// same function -- two copies would drift the moment one of them was retuned.
// `fmt` carries its own %u, so the volume row keeps using the string it always
// had ("VOL %u") rather than needing a bare label added beside it in all six
// languages -- and STRINGS is positional, so every avoidable entry is one fewer
// chance to shift a row.
static void drawStepperRow(int i, const char *fmt, uint8_t v, uint8_t vmax,
                           uint16_t barCol) {
  int rx, ry, rw, rh;
  setRowRect(i, &rx, &ry, &rw, &rh);
  gfx->fillRoundRect(rx, ry, rw, rh, 10, UI_BG_DAY);
  gfx->drawRoundRect(rx, ry, rw, rh, 10, UI_INK);
  for (int b = 0; b < 2; b++) {
    const bool plus = (b != 0);
    const int bx = plus ? rx + rw - SET_STEP_W : rx;
    const bool live = plus ? (v < vmax) : (v > 0);
    gfx->fillRoundRect(bx, ry, SET_STEP_W, rh, 10, live ? UI_WHITE : UI_TRACK);
    gfx->drawRoundRect(bx, ry, SET_STEP_W, rh, 10, UI_INK);
    gfx->setTextColor(live ? UI_INK : 0x8410);
    gfx->setTextSize(3);
    gfx->setCursor(bx + SET_STEP_W / 2 - 8, ry + rh / 2 - 11);
    gfx->print(plus ? "+" : "-");
  }
  const int mid = rx + SET_STEP_W, midW = rw - SET_STEP_W * 2;
  char l[24];
  snprintf(l, sizeof(l), fmt, (unsigned)v);
  gfx->setTextColor(UI_INK);
  gfx->setTextSize(2);
  gfx->setCursor(mid + (midW - (int)strlen(l) * 12) / 2, ry + 6);
  gfx->print(l);
  const int barW = midW - 24;
  gfx->fillRoundRect(mid + 12, ry + rh - 14, barW, 8, 3, UI_TRACK);
  if (v) gfx->fillRoundRect(mid + 12, ry + rh - 14, barW * v / vmax, 8, 3, barCol);
}

// Page 1: everything that takes effect the moment it is touched.
static void renderClockOptions() {
  gfx->setTextColor(UI_INK);
  gfx->setTextSize(3);
  gfx->setCursor(CX - strlen(T(S_SETTINGS)) * 9, 44);
  gfx->print(T(S_SETTINGS));

  int rx, ry, rw, rh;
  // sound: a full-width switch, so the master control is unmissable
  {
    setRowRect(SET_SOUND, &rx, &ry, &rw, &rh);
    const bool snd = audioEnabled();
    const char *sl = snd ? T(S_SND_ON) : T(S_SND_OFF);
    gfx->fillRoundRect(rx, ry, rw, rh, 10, snd ? UI_BAR_OK : UI_WHITE);
    gfx->drawRoundRect(rx, ry, rw, rh, 10, UI_INK);
    gfx->setTextColor(snd ? UI_BG_DAY : UI_INK);
    gfx->setTextSize(2);
    gfx->setCursor(CX - (int)strlen(sl) * 6, ry + rh / 2 - 8);
    gfx->print(sl);
  }
  drawStepperRow(SET_VOL, T(S_VOL_FMT), audioVolume(), 10, UI_BAR_OK);
  drawStepperRow(SET_BRIGHT, T(S_BRIGHT_FMT), gBrightLevel, BRIGHT_LEVELS,
                 UI_BAR_WARN);
  // language: a pill that cycles
  {
    setRowRect(SET_LANG, &rx, &ry, &rw, &rh);
    gfx->fillRoundRect(rx, ry, rw, rh, 10, UI_WHITE);
    gfx->drawRoundRect(rx, ry, rw, rh, 10, UI_INK);
    char lp[24];
    snprintf(lp, sizeof(lp), "%s  %s >", T(S_LANG_LABEL), LANG_CODES[gLang]);
    gfx->setTextColor(UI_INK);
    gfx->setTextSize(2);
    gfx->setCursor(CX - (int)strlen(lp) * 6, ry + rh / 2 - 8);
    gfx->print(lp);
  }
  // reset: drawn as the destructive thing it is, and it only ever OPENS the
  // confirm -- see clockTap()
  {
    setRowRect(SET_RESET, &rx, &ry, &rw, &rh);
    gfx->fillRoundRect(rx, ry, rw, rh, 10, UI_TRACK);
    gfx->drawRoundRect(rx, ry, rw, rh, 10, UI_BAR_BAD);
    gfx->setTextColor(UI_BAR_BAD);
    gfx->setTextSize(2);
    gfx->setCursor(CX - (int)strlen(T(S_RESET)) * 6, ry + rh / 2 - 8);
    gfx->print(T(S_RESET));
  }
}

void renderClock() {
  gfx->fillScreen(RGB565_BLACK);
  gfx->fillCircle(CX, CY, 231, UI_BG_DAY);
  if (clockPage == 0) renderClockTime();
  else renderClockOptions();

  // firmware version (discreet, at the very bottom)
  char ver[20];
  snprintf(ver, sizeof(ver), "TamaDigi v%s", FW_VERSION);
  gfx->setTextColor(UI_INK_SOFT);
  gfx->setTextSize(1);
  gfx->setCursor(CX - (int)strlen(ver) * 3, 436);
  gfx->print(ver);
  // the arc scrollbar and the tile dots, so the second page advertises itself
  uiChrome();
  // Drawn LAST and over everything, because it is modal: while it is up nothing
  // else on the screen responds (clockTap checks it first).
  if (resetConfirm)
    drawConfirmPanel(T(S_RESET_Q), T(S_RESET_COST), nullptr, UI_BAR_BAD,
                     T(S_RESET), UI_BAR_BAD, UI_WHITE, T(S_NO), UI_BAR_OK, UI_WHITE);
  gfx->flush();
}

void clockTap(int16_t x, int16_t y) {
  // MODAL FIRST. The confirm covers the rows underneath it, and its NO button
  // sits over the reset row -- so with the rows tested first, declining the wipe
  // would re-open the very dialog it was declining.
  if (resetConfirm) {
    int c1t, c1b, c2t, c2b;
    uiConfirmRects(&c1t, &c1b, &c2t, &c2b);
    if (x >= CONFIRM_BTN_X && x <= CONFIRM_BTN_X + CONFIRM_BTN_W) {
      if (y >= c1t && y <= c1b) {            // yes, wipe it
        resetConfirm = false;
        // Record the intent, stop anything writing the old creature back, and
        // restart. The wipe itself happens at the top of the next boot, before
        // any of this is loaded again -- see save.h section RESET_NS.
        resetArm();
        saveInhibited = true;
        Serial.println("reset: armed by the player; restarting");
        delay(100);
        ESP.restart();
        return;
      }
      if (y >= c2t && y <= c2b) {            // no
        resetConfirm = false;
        sfxPlay(SFX_TAP);
        return;
      }
    }
    return;      // anything else while it is up does nothing at all
  }

  if (clockPage != 0) {
    for (int i = 0; i < SET_ROWS; i++) {
      int rx, ry, rw, rh;
      setRowRect(i, &rx, &ry, &rw, &rh);
      if (x < rx || x > rx + rw || y < ry || y > ry + rh) continue;
      if (i == SET_SOUND) {
        audioSetEnabled(!audioEnabled());
        if (audioEnabled()) sfxPlay(SFX_TAP);    // confirms at power-on
        return;
      }
      if (i == SET_VOL || i == SET_BRIGHT) {
        const bool minus = (x < rx + SET_STEP_W);
        const bool plus = (x > rx + rw - SET_STEP_W);
        if (!minus && !plus) return;             // the middle is a readout
        if (i == SET_VOL) {
          uint8_t v = audioVolume();
          if (plus && v < 10) audioSetVolume(v + 1);
          else if (minus && v > 0) audioSetVolume(v - 1);
          sfxPlay(SFX_TAP);                      // so the new level is audible
        } else {
          // 1, not 0: see brightBase(). A settings screen that could reach a
          // black panel would leave no visible way back from it.
          if (plus) brightSetLevel(gBrightLevel + 1);
          else if (gBrightLevel > 1) brightSetLevel(gBrightLevel - 1);
          sfxPlay(SFX_TAP);
        }
        return;
      }
      if (i == SET_LANG) {
        setLang((Lang)((gLang + 1) % LANG_COUNT));
        sfxPlay(SFX_TAP);
        return;
      }
      if (i == SET_RESET) {                      // ASKS. Always.
        resetConfirm = true;
        sfxPlay(SFX_DENY);
        return;
      }
    }
    return;
  }

  if (y >= 190 && y <= 248) {  // row of +/- buttons
    if (x >= 104 && x < 162) clockH = (clockH + 23) % 24;
    else if (x >= 170 && x < 228) clockH = (clockH + 1) % 24;
    else if (x >= 252 && x < 310) clockM = (clockM + 59) % 60;
    else if (x >= 318 && x < 376) clockM = (clockM + 1) % 60;
    return;
  }
  if (y >= 340 && y <= 388 && x >= 133 && x <= 333) { applyClock(); return; }
}

// flame + streak number at the top left
void drawStreakBadge() {
  if (pet.streak < 1) return;
  int x = 26, y = 16;
  gfx->fillTriangle(x + 8, y, x + 1, y + 17, x + 15, y + 17, UI_BAR_BAD);
  gfx->fillTriangle(x + 8, y + 7, x + 4, y + 17, x + 12, y + 17, UI_BAR_WARN);
  char s[6];
  snprintf(s, sizeof(s), "%u", pet.streak);
  gfx->setTextColor(inkColor());
  gfx->setTextSize(2);
  gfx->setCursor(x + 22, y + 2);
  gfx->print(s);
}

// temporary banner: new medal or streak milestone
void drawCelebration() {
  const char *l1 = nullptr, *l2 = nullptr;
  char buf[20];
  if (pet.showMedal()) {
    for (int i = 0; i < MED_COUNT; i++)
      if (pet.newMedal & (1 << i)) { l2 = medalName(i); break; }
    l1 = T(S_MEDAL_BANNER);
  } else if (pet.showMilestone()) {
    snprintf(buf, sizeof(buf), T(S_STREAK_DAYS_FMT), pet.streak);
    l1 = T(S_GREAT);
    l2 = buf;
  }
  if (!l1) return;
  gfx->fillRoundRect(73, 150, 320, 96, 16, UI_BAR_WARN);
  gfx->drawRoundRect(73, 150, 320, 96, 16, UI_INK);
  gfx->setTextColor(UI_INK);
  gfx->setTextSize(3);
  gfx->setCursor(CX - strlen(l1) * 9, 176);
  gfx->print(l1);
  gfx->setTextSize(2);
  gfx->setCursor(CX - strlen(l2) * 6, 212);
  gfx->print(l2);
}

// medals on the card: badge with a label, coloured if earned
void drawMedalBadge(int x, int y, int i) {
  bool got = pet.hasMedal(1 << i);
  gfx->fillRoundRect(x, y, 100, 24, 6, got ? UI_BAR_OK : UI_TRACK);
  if (!got) gfx->drawRoundRect(x, y, 100, 24, 6, UI_TRACK);
  gfx->setTextColor(got ? UI_BG_DAY : 0x9492);
  gfx->setTextSize(2);
  gfx->setCursor(x + (100 - (int)strlen(medalLabel(i)) * 12) / 2, y + 5);
  gfx->print(medalLabel(i));
}

// pagina 0: perfil (retrato grande, identidad, racha, vinculo, baya)
void renderCardProfile() {
  const TsDexEntry &d = TS_DEX_TBL[pet.speciesId];
  const char *nm = pet.nick[0] ? pet.nick : d.name;
  char head[26];
  snprintf(head, sizeof(head), T(S_NAME_FMT), pet.variant ? "*" : "", nm, pet.level());
  gfx->setTextColor(dexAccent(pet.speciesId));
  // auto-shrink: at size 3 long names do not fit the narrow strip at the
  // top of the round screen, so they were cut off at the edge
  int hlen = strlen(head);
  int hts = (hlen <= 11) ? 3 : 2;
  gfx->setTextSize(hts);
  gfx->setCursor(CX - hlen * (hts == 3 ? 9 : 6), hts == 3 ? 34 : 40);
  gfx->print(head);
  // the stage, under the name (and the real Digimon under a nickname)
  {
    char sub[40];
    const char *stage = T((StrId)(S_STAGE_0 + (d.stage % STAGE_COUNT)));
    if (pet.nick[0]) snprintf(sub, sizeof(sub), "%s - %s", d.name, stage);
    else snprintf(sub, sizeof(sub), "%s", stage);
    gfx->setTextColor(UI_INK_SOFT);
    gfx->setTextSize(2);
    gfx->setCursor(CX - (int)strlen(sub) * 6, 64);
    gfx->print(sub);
  }

  // retrato grande animado
  if (pmd.loaded) drawPmdAct(PMD_IDLE, CX, 212, millis(), true, false, 3);

  // streak with flame
  int sx = 138, sy = 224;
  gfx->fillTriangle(sx + 8, sy, sx + 1, sy + 18, sx + 15, sy + 18, UI_BAR_BAD);
  gfx->fillTriangle(sx + 8, sy + 7, sx + 4, sy + 18, sx + 12, sy + 18, UI_BAR_WARN);
  char rl[30];
  snprintf(rl, sizeof(rl), T(S_STREAK_FMT), pet.streak, pet.bestStreak);
  gfx->setTextColor(UI_INK);
  gfx->setTextSize(2);
  gfx->setCursor(sx + 24, sy + 2);
  gfx->print(rl);

  drawCardStat(258, T(S_VIN), pet.bond, 100, C565(0xd4, 0x52, 0x7e), IV_NONE);

  const char *berry = !pet.berryKnown ? T(S_BERRY_UNK)
                      : pet.lovesBerry(0) ? T(S_BERRY_RED)
                      : pet.lovesBerry(1) ? T(S_BERRY_BLUE)
                                          : T(S_BERRY_GREEN);
  char info[40];
  snprintf(info, sizeof(info), T(S_INFO_FMT), berry,
           (unsigned long)(pet.ageMinutes / 1440));
  gfx->setTextColor(UI_INK);
  gfx->setTextSize(2);
  gfx->setCursor(CX - strlen(info) * 6, 296);
  gfx->print(info);

  // Its temperament, beside the food it likes -- the other thing about this
  // individual that is true from the moment it hatches and never changes. Derived
  // from the IVs, so it costs the save nothing; see Pet::personality().
  gfx->setTextColor(dexAccent(pet.speciesId));
  gfx->setTextSize(2);
  gfx->setCursor(CX - (int)strlen(personalityName()) * 6, 320);
  gfx->print(personalityName());

  gfx->setTextColor(UI_INK_SOFT);
  gfx->setTextSize(1);
  gfx->setCursor(CX - strlen(T(S_RENAME_HINT)) * 3, 346);
  gfx->print(T(S_RENAME_HINT));
}

// page 1: battle (4 bars + train button)
void renderCardStats() {
  gfx->setTextColor(UI_INK);
  gfx->setTextSize(3);
  gfx->setCursor(CX - strlen(T(S_BATTLE)) * 9, 44);
  gfx->print(T(S_BATTLE));

  // its element, in its accent colour (English in every language, same as the
  // Digimon names themselves), and its attribute: the two things a matchup turns on
  const int16_t dex = pet.speciesId;
  const TsDexEntry &de = TS_DEX_TBL[dex];
  char ty[32];
  snprintf(ty, sizeof(ty), "%s / %s", typeName(homeElement(dex)), attrName(de.attr));
  gfx->setTextColor(dexAccent(dex));
  gfx->setTextSize(2);
  gfx->setCursor(CX - (int)strlen(ty) * 6, 76);
  gfx->print(ty);

  // bar maximum 360: untrained, nothing passes HP 390 and most stats sit under 200,
  // and training only counts while it stays on the scale.
  drawCardStat(104, T(S_STAT_ATK), pet.atkStat(), 360, UI_BAR_BAD, pet.ivAtk);
  drawCardStat(144, T(S_STAT_DEF), pet.defStat(), 360, 0x4C98, pet.ivDef);
  drawCardStat(184, T(S_STAT_SPE), pet.speStat(), 360, UI_BAR_WARN, pet.ivSpe);
  drawCardStat(224, T(S_STAT_VIT), pet.vitStat(), 360, UI_BAR_OK, pet.ivHp);
  drawCardStat(264, T(S_STAT_WGT), pet.weight, 100, 0xB3C8, IV_NONE);

}

// Draws one move as a row: name, its type in the type's own colour, and either
// power or a STATUS marker. Shared by the moves page and the picker so a move
// looks the same wherever you meet it.
// A filled chip in the type's own colour, label in whichever of black/white
// reads on it. Returns its width so a caller can lay out beside it.
int drawTypeChip(int x, int y, uint8_t type) {
  const char *nm = typeName(type);
  int w = (int)strlen(nm) * 6 + 10;
  gfx->fillRoundRect(x, y, w, 15, 4, typeColor(type));
  gfx->setTextSize(1);
  gfx->setTextColor(typeColorIsLight(type) ? UI_INK : UI_WHITE);
  gfx->setCursor(x + 5, y + 4);
  gfx->print(nm);
  return w;
}

// A skill's name in a box `w` px wide: size 2 when it fits, else size 1, and broken at
// a space into two lines when even that does not (names run to 30 characters).
// Returns nothing to lay out around: both forms stay inside `h` px of height.
static void drawSkillName(int x, int y, int w, int h, const char *name) {
  const int len = (int)strlen(name);
  gfx->setTextSize(len * 12 <= w ? 2 : 1);
  if (len * 12 <= w) { gfx->setCursor(x, y); gfx->print(name); return; }
  if (len * 6 <= w) { gfx->setCursor(x, y + 3); gfx->print(name); return; }
  char first[32];
  int cut = w / 6 < len ? w / 6 : len;
  while (cut > 0 && name[cut] != ' ') cut--;
  if (cut <= 0) cut = w / 6;
  if (cut >= (int)sizeof(first)) cut = sizeof(first) - 1;
  memcpy(first, name, cut);
  first[cut] = 0;
  gfx->setCursor(x, y);
  gfx->print(first);
  gfx->setCursor(x, y + h / 2);
  gfx->print(name + cut + (name[cut] == ' ' ? 1 : 0));
}

void drawMoveRow(int y, uint16_t mv, bool highlight, int16_t dex) {
  gfx->fillRoundRect(70, y, 326, 50, 12, highlight ? UI_BAR_WARN : UI_BG_DAY);
  gfx->drawRoundRect(70, y, 326, 50, 12, UI_INK);
  if (!mv) {
    gfx->setTextColor(UI_INK_SOFT);
    gfx->setTextSize(2);
    gfx->setCursor(CX - (int)strlen(T(S_MOVE_EMPTY)) * 6, y + 17);
    gfx->print(T(S_MOVE_EMPTY));
    return;
  }
  const TsSkill &m = skillEntry(mv);
  gfx->setTextColor(UI_INK);
  drawSkillName(82, y + 8, 302, 16, moveName(mv));
  // Colouring same-element skills in the Digimon's accent marks the ones that hit
  // hardest for this creature: the bonus is x1.5. The chip carries the ELEMENT; the
  // bonus sits on the power figure, where it belongs -- it is a damage bonus, so
  // saying it next to the damage reads straight.
  const bool support = m.cat == TS_SC_SUPPORT;
  bool stab = !support && hasStab(dex, m.element);
  int cw = support ? 0 : drawTypeChip(82, y + 29, m.element);
  if (stab) {
    gfx->setTextColor(dexAccent(dex));
    gfx->setTextSize(1);
    gfx->setCursor(82 + cw + 6, y + 33);
    gfx->print("SAME");
  }
  char pw[20];
  if (support) snprintf(pw, sizeof(pw), "%s", T(S_MOVE_STATUS));
  else if (m.hits > 1) snprintf(pw, sizeof(pw), "%ux%u", (unsigned)skillPower(mv, pet.level()), (unsigned)m.hits);
  else snprintf(pw, sizeof(pw), T(S_MOVE_PWR), (unsigned)skillPower(mv, pet.level()));
  gfx->setTextColor(stab ? dexAccent(dex) : UI_INK);
  gfx->setTextSize(1);
  gfx->setCursor(384 - (int)strlen(pw) * 6, y + 33);
  gfx->print(pw);
}

// card page 4: the four known moves. Tapping a slot opens the picker.
void renderCardMoves() {
  gfx->setTextColor(UI_INK);
  gfx->setTextSize(3);
  gfx->setCursor(CX - strlen(T(S_MOVES)) * 9, 44);
  gfx->print(T(S_MOVES));
  for (int i = 0; i < MOVE_SLOTS; i++) drawMoveRow(MOVE_ROW_Y(i), pet.moves[i], false, pet.speciesId);
  gfx->setTextColor(UI_INK_SOFT);
  gfx->setTextSize(1);
  gfx->setCursor(CX - (int)strlen(T(S_MOVE_TAP)) * 3, 340);
  gfx->print(T(S_MOVE_TAP));
}

// What a form offers `hours` after becoming it: its specials and the attachment
// skills unlocked so far. Skills are not remembered once dropped, so this is the
// whole of what a slot can be swapped for, beside the other slots.
uint8_t learnableFor(int16_t dex, uint8_t hours, uint16_t *out, uint8_t max) {
  if (!dexValid(dex)) return 0;
  const TsDexEntry &d = TS_DEX_TBL[dex];
  uint8_t w = 0;
  for (uint8_t i = 0; i < d.learnCount && w < max; i++) {
    const TsLearn &l = TS_LEARN_TBL[d.learnFirst + i];
    if (l.hours > hours) break;
    bool dup = false;
    for (uint8_t j = 0; j < w; j++)
      if (out[j] == l.skill) { dup = true; break; }
    if (!dup) out[w++] = l.skill;
  }
  return w;
}

// The picker's list: the partner's current slots, then what its form offers. A skill
// carried over from another form stays listed, or moving it to another slot would
// be impossible and swapping it out would look like the only choice.
uint8_t learnableList(uint16_t *out, uint8_t max) {
  if (pet.isEgg()) return 0;
  uint8_t w = 0;
  for (uint8_t i = 0; i < MOVE_SLOTS && w < max; i++)
    if (pet.moves[i]) out[w++] = pet.moves[i];
  uint16_t offered[MOVE_PICK_MAX];
  const uint8_t n = learnableFor(pet.speciesId, pet.formHours(), offered, MOVE_PICK_MAX);
  for (uint8_t i = 0; i < n && w < max; i++) {
    bool dup = false;
    for (uint8_t j = 0; j < w; j++)
      if (out[j] == offered[i]) { dup = true; break; }
    if (!dup) out[w++] = offered[i];
  }
  return w;
}

uint16_t *pickTargetMoves() { return pet.moves; }
int16_t pickTargetDex() { return pet.speciesId; }

void renderMovePick() {
  gfx->fillScreen(RGB565_BLACK);
  gfx->fillCircle(CX, CY, 231, UI_BG_DAY);
  gfx->setTextColor(UI_INK);
  gfx->setTextSize(2);
  gfx->setCursor(CX - strlen(T(S_MOVE_PICK)) * 6, 40);
  gfx->print(T(S_MOVE_PICK));

  uint16_t all[MOVE_PICK_MAX];
  uint8_t n = learnableList(all, MOVE_PICK_MAX);
  uint8_t pages = n ? (n + MOVE_PICK_PER_PAGE - 1) / MOVE_PICK_PER_PAGE : 1;
  if (movePickPage >= pages) movePickPage = 0;
  for (uint8_t i = 0; i < MOVE_PICK_PER_PAGE; i++) {
    uint8_t idx = movePickPage * MOVE_PICK_PER_PAGE + i;
    if (idx >= n) break;
    // the move already in this slot is highlighted, so replacing like for like
    // is obvious rather than a guess
    drawMoveRow(MOVE_PICK_Y(i), all[idx], all[idx] == pickTargetMoves()[movePickSlot], pickTargetDex());
  }
  for (uint8_t i = 0; i < pages && pages > 1; i++) {
    if (i == movePickPage) gfx->fillCircle(CX - (pages - 1) * 13 + i * 26, 380, 5, UI_INK);
    else gfx->drawCircle(CX - (pages - 1) * 13 + i * 26, 380, 4, UI_INK);
  }
  gfx->setTextColor(UI_INK_SOFT);
  gfx->setTextSize(2);
  gfx->setCursor(CX - strlen(T(S_BACK)) * 6, 402);
  gfx->print(T(S_BACK));
  gfx->flush();
}

// ---------- battle ----------

// Draws a battle backdrop scaled 2x. Emitted as runs of identical indices
// rather than a write per pixel: this is flat pixel art with long horizontal
// runs, and 240x112 at 2x would otherwise be 26,880 fillRect calls a frame.
// The round bezel crops the overhang physically, so nothing is clipped here.
static void drawBack(const BackScene &b, int y0) {
  const int SC = 2;
  int x0 = CX - (b.w * SC) / 2;
  for (int r = 0; r < b.h; r++) {
    const uint8_t *row = b.idx + (uint32_t)r * b.w;
    int c = 0;
    while (c < b.w) {
      uint8_t v = row[c];
      int run = 1;
      while (c + run < b.w && row[c + run] == v) run++;
      uint16_t col = b.pal[v];
      gfx->fillRect(x0 + c * SC, y0 + r * SC, run * SC, SC, col);
      c += run;
    }
  }
}

// Which scene: the FOE's biome, since a battle happens where it lives, and the
// same day/night split the main screen already uses.
static void drawBattleBack() {
  int16_t dex = btlFoe.dex;
  if (dex < 1 || dex > DEX_COUNT) { gfx->fillCircle(CX, CY, 231, UI_BG_DAY); return; }
  uint8_t bi = dexBiome(dex);
  if (bi >= BACK_BIOMES) bi = 0;
  bool night = sceneHour() < 6 || sceneHour() >= 20;
  drawBack(BACKS[bi][night ? 1 : 0], 30);
}

// Streams a side's sprite if it is not already the one loaded. Called whenever
// a creature steps in, never per frame.
static void btlSyncSprite(uint8_t who, const Combatant &c) {
  int16_t key = c.dex * (c.variant ? -1 : 1);
  if (btlPmdDex[who] == key && btlPmd[who].loaded) return;
  btlPmd[who].unload();
  btlPmdDex[who] = 0;
  if (c.dex < 1 || c.dex > DEX_COUNT) return;
  if (btlPmd[who].load(c.dex, c.variant)) btlPmdDex[who] = key;   // NOT (uint8_t): the dex runs past 2555
}

static void btlFreeSprites() {
  for (int i = 0; i < 2; i++) { btlPmd[i].unload(); btlPmdDex[i] = 0; }
}

static void btlSay(const char *fmt, ...) {
  if (btlMsgCount >= 6) return;
  va_list ap;
  va_start(ap, fmt);
  vsnprintf(btlMsg[btlMsgCount], sizeof(btlMsg[0]), fmt, ap);
  va_end(ap);
  btlMsgCount++;
}

// Turns a TurnLog into narration. Everything here was already decided by the
// engine -- nothing is recomputed, so the text can never disagree with the maths.
// Picks the cue for an action from the TurnLog, so the sound can never
// disagree with what actually happened.
static void btlSfxFor(const TurnLog &lg) {
  if (lg.targetFainted) { sfxPlay(SFX_FAINT); return; }
  if (lg.inflicted) { sfxPlay(SFX_STATUS); return; }
  if (lg.damage && lg.effPct > 100) { sfxPlay(SFX_SUPER); return; }
  if (lg.damage) {
    sfxPlay(lg.move && skillEntry(lg.move).cat == TS_SC_MAGIC ? SFX_BEAM : SFX_HIT);
    return;
  }
  if (lg.move && skillEntry(lg.move).cat == TS_SC_SUPPORT && !lg.missed) sfxPlay(SFX_STATUS);
}

static void btlNarrate(const Combatant &actor, const Combatant &target, const TurnLog &lg) {
  if (lg.skipped || (!lg.move && !lg.hurtSelf && !lg.damage)) return;
  btlSfxFor(lg);
  if (lg.hurtSelf) { btlSay(T(S_BTL_HURTSELF)); return; }
  if (lg.move) btlSay(T(S_BTL_USED), actor.name, moveName(lg.move));
  if (lg.missed) { btlSay(T(S_BTL_MISS), actor.name); return; }
  if (lg.immune) { btlSay(T(S_BTL_IMMUNE)); return; }
  if (lg.crit) btlSay(T(S_BTL_CRIT));
  if (lg.damage && lg.effPct > 100) btlSay(T(S_BTL_SUPER));
  else if (lg.damage && lg.effPct < 100) btlSay(T(S_BTL_WEAK));
  if (lg.inflicted) {
    static const StrId AIL_STR[] = { S_AIL_PARA, S_AIL_PARA, S_AIL_BURN, S_AIL_POISON,
                                     S_AIL_SLEEP, S_AIL_FREEZE, S_AIL_CONFUSE };
    if (lg.inflicted < 7) btlSay(T(S_BTL_STATUS), target.name, T(AIL_STR[lg.inflicted]));
  }
  if (lg.targetFainted) btlSay(T(S_BTL_FAINT), target.name);
}

// Builds one opponent through Pet, so it gets the same stat formula and the
// same learnset-driven skills the player's creatures do. IVs no longer touch a stat,
// so a Hard boss differs by its AI until phase 2 brings Hard mode's level rule.
static void foeFromSpecies(Combatant &c, int16_t dex, uint8_t lvl, bool variant) {
  Pet foe;
  foe.dbgHatchAs(dex, variant);
  foe.ageMinutes = (uint32_t)(lvl ? lvl - 1 : 0) * MINUTES_PER_LEVEL;
  foe.relearnFromLevel();
  combatantFromPet(c, foe);
}

// Your side: the partner, and only the partner. Every battle is 1-on-1.
//
// The boss ladder caps your LEVEL to the boss's, so a boss is always fought on
// its own terms and grinding is never the answer -- the matchups, the skills
// and the choices are. The cap is applied while BUILDING the combatant, so
// nothing is ever written back to the live pet, exactly like ailments.
static bool buildPartner(uint8_t maxLvl) {
  if (pet.isEgg()) return false;
  combatantFromPet(btlYou, pet, maxLvl);
  return true;
}

// A fight against another device. Each side's partner is already exchanged; the
// host owns resolution and the guest renders what it is sent.
void startLinkBattle() {
  if (!lan.mineN || !lan.theirsN) return;
  // Rebuilt from lan.mine, NOT from the live pet. What we fight with has to be
  // exactly what the peer was told we have.
  linkMonTo(btlYou, lan.mine[0]);
  btlLink = true;
  btlLinkHost = lan.isHost;
  btlWild = false;
  btlTrainer = -1;
  btlHard = false;
  linkMonTo(btlFoe, lan.theirs[0]);
  btlMyAct = 0;
  btlMsgCount = 0;
  btlOver = false;
  btlWon = false;
  btlMenu = 0;
  btlWinUntil = 0;
  btlFaintUntil[0] = btlFaintUntil[1] = 0;
  btlHpShown[0] = btlYou.maxHp;
  btlHpShown[1] = btlFoe.maxHp;
  btlSyncSprite(0, btlYou);
  btlSyncSprite(1, btlFoe);
  audioMusic(MUS_BATTLE);
  battleOpen = true;
}

void startTrainerBattle(uint8_t idx, bool hard) {
  if (idx >= TRAINER_COUNT || pet.isEgg() || pet.ceremony != CER_NONE) return;
  const Trainer &boss = TRAINERS[idx];
  // The gate the wild has too: a boss that cannot be drawn would open the fight with
  // a bare dex number where a creature should be.
  if (!speciesShowable((int16_t)boss.dex)) return;
  // BOTH difficulties cap your level to the boss's. Without it a L73 partner
  // walks every tamer at 100% and the matchups never matter. Hard adds a
  // smarter AI.
  if (!buildPartner(boss.level)) return;
  btlTrainer = (int8_t)idx;
  btlHard = hard;
  btlWild = false;
  foeFromSpecies(btlFoe, boss.dex, boss.level, false);
  btlMsgCount = 0;
  btlOver = false;
  btlWon = false;
  btlMenu = 0;
  btlWinUntil = 0;
  btlFaintUntil[0] = btlFaintUntil[1] = 0;
  btlHpShown[0] = btlYou.maxHp;
  btlHpShown[1] = btlFoe.maxHp;
  btlSyncSprite(0, btlYou);
  btlSyncSprite(1, btlFoe);
  audioMusic(MUS_BATTLE);
  btlLungeUntil[0] = btlLungeUntil[1] = 0;
  btlHitUntil[0] = btlHitUntil[1] = 0;
  battleOpen = true;
}

void startBattle(int16_t dex, uint8_t lvl) {
  if (pet.isEgg() || pet.ceremony != CER_NONE) return;
  if (dex < 1 || dex > DEX_COUNT) return;
  if (!buildPartner(0)) return;
  foeFromSpecies(btlFoe, dex, lvl, false);
  btlWild = false;
  btlMsgCount = 0;
  btlOver = false;
  btlWon = false;
  btlMenu = 0;
  btlWinUntil = 0;
  btlFaintUntil[0] = btlFaintUntil[1] = 0;
  btlHpShown[0] = btlYou.maxHp;
  btlHpShown[1] = btlFoe.maxHp;
  btlSyncSprite(0, btlYou);
  btlSyncSprite(1, btlFoe);
  audioMusic(MUS_BATTLE);
  btlLungeUntil[0] = btlLungeUntil[1] = 0;
  btlHitUntil[0] = btlHitUntil[1] = 0;
  battleOpen = true;
}

// The guest's whole turn: copy in what the host resolved and play the same
// animations the host is playing. It runs no battle logic at all -- that is the
// entire point of one side being authoritative (see link.h).
static void btlApplyResult() {
  if (lan.resultN < sizeof(LinkResult)) { lan.resultNew = false; return; }
  LinkResult r;
  memcpy(&r, lan.result, sizeof(r));
  lan.resultNew = false;

  // The wire says "host"/"guest"; here we are always the guest, so their fields
  // are the foe's and ours are ours.
  uint32_t now = millis();
  btlYou.hp = r.guestHp > btlYou.maxHp ? btlYou.maxHp : r.guestHp;
  btlFoe.hp = r.hostHp > btlFoe.maxHp ? btlFoe.maxHp : r.hostHp;
  btlYou.ailment = r.guestAil;
  btlFoe.ailment = r.hostAil;

  btlMsgCount = 0;
  if (r.hostMove) btlSay(T(S_BTL_USED), btlFoe.name, moveName(r.hostMove));
  if (r.guestMove) btlSay(T(S_BTL_USED), btlYou.name, moveName(r.guestMove));
  if (r.guestDmg) { btlHitUntil[0] = now + BTL_HIT_MS; sfxPlay(SFX_HIT); }
  if (r.hostDmg) { btlHitUntil[1] = now + BTL_HIT_MS; sfxPlay(SFX_HIT); }
  if (btlYou.fainted()) {
    btlFaintUntil[0] = now + BTL_FAINT_MS;
    btlSay(T(S_BTL_FAINT), btlYou.name);
  }
  if (btlFoe.fainted()) {
    btlFaintUntil[1] = now + BTL_FAINT_MS;
    btlSay(T(S_BTL_FAINT), btlFoe.name);
  }
}

// Radio packets land on another task, so the guest picks them up here, once a
// frame, rather than rendering from inside an interrupt.
static void btlLinkPoll() {
  if (!btlLink) return;

  // A peer that stopped answering. Ending the fight is the only honest thing to
  // do -- there is no result coming, and pretending otherwise is the hang this
  // whole layer exists to remove.
  if (!lan.live() && !btlOver) {
    btlOver = true;
    btlWon = false;
    audioMusic(MUS_NONE);
    btlMsgCount = 0;
    btlSay("%s", T(S_LAN_GONE));
    return;
  }

  if (btlLinkHost) {
    // Our own action was latched when it was tapped; theirs arrives whenever
    // the radio manages it. Whichever is second sets the turn going.
    if (btlMyAct && lan.hasPeerAct() && !btlOver && !btlMsgCount) {
      uint8_t act = btlMyAct;
      btlMyAct = 0;
      btlResolve(linkActMove(btlYou, act));
    }
    return;
  }

  if (lan.resultNew) btlApplyResult();
  if (lan.state == LINK_DONE && !btlOver) {
    btlOver = true;
    btlWon = lan.youWon;
    audioMusic(btlWon ? MUS_VICTORY : MUS_NONE);
    if (btlWon) sfxPlay(SFX_VICTORY);
    btlSay("%s", btlWon ? T(S_BTL_WIN) : T(S_BTL_LOSE));
  }
}

// Packs the outcome for the guest. Only the host ever calls this.
static void btlShipResult(uint16_t yourMove, uint16_t theirMove,
                          uint16_t hp0You, uint16_t hp0Foe) {
  LinkResult r = {};
  r.hostHp = btlYou.hp;   r.guestHp = btlFoe.hp;
  r.hostAil = btlYou.ailment; r.guestAil = btlFoe.ailment;
  r.hostMove = yourMove;  r.guestMove = theirMove;
  r.hostDmg = (hp0You > btlYou.hp) ? hp0You - btlYou.hp : 0;
  r.guestDmg = (hp0Foe > btlFoe.hp) ? hp0Foe - btlFoe.hp : 0;
  if (btlYou.fainted() || btlFoe.fainted()) r.flags |= 0x04;
  lan.sendResult((const uint8_t *)&r, (uint8_t)sizeof(r));
}

// ---------- wild battle actions ----------

// What beating a wild creature is worth. Each draw EXCLUDES every earlier one,
// so a settlement can never list the same item twice -- which would read as a
// bug rather than as luck, the same reasoning that stops rewardTraining()
// picking a stat with no headroom.
static void wildGrantDrops() {
  wildDropN = 0;
  uint8_t n = wildDropCount(btlHard, (uint8_t)random(100));
  for (uint8_t i = 0; i < n && i < 4; i++) {
    uint32_t total = bag.weightTotal(wildDrops, wildDropN);
    if (!total) break;
    ItemKey k = bag.weightedDrop((uint32_t)random(total), wildDrops, wildDropN);
    if (!k) break;
    bag.add(k);
    wildDrops[wildDropN++] = k;
    btlSay(T(S_FOUND_ITEM), itemEntry(k).name);
  }
}


// What the battle bag lists: medicine, never vitamins -- training is permanent and
// belongs to the care sim. ONE predicate, asked by the draw and the tap alike, so a
// cell can never be drawn and then do something else.
static bool btlBagShows(ItemKey k) {
  return itemUsableInBattle(k);
}

// A potion or a full heal, on whichever creature is out. It works on the
// Combatant, so like every ailment it is battle-only and is never written back.
static void btlUseItem(ItemKey k) {
  const ItemEntry &e = itemEntry(k);
  bool useful = (e.category == IC_HEAL) ? btlYou.hp < btlYou.maxHp
              : (e.category == IC_CURE) ? (btlYou.ailment != TS_AIL_NONE || btlYou.confuseTurns)
              : false;
  if (!useful) { sfxPlay(SFX_DENY); btlSay("%s", T(S_ITEM_NOUSE)); btlMenu = 0; return; }
  if (!bag.consume(k)) { sfxPlay(SFX_DENY); return; }
  if (e.category == IC_HEAL) {
    uint32_t hp = (uint32_t)btlYou.hp + (uint16_t)e.param;
    btlYou.hp = hp > btlYou.maxHp ? btlYou.maxHp : (uint16_t)hp;
  } else {
    btlYou.ailment = TS_AIL_NONE;
    btlYou.ailTurns = 0;
    btlYou.confuseTurns = 0;
  }
  btlMenu = 0;
  sfxPlay(SFX_TAP);
  btlSay(T(S_ITEM_USED), e.name);
  btlResolve(0);   // using an item costs the turn, as it does in the real games
}

// One exchange: both sides act in speed order, then injury/poison chip.
static void btlResolve(uint16_t yourMove) {
  TurnLog lg;
  // Against another device the opponent's move comes off the wire, never from
  // the AI -- and the host is the only side that runs this at all.
  uint16_t foeMove;
  uint32_t now = millis();
  if (btlLink) {
    // Off the wire, never from the AI.
    foeMove = linkActMove(btlFoe, lan.pendingAct);
    lan.pendingAct = 0;
  } else {
    foeMove = aiChooseMove(btlFoe, btlYou, btlHard);
    // A wild creature can leave. It spends its ACTION doing so rather than
    // fleeing and attacking in the same turn, so the fight simply ends -- with
    // no drops, which is what makes weakening it worth doing before it goes.
    if (btlWild && random(100) < wildFoeEscapeChance(btlFoe.hp, btlFoe.maxHp)) {
      btlOver = true;
      btlWon = false;
      audioMusic(MUS_NONE);
      btlSay(T(S_WILD_FLED), btlFoe.name);
      return;
    }
  }

  bool youFirst = battleMovesFirst(btlYou, yourMove, btlFoe, foeMove);
  Combatant *a = youFirst ? &btlYou : &btlFoe;
  Combatant *b = youFirst ? &btlFoe : &btlYou;
  uint16_t ma = youFirst ? yourMove : foeMove;
  uint16_t mb = youFirst ? foeMove : yourMove;

  uint16_t hp0You = btlYou.hp, hp0Foe = btlFoe.hp;
  battleAct(*a, *b, ma, lg);
  btlNarrate(*a, *b, lg);
  if (lg.damage && !lg.hurtSelf) btlLungeUntil[a == &btlYou ? 0 : 1] = now + BTL_LUNGE_MS;
  if (!b->fainted()) {
    battleAct(*b, *a, mb, lg);
    btlNarrate(*b, *a, lg);
    if (lg.damage && !lg.hurtSelf)
      btlLungeUntil[b == &btlYou ? 0 : 1] = now + BTL_LUNGE_MS + BTL_LUNGE_MS;
  }
  // whoever actually lost health flinches, whichever side dealt it
  if (btlYou.hp < hp0You) btlHitUntil[0] = now + BTL_HIT_MS;
  if (btlFoe.hp < hp0Foe) btlHitUntil[1] = now + BTL_HIT_MS;
  if (btlLink && btlLinkHost) btlShipResult(yourMove, foeMove, hp0You, hp0Foe);
  if (!btlYou.fainted() && !btlFoe.fainted()) {
    battleEndTurn(btlYou, lg);
    if (lg.damage) btlNarrate(btlYou, btlYou, lg);
    battleEndTurn(btlFoe, lg);
    if (lg.damage) btlNarrate(btlFoe, btlFoe, lg);
  }
  // One Digimon a side, so the first to go down ends the fight.
  if (btlFoe.fainted() || btlYou.fainted()) {
    btlOver = true;
    btlWon = btlFoe.fainted();
    btlNewBadge = false;
    btlTrainGain = 0;
    if (btlWon && btlTrainer >= 0 && !pet.hasBadge(btlTrainer, btlHard)) {
      pet.winBadge(btlTrainer, btlHard);
      btlNewBadge = true;
    }
    // A badge and nothing else made the ladder a one-way checklist. A win now
    // trains the partner that fought for it -- so a boss you can already beat
    // is worth returning to. Battling already costs the partner energy, which
    // is what rate-limits the grind without needing a cooldown.
    if (btlWon && btlTrainer >= 0) {
      // Later bosses are worth more, and hard mode is worth roughly double.
      uint8_t amt = (btlHard ? 6 + random(5) : 3 + random(3)) + btlTrainer / 3;
      btlTrainGain = pet.rewardTraining(amt, btlTrainWhich);
    }
    audioMusic(btlWon ? MUS_VICTORY : MUS_NONE);
    if (btlWon) sfxPlay(SFX_VICTORY);
    // Tell the peer before anything else: if we stop here without sending, the
    // other device sits on a battle that will never take another turn.
    if (btlLink && btlLinkHost) lan.sendEnd(btlWon);
    if (btlLink) { btlSay("%s", btlWon ? T(S_BTL_WIN) : T(S_BTL_LOSE)); return; }
    // A wild win reports its drops as narration rather than on the win screen:
    // that screen is the badge ceremony, and it has no badge to show.
    if (btlWon && btlWild) { btlSay("%s", T(S_BTL_WIN)); wildGrantDrops(); return; }
    if (btlWon && btlTrainer >= 0) { btlWinUntil = millis() + 60000; return; }
    btlSay("%s", T(S_BTL_LOSE));
  }
}

static void btlHpBar(int x, int y, int w, const Combatant &c, uint16_t shown) {
  int fw = c.maxHp ? (w - 4) * shown / c.maxHp : 0;
  uint16_t col = (shown * 2 > c.maxHp) ? UI_BAR_OK
                 : (shown * 4 > c.maxHp) ? UI_BAR_WARN : UI_BAR_BAD;
  gfx->fillRoundRect(x, y, w, 14, 4, UI_TRACK);
  if (fw > 0) gfx->fillRoundRect(x + 2, y + 2, fw, 10, 3, col);
  gfx->drawRoundRect(x, y, w, 14, 4, UI_INK);
}

static void btlSide(int tx, int ty, int sx, int sy, const Combatant &c, uint8_t who) {
  // the scenes are busy, so the name and bar sit on their own plate rather
  // than fighting the artwork for contrast
  int ph = (who == 0) ? 54 : 40;
  gfx->fillRoundRect(tx - 8, ty - 8, 158, ph, 8, UI_BG_DAY);
  gfx->drawRoundRect(tx - 8, ty - 8, 158, ph, 8, UI_INK);
  char l[28];
  snprintf(l, sizeof(l), "%s Lv.%u", c.name, c.level);
  gfx->setTextColor(UI_INK);
  gfx->setTextSize(1);
  gfx->setCursor(tx, ty);
  gfx->print(l);
  gfx->setTextColor(UI_BAR_WARN);
  gfx->setCursor(tx, ty + 14);
  gfx->print("HP");
  btlHpBar(tx + 18, ty + 12, 122, c, btlHpShown[who]);
  if (who == 0) {                 // your own numbers, as the games do
    char hp[16];
    snprintf(hp, sizeof(hp), "%u/%u", btlHpShown[who], c.maxHp);
    gfx->setTextColor(UI_INK);
    gfx->setCursor(tx + 140 - (int)strlen(hp) * 6, ty + 28);
    gfx->print(hp);
  }
  if (c.ailment != TS_AIL_NONE) {   // a status is the thing you most need to see
    static const StrId AIL_STR[] = { S_AIL_PARA, S_AIL_PARA, S_AIL_BURN, S_AIL_POISON,
                                     S_AIL_SLEEP, S_AIL_FREEZE, S_AIL_CONFUSE };
    gfx->setTextColor(UI_BAR_BAD);
    gfx->setCursor(tx + 18, ty + 28);
    gfx->print(T(AIL_STR[c.ailment]));
  }
  // a platform under each creature, so they stand in the scene rather than
  // floating over it
  uint32_t now = millis();
  int ox = 0, oy = 0;
  bool flash = false;
  if (now < btlFaintUntil[who]) {          // sinks out of frame as it faints
    uint32_t left = btlFaintUntil[who] - now;
    oy += (int)((BTL_FAINT_MS - left) * 70 / BTL_FAINT_MS);
  }
  if (now < btlLungeUntil[who]) {          // lean in, then back out
    uint32_t left = btlLungeUntil[who] - now;
    int amt = (int)(left > BTL_LUNGE_MS / 2 ? BTL_LUNGE_MS - left : left) * 22 / (BTL_LUNGE_MS / 2);
    ox = who == 0 ? amt : -amt;            // you lunge right, the foe lunges left
    oy = who == 0 ? -amt / 2 : amt / 2;
  }
  if (now < btlHitUntil[who]) {
    uint32_t left = btlHitUntil[who] - now;
    ox += ((left / 50) % 2) ? 5 : -5;      // jitter
  }

  // Real PMD playback when the sprite streamed: attack while lunging, hurt
  // while flinching, idle otherwise. `has()` guards every one, because not
  // every Digimon ships every action -- falling through to idle, and to the
  // flat thumbnail if the sprite is missing entirely (no SD).
  if (btlPmd[who].loaded) {
    uint8_t act = PMD_IDLE;
    bool loop = true;
    uint32_t t = now;
    if (now < btlHitUntil[who] && btlPmd[who].has(PMD_HURT)) {
      act = PMD_HURT; loop = false; t = now - (btlHitUntil[who] - BTL_HIT_MS);
    } else if (now < btlLungeUntil[who] && btlPmd[who].has(PMD_ATTACK)) {
      act = PMD_ATTACK; loop = false; t = now - (btlLungeUntil[who] - BTL_LUNGE_MS);
    }
    // x3, not x4: a 16x16 dot sprite fills its whole canvas, where the old
    // art left half of it empty, so x4 pushed the foe off the top of the glass.
    if (who == 0) drawPmdActFlip(btlPmd[who], act, sx + 24 + ox, sy + 78 + oy, t, loop, false, 3);
    else drawPmdActM(btlPmd[who], act, sx + 24 + ox, sy + 78 + oy, t, loop, false, 3);
    return;
  }
  const uint8_t *th = thumbs.get(c.dex);
  if (!th) return;
  if (now < btlHitUntil[who]) flash = ((btlHitUntil[who] - now) / 60) % 2 == 0;
  drawThumb(th, sx + ox, sy + oy, 3, flash);
}

// Bars drain rather than snap: a hit that removes half your health should be
// visible as it happens, not as a value that was already different.
static void btlEaseBars() {
  const uint16_t real[2] = { btlYou.hp, btlFoe.hp };
  for (int i = 0; i < 2; i++) {
    int diff = (int)real[i] - (int)btlHpShown[i];
    if (!diff) continue;
    int step = diff / 5;
    if (!step) step = diff > 0 ? 1 : -1;
    btlHpShown[i] = (uint16_t)((int)btlHpShown[i] + step);
  }
}

// The moment the ladder builds toward. It used to be one more line in the same
// message box as "It's super effective!", with the badge awarded silently.
void renderWin() {
  const Trainer &t = TRAINERS[btlTrainer];
  gfx->fillScreen(RGB565_BLACK);
  gfx->fillCircle(CX, CY, 231, UI_BG_DAY);

  gfx->setTextColor(UI_BAR_WARN);
  gfx->setTextSize(3);
  gfx->setCursor(CX - strlen(T(S_BTL_WIN)) * 9, 54);
  gfx->print(T(S_BTL_WIN));

  char l[40];
  snprintf(l, sizeof(l), T(S_BTL_BEAT), t.name);
  gfx->setTextColor(UI_INK);
  gfx->setTextSize(2);
  gfx->setCursor(CX - (int)strlen(l) * 6, 96);
  gfx->print(l);

  // the badge, large, with the hard-mode halo if that is how it was won
  if (btlTrainer < TRAINER_GYMS) {
    int by = 190;
    if (btlHard) {
      for (int r = 62; r >= 56; r--) gfx->drawCircle(CX, by, r, r % 2 ? 0xFEA0 : 0xFF60);
    }
    const BadgeArt *a = badgeArtFor(btlTrainer);
    if (a) {
      for (int r = 0; r < BADGE_PX; r++)
        for (int c = 0; c < BADGE_PX; c++) {
          uint8_t v = a->idx[r * BADGE_PX + c];
          if (v == 0xFF) continue;
          // 3x, so it reads as a prize rather than a list entry
          gfx->fillRect(CX - BADGE_PX * 3 / 2 + c * 3, by - BADGE_PX * 3 / 2 + r * 3,
                        3, 3, a->pal[v]);
        }
    } else {
      // An elite or the champion has no badge. A plain medal in the boss's colour.
      const uint8_t el = homeElement((int16_t)TRAINERS[btlTrainer].dex);
      gfx->fillCircle(CX, by, 26, typeColor(el));
      gfx->drawCircle(CX, by, 26, UI_INK);
      char n[4];
      snprintf(n, sizeof(n), "%u", (unsigned)(btlTrainer + 1));
      gfx->setTextSize(3);
      gfx->setTextColor(typeColorIsLight(el) ? UI_INK : UI_WHITE);
      gfx->setCursor(CX - (int)strlen(n) * 9, by - 11);
      gfx->print(n);
    }
    if (btlNewBadge) {
      gfx->setTextColor(UI_BAR_OK);
      gfx->setTextSize(2);
      gfx->setCursor(CX - strlen(T(S_BTL_NEWBADGE)) * 6, 286);
      gfx->print(T(S_BTL_NEWBADGE));
    }
  }
  snprintf(l, sizeof(l), T(S_BADGES_FMT), pet.badgeCount(btlHard));
  gfx->setTextColor(UI_INK);
  gfx->setTextSize(2);
  gfx->setCursor(CX - (int)strlen(l) * 6, 316);
  gfx->print(l);

  // what the win was worth beyond the badge
  if (btlTrainGain) {
    static const StrId NAMES[3] = { S_TR_ATK, S_TR_DEF, S_TR_SPE };
    snprintf(l, sizeof(l), T(S_WIN_TRAIN_FMT),
             T(NAMES[btlTrainWhich % 3]), btlTrainGain);
    gfx->setTextColor(UI_BAR_OK);
    gfx->setTextSize(2);
    gfx->setCursor(CX - (int)strlen(l) * 6, 344);
    gfx->print(l);
  } else if (btlTrainer >= 0) {
    gfx->setTextColor(UI_INK_SOFT);
    gfx->setTextSize(1);
    gfx->setCursor(CX - (int)strlen(T(S_WIN_MAXED)) * 3, 348);
    gfx->print(T(S_WIN_MAXED));
  }

  gfx->setTextColor(UI_INK_SOFT);
  gfx->setTextSize(2);
  gfx->setCursor(CX - strlen(T(S_BACK)) * 6, 380);
  gfx->print(T(S_BACK));
  gfx->flush();
}

void renderBattle() {
  if (btlWinUntil) { renderWin(); return; }
  btlEaseBars();
  gfx->fillScreen(RGB565_BLACK);
  drawBattleBack();
  // the lower band stays flat so the move grid and the HP text keep their
  // contrast against it
  gfx->fillRect(0, 254, 466, 212, UI_BG_DAY);

  // x=82 not 58: at y=60 the round bezel starts around x=77, and a longer
  // name like SEADRAMON was losing its first characters off the edge
  btlSide(82, 82, 300, 40, btlFoe, 1);    // foe reads top-left, sprite top-right
  btlSide(250, 190, 76, 168, btlYou, 0);  // you read bottom-right, sprite bottom-left

  // Waiting on the other device. Without this the screen is identical to the
  // one where it is your turn, so a tap that has been sent and a tap that was
  // never registered look exactly the same.
  bool lanWait = btlLink && !btlOver &&
                 (btlLinkHost ? (btlMyAct && !lan.hasPeerAct())
                              : (lan.state == LINK_WAITING));
  if (lanWait && !btlMsgCount) {
    gfx->fillRoundRect(BTL_GRID_X, BTL_GRID_Y, 328, BTL_GRID_H, 12, UI_WHITE);
    gfx->drawRoundRect(BTL_GRID_X, BTL_GRID_Y, 328, BTL_GRID_H, 12, UI_INK);
    gfx->setTextColor(UI_INK_SOFT);
    gfx->setTextSize(2);
    const char *w = T(S_LAN_WAITFOE);
    gfx->setCursor(CX - (int)strlen(w) * 6, BTL_GRID_Y + 48);
    gfx->print(w);
  } else if (btlMsgCount) {            // narration takes over the menu area
    gfx->fillRoundRect(BTL_GRID_X, BTL_GRID_Y, 328, BTL_GRID_H, 12, UI_WHITE);
    gfx->drawRoundRect(BTL_GRID_X, BTL_GRID_Y, 328, BTL_GRID_H, 12, UI_INK);
    gfx->setTextColor(UI_INK);
    gfx->setTextSize(2);
    char lines[3][25] = {{0}};
    const char *p = btlMsg[0];
    uint8_t lineCount = 0;
    while (*p && lineCount < 3) {
      while (*p == ' ') p++;
      int take = (int)strlen(p);
      if (take > 24) take = 24;
      if (p[take] && p[take] != ' ') {
        int word = take;
        while (word > 0 && p[word] != ' ') word--;
        if (word > 0) take = word;
      }
      memcpy(lines[lineCount], p, take);
      lines[lineCount][take] = 0;
      p += take;
      lineCount++;
    }
    int firstY = BTL_GRID_Y + 18 + (3 - lineCount) * 10;
    for (uint8_t i = 0; i < lineCount; i++) {
      gfx->setCursor(CX - (int)strlen(lines[i]) * 6, firstY + i * 24);
      gfx->print(lines[i]);
    }
    gfx->setTextColor(UI_INK_SOFT);
    gfx->setTextSize(1);
    gfx->setCursor(CX - 18, BTL_GRID_Y + BTL_GRID_H - 14);
    gfx->print("tap...");
  } else if (btlMenu == 0) {
    // The 2x2 grid: FIGHT and BAG on top, the basic attack and RUN below. All of
    // them reuse the skill grid's cells and so inherit its padded hit areas. The
    // bottom-left cell was the switch; now it is what a Digimon with nothing but
    // support skills fights with.
    const char *opt[4] = { T(S_FIGHT), T(S_BAG), T(S_BASIC_ATK), T(S_BTL_RUN) };
    for (int i = 0; i < 4; i++) {
      int x = BTL_CELL_X(i), y = BTL_CELL_Y(i);
      // The bag is dead in a link fight: an item the peer was never told about
      // would desync the two devices, and the host is authoritative.
      bool live = !(i == 1 && btlLink);
      gfx->fillRoundRect(x, y, BTL_CELL_W, BTL_CELL_H, 10, live ? UI_BG_DAY : UI_TRACK);
      gfx->drawRoundRect(x, y, BTL_CELL_W, BTL_CELL_H, 10, live ? UI_INK : 0x8410);
      gfx->setTextColor(live ? UI_INK : 0x8410);
      gfx->setTextSize(2);
      gfx->setCursor(x + (BTL_CELL_W - (int)strlen(opt[i]) * 12) / 2, y + 19);
      gfx->print(opt[i]);
    }
  } else if (btlMenu == 3) {
    drawBtlBack();
    // The battle bag: see btlBagShows().
    uint8_t shown = 0;
    uint8_t n = bag.distinctCount();
    for (uint8_t idx = 0; idx < n && shown < 4; idx++) {
      ItemKey k = bag.keyAt(idx);
      if (!btlBagShows(k)) continue;
      if (shown < btlBagPage * 4) { shown++; continue; }
      int cell = shown - btlBagPage * 4;
      if (cell >= 4) break;
      int x = BTL_CELL_X(cell), y = BTL_CELL_Y(cell);
      gfx->fillRoundRect(x, y, BTL_CELL_W, BTL_CELL_H, 10, UI_BG_DAY);
      gfx->drawRoundRect(x, y, BTL_CELL_W, BTL_CELL_H, 10, UI_INK);
      gfx->setTextColor(UI_INK);
      gfx->setTextSize(strlen(itemEntry(k).name) <= 11 ? 2 : 1);
      gfx->setCursor(x + 10, y + 8);
      gfx->print(itemEntry(k).name);
      gfx->setTextSize(1);
      char cnt[8];
      snprintf(cnt, sizeof(cnt), "x%u", bag.count(k));
      gfx->setCursor(x + 10, y + 28);
      gfx->print(cnt);
      shown++;
    }
    if (!shown) {
      gfx->setTextColor(UI_INK_SOFT);
      gfx->setTextSize(1);
      gfx->setCursor(CX - (int)strlen(T(S_BAG_EMPTY)) * 3, BTL_GRID_Y + 40);
      gfx->print(T(S_BAG_EMPTY));
    }
  } else {
    drawBtlBack();
    for (int i = 0; i < MOVE_SLOTS; i++) {
      int x = BTL_CELL_X(i), y = BTL_CELL_Y(i);
      uint16_t mv = btlYou.moves[i];
      gfx->fillRoundRect(x, y, BTL_CELL_W, BTL_CELL_H, 10, mv ? UI_BG_DAY : UI_TRACK);
      gfx->drawRoundRect(x, y, BTL_CELL_W, BTL_CELL_H, 10, UI_INK);
      if (!mv) continue;
      const TsSkill &sk = skillEntry(mv);
      gfx->setTextColor(UI_INK);
      drawSkillName(x + 10, y + 7, BTL_CELL_W - 18, 22, moveName(mv));
      // Same chip as the skill list: in a fight the element IS the decision, and
      // grey 6px text was the least visible thing on the busiest screen.
      if (sk.cat == TS_SC_SUPPORT) continue;
      int cw = drawTypeChip(x + 10, y + 34, sk.element);
      if (hasStab(btlYou.dex, sk.element)) {
        gfx->setTextSize(1);
        gfx->setTextColor(dexAccent(btlYou.dex));
        gfx->setCursor(x + 10 + cw + 4, y + 38);
        gfx->print("+");
      }
    }
  }
  gfx->flush();
}


int btlCellIndexAt(int16_t x, int16_t y) {
  for (int i = 0; i < 4; i++)
    if (btlCellHit(i, x, y)) return i;
  return -1;
}

// The way out of the move and switch screens. Without it the only exits were
// choosing something or leaving the fight entirely.
static void drawBtlBack() {
  gfx->fillRoundRect(BTL_BACK_X, BTL_BACK_Y, BTL_BACK_W, BTL_BACK_H, 11, UI_TRACK);
  gfx->drawRoundRect(BTL_BACK_X, BTL_BACK_Y, BTL_BACK_W, BTL_BACK_H, 11, UI_INK);
  gfx->setTextColor(UI_INK);
  gfx->setTextSize(2);
  gfx->setCursor(CX - (int)strlen(T(S_BACK)) * 6, BTL_BACK_Y + 14);
  gfx->print(T(S_BACK));
}

static bool btlBackTap(int16_t x, int16_t y) {
  if (x < BTL_BACK_X || x > BTL_BACK_X + BTL_BACK_W ||
      y < BTL_BACK_Y || y > BTL_BACK_Y + BTL_BACK_H) return false;
  btlMenu = 0;
  sfxPlay(SFX_TAP);
  return true;
}

// Running. A boss keeps their badge and the fight simply ends; against
// another device the peer is told, so it does not sit waiting for a move that
// will never come.
//
// A WILD fight is the exception: getting away is a roll, and failing it costs
// the turn.
static void btlRun() {
  if (btlWild && !btlOver) {
    btlMenu = 0;
    if (random(100) >= wildEscapeChance(btlYou.level, btlFoe.level)) {
      sfxPlay(SFX_DENY);
      btlSay("%s", T(S_NO_ESCAPE));
      btlResolve(0);   // move 0 = no attack, so only the foe acts
      return;
    }
    // Narrated and left OVER rather than closed here, so the message is
    // actually seen: battleTap() dismisses a finished fight, and closing on the
    // same beat would flash the line for one frame.
    sfxPlay(SFX_TAP);
    btlOver = true;
    btlWon = false;
    audioMusic(MUS_NONE);
    btlSay("%s", T(S_GOT_AWAY));
    return;
  }
  sfxPlay(SFX_DENY);
  btlFreeSprites();
  audioMusic(MUS_NONE);
  if (btlLink) { lanLeave(); btlLink = false; lanOpen = true; }
  battleOpen = false;
  btlWild = false;
  btlMenu = 0;
}

void battleTap(int16_t x, int16_t y) {
  if (btlWinUntil) {          // dismiss the win screen and leave the fight
    btlWinUntil = 0;
    btlFreeSprites();
    audioMusic(MUS_NONE);
    battleOpen = false;
    btlWild = false;
    if (btlLink) { btlLink = false; lanOpen = true; }
    return;
  }
  if (btlMsgCount) {          // one readable event per tap; never skip queued text
    for (uint8_t i = 1; i < btlMsgCount; i++)
      memcpy(btlMsg[i - 1], btlMsg[i], sizeof(btlMsg[0]));
    btlMsgCount--;
    if (btlMsgCount) return;
    if (btlOver) {
      btlFreeSprites();
      // Its twin above (the btlWinUntil dismiss) already stops the music; a
      // wild win/loss and a losing tamer fight end here instead and were the
      // one path that left MUS_BATTLE/MUS_VICTORY looping under the next screen.
      audioMusic(MUS_NONE);
      battleOpen = false;
      btlWild = false;
      // Back to the LAN screen rather than all the way out: that is where a
      // rematch is offered, and re-pairing for every fight would be tedious.
      if (btlLink) { btlLink = false; lanOpen = true; }
      return;
    }
    return;
  }
  if (btlMenu == 0) {
    if (btlCellHit(0, x, y)) { sfxPlay(SFX_TAP); btlMenu = 1; return; }   // FIGHT
    if (btlCellHit(1, x, y)) {
      if (btlLink) { sfxPlay(SFX_DENY); return; }   // see renderBattle
      sfxPlay(SFX_TAP); btlMenu = 3; btlBagPage = 0; return;
    }
    if (btlCellHit(2, x, y)) {   // the basic attack: see renderBattle
      sfxPlay(SFX_TAP);
      if (btlLink && !btlLinkHost) { lan.sendAct(LINK_ACT_BASIC); return; }
      if (btlLink) {
        btlMyAct = LINK_ACT_BASIC;
        if (!lan.hasPeerAct()) return;   // resolved by btlLinkPoll when it lands
        btlMyAct = 0;
      }
      btlResolve(SKILL_BASIC);
      return;
    }
    if (btlCellHit(3, x, y)) { btlRun(); return; }
    return;
  }
  if (btlMenu == 3) {
    if (btlBackTap(x, y)) return;
    uint8_t shown = 0;
    uint8_t n = bag.distinctCount();
    for (uint8_t idx = 0; idx < n; idx++) {
      ItemKey k = bag.keyAt(idx);
      if (!btlBagShows(k)) continue;
      if (shown < btlBagPage * 4) { shown++; continue; }
      int cell = shown - btlBagPage * 4;
      if (cell >= 4) break;
      shown++;
      if (!btlCellHit(cell, x, y)) continue;
      btlUseItem(k);
      return;
    }
    btlMenu = 0;      // anywhere else backs out
    return;
  }
  if (btlBackTap(x, y)) return;
  for (int i = 0; i < MOVE_SLOTS; i++) {
    if (!btlYou.moves[i]) continue;
    if (!btlCellHit(i, x, y)) continue;
    sfxPlay(SFX_TAP);
    btlMenu = 0;
    if (btlLink && !btlLinkHost) {
      lan.sendAct(LINK_ACT_MOVE(i));   // the guest asks; the host decides
      return;
    }
    if (btlLink) {
      // Latched, not discarded. The host used to throw the tap away when the
      // rival had not chosen yet, so you had to keep jabbing at the move until
      // the timing happened to line up.
      btlMyAct = LINK_ACT_MOVE(i);
      if (!lan.hasPeerAct()) return;   // resolved by btlLinkPoll when it lands
      btlMyAct = 0;
    }
    btlResolve(btlYou.moves[i]);
    return;
  }
  btlMenu = 0;        // a tap off the grid goes back to FIGHT/BAG/RUN
}

// ---------- player card (swipe down) ----------
// Everything here is player-wide and outlives the creature: badges, the daily
// streak and the Digidex. No player sprite yet -- the SD carries
// PMD creature sprites only, so a tamer portrait needs new art.
// Page 1: who you are -- avatar, badges, totals. Tap the avatar to cycle it;
// the four sprites are hand-drawn (see Digimon.h) because SpriteCollab has no
// tamer art and ripped sprites would be unlicensed.
static void renderPlayerBadges() {
  // the player's name if they have set one, the generic title if not; either
  // way tapping it opens the keyboard
  const char *tn = pet.trainerName[0] ? pet.trainerName : T(S_TRAINER);
  gfx->setTextColor(UI_INK);
  gfx->setTextSize(3);
  gfx->setCursor(CX - (int)strlen(tn) * 9, 40);
  gfx->print(tn);

  if (gShowAllAvatars) {                 // emulator only: every avatar at once
    for (uint8_t i = 0; i < AVATAR_COUNT; i++)
      drawAvatar(i, 60 + (i % 4) * 88, 60 + (i / 4) * 60, 3);
  } else {
    drawAvatar(pet.avatar, CX - AVATAR_PX * 2, 72, 4);
    // the sprite alone is not always obvious at 16x16, so it is named
    const char *an = AVATARS[pet.avatar % AVATAR_COUNT].name;
    gfx->setTextColor(UI_INK);
    gfx->setTextSize(1);
    gfx->setCursor(CX - (int)strlen(an) * 3, 143);
    gfx->print(an);
    gfx->setTextColor(UI_INK_SOFT);
    gfx->setCursor(CX - (int)strlen(T(S_AVATAR_HINT)) * 3, 154);
    gfx->print(T(S_AVATAR_HINT));
  }

  // The real badges, 2x4. Unearned ones draw as a faint outline so the shape
  // of what is missing is still visible.
  for (int i = 0; i < TRAINER_GYMS; i++) {
    int bx = 140 + (i % 4) * 62, by = 188 + (i / 4) * 62;
    bool got = pet.hasBadge(i, false);
    bool hard = pet.hasBadge(i, true);
    if (hard) {
      // Beaten on hard: a golden halo. Concentric rings, not a filled disc --
      // a disc sat behind the art and read as a gold coin rather than a glow.
      gfx->drawCircle(bx, by, 25, 0xFDE0);
      gfx->drawCircle(bx, by, 24, 0xFEA0);
      gfx->drawCircle(bx, by, 23, 0xFF60);
      gfx->drawCircle(bx, by, 22, 0xFEA0);
      gfx->drawCircle(bx, by, 21, 0xFDE0);
    }
    if (!got) {
      gfx->drawCircle(bx, by, 20, UI_TRACK);
      continue;
    }
    const BadgeArt *a = badgeArtFor(i);
    for (int r = 0; r < BADGE_PX; r++)
      for (int c = 0; c < BADGE_PX; c++) {
        uint8_t v = a->idx[r * BADGE_PX + c];
        if (v == 0xFF) continue;
        gfx->fillRect(bx - BADGE_PX / 2 + c, by - BADGE_PX / 2 + r, 1, 1, a->pal[v]);
      }
  }
  char l[32];
  gfx->setTextColor(UI_INK);
  gfx->setTextSize(2);
  snprintf(l, sizeof(l), T(S_STREAK_FMT), pet.streak, pet.bestStreak);
  gfx->setCursor(CX - (int)strlen(l) * 6, 286);
  gfx->print(l);
  snprintf(l, sizeof(l), T(S_DIGIDEX_FMT), pet.registeredCount(), DEX_COUNT);
  gfx->setCursor(CX - (int)strlen(l) * 6, 312);
  gfx->print(l);
}

// Page 2: the medals. They used to sit on the creature's card; they belong with
// the player, since totalMedals accumulates across every pet you raise.
static void renderPlayerMedals() {
  int got = 0;
  for (int i = 0; i < MED_COUNT; i++)
    if (pet.hasMedal(1 << i)) got++;
  char head[24];
  snprintf(head, sizeof(head), T(S_MEDALS_FMT), got, MED_COUNT);
  gfx->setTextColor(UI_INK);
  gfx->setTextSize(3);
  gfx->setCursor(CX - strlen(head) * 9, 44);
  gfx->print(head);

  for (int i = 0; i < MED_COUNT; i++) {
    int x = 46 + (i % 2) * 190, y = 96 + (i / 2) * 58;
    bool g = pet.hasMedal(1 << i);
    gfx->fillRoundRect(x, y, 180, 48, 10, g ? UI_BAR_OK : UI_TRACK);
    gfx->drawRoundRect(x, y, 180, 48, 10, UI_INK);
    gfx->setTextColor(g ? UI_BG_DAY : UI_INK);
    gfx->setTextSize(2);
    gfx->setCursor(x + (180 - (int)strlen(medalLabel(i)) * 12) / 2, y + 6);
    gfx->print(medalLabel(i));
    gfx->setTextSize(1);
    gfx->setCursor(x + (180 - (int)strlen(medalDesc(i)) * 6) / 2, y + 30);
    gfx->print(medalDesc(i));
  }
  char tot[28];
  snprintf(tot, sizeof(tot), T(S_MEDALS_TOTAL_FMT), pet.totalMedals);
  gfx->setTextColor(UI_INK_SOFT);
  gfx->setTextSize(1);
  gfx->setCursor(CX - (int)strlen(tot) * 3, 344);
  gfx->print(tot);
}

// The trait's name. Indexed by the PERS_* value, in the same order as the enum,
// so there is no switch that could disagree with it.
const char *personalityName() {
  static const StrId NAMES[Pet::PERSONALITY_COUNT] = {
    S_PERS_BOLD, S_PERS_STURDY, S_PERS_BRISK, S_PERS_HARDY, S_PERS_EAGER, S_PERS_CALM,
  };
  return T(NAMES[pet.personality() % Pet::PERSONALITY_COUNT]);
}

// ---------------------------------------------------------------------------
// TODAY'S CARE CHECKLIST.
//
// NON-DESTRUCTIVE, and that is the whole design rather than a caveat. Every line
// is COMPUTED from state the save already holds, so:
//   * nothing new is written, no field is added, no migration exists to get wrong;
//   * the list resets itself with the day, because lastCareDay and the bars
//     already do;
//   * and there is deliberately NO REWARD. A reward would have to be marked as
//     claimed, which means a per-day persisted flag, which is the migration this
//     avoids -- and the fork this idea came from pays for its version by
//     CONSUMING A LIVING CREATURE, which is not a trade worth making. The value
//     here is answering "what does it need right now", and a checklist does that
//     without being a currency.
//
// Every check reads PERSISTED state rather than a "did you do X today" counter.
// bondToday would have been the obvious source for a training goal and is RAM
// only, so it reads false after a reboot -- a checklist that forgets what you did
// because the device restarted is worse than one line shorter.
struct GoalDef {
  StrId label;
  bool (*met)();
};
static bool goalCared()  { return pet.caredToday(); }
static bool goalFed()    { return pet.fullness >= 70; }
static bool goalClean()  { return pet.poops == 0 && pet.hygiene >= 70; }
static bool goalHappy()  { return pet.joy >= 70; }
static bool goalRested() { return pet.energy >= 70; }
static const GoalDef GOALS[] = {
  { S_GOAL_CARED,  goalCared  },
  { S_GOAL_FED,    goalFed    },
  { S_GOAL_CLEAN,  goalClean  },
  { S_GOAL_HAPPY,  goalHappy  },
  { S_GOAL_RESTED, goalRested },
};
#define GOAL_COUNT ((int)(sizeof(GOALS) / sizeof(GOALS[0])))
// Its metrics live up with the other layout constants; uiRowHeights() holds
// GOAL_ROW_H to the hard floor far above here.

// Published so a test can drive the firmware's own answers rather than
// re-implementing five predicates and proving only the transcription.
int uiGoalCount() { return GOAL_COUNT; }
bool uiGoalMet(int i) { return i >= 0 && i < GOAL_COUNT && GOALS[i].met(); }
int uiGoalsMet() {
  int n = 0;
  for (int i = 0; i < GOAL_COUNT; i++) if (GOALS[i].met()) n++;
  return n;
}

static void renderPlayerGoals() {
  const int done = uiGoalsMet();
  gfx->setTextColor(UI_INK);
  gfx->setTextSize(3);
  gfx->setCursor(CX - strlen(T(S_GOALS)) * 9, 44);
  gfx->print(T(S_GOALS));
  char sub[24];
  snprintf(sub, sizeof(sub), T(S_GOALS_FMT), done, GOAL_COUNT);
  gfx->setTextColor(done == GOAL_COUNT ? UI_BAR_OK : UI_INK_SOFT);
  gfx->setTextSize(2);
  gfx->setCursor(CX - (int)strlen(sub) * 6, 76);
  gfx->print(sub);

  for (int i = 0; i < GOAL_COUNT; i++) {
    const int ry = GOAL_ROW_Y(i);
    // As wide as the glass allows AT THIS HEIGHT, the same rule every other row
    // list here follows -- one width for all five would hang the last one's
    // corners off the bezel.
    const int half = uiSafeHalfWidthFor(ry, ry + GOAL_ROW_H) - 18;
    const int rx = CX - half;
    const bool met = GOALS[i].met();
    gfx->fillRoundRect(rx, ry, half * 2, GOAL_ROW_H, 10, met ? UI_BAR_OK : UI_TRACK);
    gfx->drawRoundRect(rx, ry, half * 2, GOAL_ROW_H, 10, UI_INK);
    // A tick or an empty box, so the state does not rest on colour alone -- the
    // filled green and the grey track are close in luminance and this screen has
    // to read for somebody who cannot tell them apart.
    const int bx = rx + 14, by = ry + GOAL_ROW_H / 2;
    if (met) {
      gfx->fillCircle(bx + 8, by, 9, UI_BG_DAY);
      gfx->drawLine(bx + 4, by, bx + 7, by + 4, UI_INK);
      gfx->drawLine(bx + 5, by, bx + 8, by + 4, UI_INK);
      gfx->drawLine(bx + 7, by + 4, bx + 13, by - 5, UI_INK);
      gfx->drawLine(bx + 8, by + 4, bx + 14, by - 5, UI_INK);
    } else {
      gfx->drawCircle(bx + 8, by, 9, UI_INK_SOFT);
    }
    const char *l = T(GOALS[i].label);
    gfx->setTextColor(met ? UI_BG_DAY : UI_INK);
    gfx->setTextSize(2);
    gfx->setCursor(bx + 30, by - 8);
    gfx->print(l);
  }
}

void renderPlayer() {
  gfx->fillScreen(RGB565_BLACK);
  gfx->fillCircle(CX, CY, 231, UI_BG_DAY);
  if (playerPage == 0) renderPlayerBadges();
  else if (playerPage == 1) renderPlayerMedals();
  else renderPlayerGoals();

  gfx->setTextColor(UI_INK_SOFT);
  gfx->setTextSize(2);
  gfx->setCursor(CX - strlen(T(S_BACK)) * 6, 392);
  gfx->print(T(S_BACK));
  uiChrome();
  gfx->flush();
}

// ---------- reaction test (trains SPEED) ----------
// The third training verb. The bag is a masher and the ball is a juggler, so
// this one is a reaction: a target appears somewhere on the panel and you tap
// it before it expires. The window shrinks as you go, which is what makes it
// read as speed rather than as endurance.
#define SPD_MS 15000UL       // session length
#define SPD_LIFE0 1100       // first target's window, ms
#define SPD_LIFE_MIN 380
#define SPD_R 46             // target radius

void spdSpawn() {
  // Keep the whole target inside the bezel: pick an angle and a radius that
  // leave SPD_R of margin, rather than a square that clips at the corners.
  int ang = random(360);
  int rad = random(150);
  float a = ang * 3.14159f / 180.0f;
  spdX = CX + (int)(cosf(a) * rad);
  spdY = CY + (int)(sinf(a) * rad);
  spdBorn = millis();
}

void startSpeedGame() {
  if (pet.isEgg() || pet.sleeping || pet.ceremony) return;
  spdOpen = true;
  spdUntil = millis() + SPD_MS;
  spdOverUntil = 0;
  spdHits = 0;
  spdMisses = 0;
  spdGain = 0;
  spdNewHi = false;
  spdSpawn();
}

static uint16_t spdLife() {
  int life = SPD_LIFE0 - spdHits * 32;
  return life < SPD_LIFE_MIN ? SPD_LIFE_MIN : life;
}

void spdTap(int16_t x, int16_t y) {
  if (spdOverUntil) return;
  int dx = x - spdX, dy = y - spdY;
  if (dx * dx + dy * dy <= (SPD_R + 14) * (SPD_R + 14)) {
    spdHits++;
    sfxPlay(SFX_TAP);
    spdSpawn();
  }
}

void renderSpeed() {
  uint32_t now = millis();
  drawGameScene();
  bool night = sceneHour() < 6 || sceneHour() >= 20;
  uint16_t ink = night ? UI_INK_NIGHT : UI_INK;

  if (spdOverUntil) {
    if (now > spdOverUntil) { spdOpen = false; return; }
    char b[24];
    snprintf(b, sizeof(b), T(S_SCORE_FMT), spdHits);
    gfx->setTextColor(ink);
    gfx->setTextSize(4);
    gfx->setCursor(CX - strlen(b) * 12, 150);
    gfx->print(b);
    char g[20];
    snprintf(g, sizeof(g), T(S_SPD_GAIN_FMT), spdGain);
    gfx->setTextColor(UI_BAR_WARN);
    gfx->setTextSize(3);
    gfx->setCursor(CX - strlen(g) * 9, 210);
    gfx->print(g);
    gfx->setTextSize(2);
    if (spdNewHi && spdHits > 0) {
      gfx->setTextColor(UI_BAR_WARN);
      gfx->setCursor(CX - strlen(T(S_NEW_RECORD)) * 6, 256);
      gfx->print(T(S_NEW_RECORD));
    } else {
      char r[20];
      snprintf(r, sizeof(r), T(S_RECORD_FMT), pet.spdHi);
      gfx->setTextColor(ink);
      gfx->setCursor(CX - strlen(r) * 6, 256);
      gfx->print(r);
    }
    gfx->flush();
    return;
  }

  // session over?
  if (now >= spdUntil) {
    spdNewHi = (spdHits > pet.spdHi);
    spdGain = pet.trainSpeed(spdHits);
    sfxPlay(spdNewHi ? SFX_MEDAL : SFX_PLAY);
    spdOverUntil = now + 3500;
    gfx->flush();
    return;
  }
  // target expired?
  if (now - spdBorn > spdLife()) {
    spdMisses++;
    spdSpawn();
  }

  // the target, shrinking as its window runs out so the urgency is visible
  uint32_t age = now - spdBorn;
  int life = spdLife();
  int r = SPD_R - (int)((uint32_t)SPD_R * age / (life ? life : 1) / 2);
  if (r < 8) r = 8;
  gfx->fillCircle(spdX, spdY, r, UI_BAR_BAD);
  gfx->fillCircle(spdX, spdY, r * 2 / 3, UI_WHITE);
  gfx->fillCircle(spdX, spdY, r / 3, UI_BAR_BAD);

  char b[12];
  snprintf(b, sizeof(b), "%u", spdHits);
  gfx->setTextColor(ink);
  gfx->setTextSize(4);
  gfx->setCursor(CX - strlen(b) * 12, 30);
  gfx->print(b);
  // seconds left
  uint32_t left = (spdUntil > now) ? (spdUntil - now + 999) / 1000 : 0;
  snprintf(b, sizeof(b), "%us", (unsigned)left);
  gfx->setTextSize(2);
  gfx->setCursor(CX - strlen(b) * 6, 76);
  gfx->print(b);
  gfx->flush();
}

// ---------- memory game (joy and bond, no stat) ----------
//
// The fourth thing to do with a creature, and deliberately NOT a fourth stat
// tamer: the bag trains ATK, the reaction test SPE and the ball DEF, so there
// is no stat left that a new game would not simply duplicate. This one pays in
// joy and bond, which makes it the game you play when the creature is too worn
// out for the other three -- it costs almost no energy and burns no weight.
//
// Four pads flash a sequence and you repeat it. One more step each round, so the
// score IS the longest sequence remembered, and the difficulty curve is the
// player's memory rather than a timer that gets meaner.
// Its metrics live up with the other layout constants, for the same reason the
// settings rows do: uiButtonHeights() and uiMemoPadR() sit far above this.

uint32_t memoOverUntil = 0;
uint8_t memoSeq[MEMO_MAX];
uint8_t memoLen = 0;         // how long the sequence currently is
uint8_t memoAt = 0;          // how much of it the player has repeated
uint8_t memoShowAt = 0;      // which step is being shown, while showing
bool memoShowing = false;
uint32_t memoStepUntil = 0;  // when the current shown step (or gap) ends
bool memoGap = false;
uint32_t memoDeadline = 0;   // when the player's patience runs out
int8_t memoLit = -1;         // which pad is lit right now, -1 for none
uint8_t memoBest = 0;        // longest sequence completed this session
bool memoWrong = false;      // the last answer was wrong, for one flash of red
bool memoNewHi = false;
uint8_t memoGain = 0;

// The pads sit on a ring, so the round panel is used rather
// than fought. ONE answer for where a pad is: the draw path and the tap path both
// ask, which is the rule every other control here follows.
void memoPadPos(int i, int *cx, int *cy) {
  const float a = (-90.0f + 90.0f * (float)i) * 0.01745329f;
  if (cx) *cx = CX + (int)(cosf(a) * MEMO_RING);
  if (cy) *cy = CY + (int)(sinf(a) * MEMO_RING);
}
int memoPadAt(int16_t x, int16_t y) {
  for (int i = 0; i < MEMO_PADS; i++) {
    int px, py;
    memoPadPos(i, &px, &py);
    const int dx = x - px, dy = y - py;
    if (dx * dx + dy * dy <= MEMO_R * MEMO_R) return i;
  }
  return -1;
}
static uint16_t memoPadColour(int i) {
  static const uint16_t C[MEMO_PADS] = {
    C565(0xe0, 0x5a, 0x5a), C565(0x4c, 0xa8, 0xe0),
    C565(0x5c, 0xc0, 0x6a), C565(0xe8, 0xc0, 0x4a),
  };
  return C[i % MEMO_PADS];
}

// Extends the sequence and starts showing it from the beginning. Replaying the
// WHOLE sequence each round is the point -- that is what makes it memory rather
// than reaction.
static void memoNextRound() {
  if (memoLen < MEMO_MAX) memoSeq[memoLen++] = (uint8_t)random(MEMO_PADS);
  memoAt = 0;
  memoShowAt = 0;
  memoShowing = true;
  memoGap = true;                       // a beat of dark before the first pad
  memoLit = -1;
  memoStepUntil = millis() + MEMO_GAP_MS * 2;
}

void startMemoGame() {
  if (pet.isEgg() || pet.sleeping || pet.ceremony) return;
  memoOpen = true;
  memoOverUntil = 0;
  memoLen = 0;
  memoBest = 0;
  memoWrong = false;
  memoNewHi = false;
  memoGain = 0;
  memoNextRound();
}

// Ends the session and banks what was earned. Its own function because three
// paths reach it -- a wrong answer, running out of patience, and walking away --
// and the reward must be applied exactly once however it ended.
static void memoFinish() {
  if (memoOverUntil) return;            // already ended
  memoNewHi = (memoBest > pet.memoHi);
  memoGain = pet.playMemo(memoBest);
  sfxPlay(memoNewHi && memoBest > 0 ? SFX_MEDAL : SFX_LEVEL);
  memoOverUntil = millis() + 3500;
}

// Leaving early BANKS what was earned rather than voiding it, exactly as the other
// three do. Quitting used to be the only way to lose a session's work, and it was
// removed from all of them for the same reason.
void leaveMemo() {
  memoFinish();
  memoOpen = false;
}

void memoTap(int16_t x, int16_t y) {
  if (memoOverUntil || memoShowing) return;   // not your turn yet
  const int pad = memoPadAt(x, y);
  if (pad < 0) return;
  memoLit = pad;                              // light what was pressed
  memoStepUntil = millis() + 160;
  if (memoSeq[memoAt] != (uint8_t)pad) {
    memoWrong = true;
    sfxPlay(SFX_DENY);
    memoFinish();
    return;
  }
  sfxPlay(SFX_TAP);
  memoAt++;
  memoDeadline = millis() + MEMO_INPUT_MS;
  if (memoAt >= memoLen) {                    // the whole sequence, repeated
    if (memoLen > memoBest) memoBest = memoLen;
    if (memoLen >= MEMO_MAX) { memoFinish(); return; }
    sfxPlay(SFX_PLAY);
    memoNextRound();
  }
}

void renderMemo() {
  const uint32_t now = millis();
  drawGameScene();
  const bool night = sceneHour() < 6 || sceneHour() >= 20;
  const uint16_t ink = night ? UI_INK_NIGHT : UI_INK;

  if (memoOverUntil) {
    if (now > memoOverUntil) { memoOpen = false; gfx->flush(); return; }
    char b[24];
    snprintf(b, sizeof(b), T(S_MEMO_FMT), memoBest);
    gfx->setTextColor(ink);
    gfx->setTextSize(4);
    gfx->setCursor(CX - strlen(b) * 12, 150);
    gfx->print(b);
    char g[22];
    snprintf(g, sizeof(g), T(S_PLUS_JOY_FMT), memoGain);
    gfx->setTextColor(C565(0xd4, 0x52, 0x7e));
    gfx->setTextSize(3);
    gfx->setCursor(CX - strlen(g) * 9, 210);
    gfx->print(g);
    gfx->setTextSize(2);
    if (memoNewHi && memoBest > 0) {
      gfx->setTextColor(UI_BAR_WARN);
      gfx->setCursor(CX - strlen(T(S_NEW_RECORD)) * 6, 256);
      gfx->print(T(S_NEW_RECORD));
    } else {
      char r[22];
      snprintf(r, sizeof(r), T(S_RECORD_FMT), pet.memoHi);
      gfx->setTextColor(ink);
      gfx->setCursor(CX - strlen(r) * 6, 256);
      gfx->print(r);
    }
    gfx->flush();
    return;
  }

  // --- advance the sequence being shown, or the player's patience
  if (memoShowing) {
    if (now >= memoStepUntil) {
      if (memoGap) {                    // the gap just ended: light the next pad
        if (memoShowAt >= memoLen) {
          memoShowing = false;          // the whole sequence has been shown
          memoLit = -1;
          memoDeadline = now + MEMO_INPUT_MS;
        } else {
          memoLit = memoSeq[memoShowAt];
          memoGap = false;
          memoStepUntil = now + MEMO_FLASH_MS;
        }
      } else {                          // the flash just ended
        memoLit = -1;
        memoShowAt++;
        memoGap = true;
        memoStepUntil = now + MEMO_GAP_MS;
      }
    }
  } else {
    if (memoLit >= 0 && now >= memoStepUntil) memoLit = -1;
    // Running out of patience ends the session rather than counting as a wrong
    // answer, so putting the device down mid-round still banks what was earned.
    if (memoDeadline && now >= memoDeadline) { memoFinish(); gfx->flush(); return; }
  }

  for (int i = 0; i < MEMO_PADS; i++) {
    int px, py;
    memoPadPos(i, &px, &py);
    const bool lit = (memoLit == i);
    const uint16_t base = memoPadColour(i);
    gfx->fillCircle(px, py, MEMO_R, lit ? UI_WHITE : base);
    if (lit) gfx->fillCircle(px, py, MEMO_R - 10, base);
    gfx->drawCircle(px, py, MEMO_R, ink);
    gfx->drawCircle(px, py, MEMO_R - 1, ink);
  }

  // How far in you are, in the middle where the pads leave a hole
  char c[10];
  snprintf(c, sizeof(c), "%u", memoShowing ? memoLen : memoAt);
  gfx->setTextColor(memoWrong ? UI_BAR_BAD : ink);
  gfx->setTextSize(4);
  gfx->setCursor(CX - strlen(c) * 12, CY - 16);
  gfx->print(c);

  // WATCH or YOUR TURN. Without it the two halves of a round look identical and
  // there is no way to know whether a tap is expected.
  const char *hint = memoShowing ? T(S_MEMO_WATCH) : T(S_MEMO_GO);
  gfx->setTextColor(ink);
  gfx->setTextSize(2);
  gfx->setCursor(CX - strlen(hint) * 6, 42);
  gfx->print(hint);
  char rec[22];
  snprintf(rec, sizeof(rec), T(S_REC_FMT), pet.memoHi);
  gfx->setTextSize(1);
  gfx->setCursor(CX - (int)strlen(rec) * 3, 74);
  gfx->print(rec);
  gfx->flush();
}

// ---------- LAN battle ----------
// Pairing on a touch-only screen: one device hosts, the other joins, and the
// protocol does the rest. There is no MAC entry because there is no keyboard
// worth typing one on.
void renderLan() {
  gfx->fillScreen(RGB565_BLACK);
  gfx->fillCircle(CX, CY, 231, UI_BG_DAY);
  gfx->setTextColor(UI_INK);
  gfx->setTextSize(2);
  gfx->setCursor(CX - strlen(T(S_LAN)) * 6, 44);
  gfx->print(T(S_LAN));

  const char *msg = T(S_LAN_PICK);
  switch (lan.state) {
    case LINK_HANDSHAKE:
    case LINK_LISTENING: msg = T(S_LAN_WAIT); break;
    case LINK_SQUADS:    msg = T(S_LAN_WAIT); break;
    case LINK_READY:     msg = T(S_LAN_READY); break;
    case LINK_REFUSED:   msg = T(S_LAN_REFUSED); break;
    case LINK_LOST:      msg = T(S_LAN_GONE); break;
    case LINK_DONE:      msg = lan.youWon ? T(S_BTL_WIN) : T(S_BTL_LOSE); break;
    default: break;
  }
  gfx->setTextColor((lan.state == LINK_REFUSED || lan.state == LINK_LOST)
                      ? UI_BAR_BAD : UI_TRACK);
  gfx->setTextSize(1);
  gfx->setCursor(CX - (int)strlen(msg) * 3, 76);
  gfx->print(msg);

  if (lan.state == LINK_OFF || lan.state == LINK_REFUSED ||
      lan.state == LINK_LOST) {
    const char *lab[2] = { T(S_LAN_HOST), T(S_LAN_JOIN) };
    for (int i = 0; i < 2; i++) {
      int y = 120 + i * 70;
      gfx->fillRoundRect(90, y, 286, 56, 12, UI_BG_DAY);
      gfx->drawRoundRect(90, y, 286, 56, 12, UI_INK);
      gfx->setTextColor(UI_INK);
      gfx->setTextSize(2);
      gfx->setCursor(CX - (int)strlen(lab[i]) * 6, y + 20);
      gfx->print(lab[i]);
    }
  } else if (lan.state == LINK_READY) {
    char l[40];
    if (lan.peerName[0]) {
      gfx->setTextColor(UI_INK);
      gfx->setTextSize(2);
      gfx->setCursor(CX - (int)strlen(lan.peerName) * 6, 130);
      gfx->print(lan.peerName);
    }
    // Their partner, as the battle plates name it. It used to be a squad count,
    // which with one Digimon a side would always read 1. Through linkMonTo(),
    // because a name off the wire need not be terminated.
    Combatant rival;
    linkMonTo(rival, lan.theirs[0]);
    snprintf(l, sizeof(l), "%s Lv.%u", rival.name, rival.level);
    gfx->setTextColor(UI_INK);
    gfx->setTextSize(2);
    gfx->setCursor(CX - (int)strlen(l) * 6, 150);
    gfx->print(l);
    gfx->fillRoundRect(120, 220, 226, 56, 12, UI_BAR_OK);
    gfx->drawRoundRect(120, 220, 226, 56, 12, UI_INK);
    gfx->setTextColor(UI_BG_DAY);
    gfx->setCursor(CX - strlen(T(S_FIGHT)) * 6, 240);
    gfx->print(T(S_FIGHT));
  } else if (lan.state == LINK_DONE) {
    // Both partners are still in hand on both devices, so going again costs one
    // packet -- there is nothing to re-exchange.
    if (lan.peerName[0]) {
      gfx->setTextColor(UI_INK);
      gfx->setTextSize(2);
      gfx->setCursor(CX - (int)strlen(lan.peerName) * 6, 140);
      gfx->print(lan.peerName);
    }
    gfx->fillRoundRect(120, 220, 226, 56, 12, UI_BG_DAY);
    gfx->drawRoundRect(120, 220, 226, 56, 12, UI_INK);
    gfx->setTextColor(UI_INK);
    gfx->setTextSize(2);
    gfx->setCursor(CX - strlen(T(S_LAN_REMATCH)) * 6, 240);
    gfx->print(T(S_LAN_REMATCH));
  }
  gfx->setTextColor(UI_INK_SOFT);
  gfx->setTextSize(2);
  gfx->setCursor(CX - strlen(T(S_BACK)) * 6, 392);
  gfx->print(T(S_BACK));
  gfx->flush();
}

// Leaving deliberately: tell the peer so it reports at once instead of sitting
// out the timeout, then free the radio -- it costs real current.
void lanLeave() {
  if (lan.live()) lan.sendBye();
  linkNowEnd();
  lan.state = LINK_OFF;
}

// Hands our partner to the link, then announces.
static void lanOffer(bool host) {
  // The partner is offered BEFORE the radio is touched. What we advertise does
  // not depend on whether the radio comes up -- doing it the other way round
  // meant a failed radio skipped it entirely and left nothing to inspect.
  lan.begin(host, pet.trainerName);
  snprintf(lan.peerName, sizeof(lan.peerName), "%s", pet.trainerName);
  if (buildPartner(0)) {
    LinkMon m;
    linkMonFrom(m, btlYou);
    lan.addMon(m);
  }
  if (!linkNowBegin(&lan)) {          // no radio: say so rather than hanging
    lan.state = LINK_REFUSED;
    return;
  }
  // BOTH sides announce. Which of them ends up hosting is settled by id inside
  // the hello, so the buttons are only a preference -- two players who both tap
  // HOST still get a working fight instead of two authorities, and two who both
  // tap JOIN still get one instead of mutual silence.
  lan.start();
}

void lanTap(int16_t x, int16_t y) {
  if (lan.state == LINK_OFF || lan.state == LINK_REFUSED ||
      lan.state == LINK_LOST) {
    for (int i = 0; i < 2; i++) {
      int by = 120 + i * 70;
      if (x < 90 || x > 376 || y < by || y > by + 56) continue;
      // An egg has nobody to bring. There used to be a team picker here; with
      // one partner there is nothing to pick, so HOST and JOIN go straight on.
      if (pet.isEgg()) { sfxPlay(SFX_DENY); return; }
      sfxPlay(SFX_TAP);
      lanWantHost = (i == 0);
      lanOffer(lanWantHost);
      return;
    }
  } else if (lan.state == LINK_READY) {
    if (x >= 120 && x <= 346 && y >= 220 && y <= 276) {
      sfxPlay(SFX_TAP);
      lanOpen = false;
      startLinkBattle();
      return;
    }
  } else if (lan.state == LINK_DONE) {
    if (x >= 120 && x <= 346 && y >= 220 && y <= 276) {
      sfxPlay(SFX_TAP);
      lan.sendRematch();      // both sides go back to READY and tap FIGHT
      return;
    }
  }
  if (y > 370) { lanLeave(); lanOpen = false; }   // back
}

// ---------- boss list ----------
void renderGyms() {
  gfx->fillScreen(RGB565_BLACK);
  gfx->fillCircle(CX, CY, 231, UI_BG_DAY);
  char title[28];
  snprintf(title, sizeof(title), T(S_BADGES_FMT), pet.badgeCount(gymHard));
  gfx->setTextColor(UI_INK);
  gfx->setTextSize(2);
  gfx->setCursor(CX - (int)strlen(title) * 6, 42);
  gfx->print(title);
  // difficulty pill: hard brings better boss IVs and a smarter AI, so it is a
  // different ladder with its own badges rather than a damage multiplier
  const char *dif = T(gymHard ? S_HARD : S_EASY);
  int dw = (int)strlen(dif) * 12 + 48;      // wider as well as taller
  if (dw < 120) dw = 120;
  gfx->fillRoundRect(CX - dw / 2, GYMDIF_Y, dw, GYMDIF_H, 12,
                     gymHard ? UI_BAR_BAD : UI_TRACK);
  gfx->setTextColor(gymHard ? UI_BG_DAY : UI_INK);
  gfx->setTextSize(2);
  gfx->setCursor(CX - (int)strlen(dif) * 6, GYMDIF_Y + 14);
  gfx->print(dif);

  for (int i = 0; i < GYM_ROWS; i++) {
    uint8_t idx = gymPage * GYM_ROWS + i;
    if (idx >= TRAINER_COUNT) break;
    const Trainer &t = TRAINERS[idx];
    int rx, y, rw, rh;
    gymRowRect(i, &rx, &y, &rw, &rh);
    bool done = pet.hasBadge(idx, gymHard);
    bool open_ = gymUnlocked(idx, gymHard);
    gfx->fillRoundRect(rx, y, rw, rh, 10, done ? UI_TRACK : UI_BG_DAY);
    gfx->drawRoundRect(rx, y, rw, rh, 10, open_ ? UI_INK : UI_TRACK);
    gfx->setTextColor(open_ ? UI_INK : UI_TRACK);
    gfx->setTextSize(2);
    gfx->setCursor(rx + 14, y + 8);
    gfx->print(t.name);
    gfx->setTextSize(1);
    gfx->setTextColor(UI_INK_SOFT);
    gfx->setCursor(rx + 14, y + 28);
    gfx->print(open_ ? t.place : T(S_LOCKED));
    // the level of the one Digimon it fights with: the honest measure of the wall
    char lv[16];
    snprintf(lv, sizeof(lv), "Lv.%u", (unsigned)t.level);
    gfx->setTextColor(done ? UI_BAR_OK : (open_ ? UI_INK : UI_TRACK));
    gfx->setCursor(rx + rw - 12 - (int)strlen(lv) * 6, y + 28);
    gfx->print(lv);
    if (done) {
      gfx->setTextColor(UI_BAR_OK);
      gfx->setCursor(rx + rw - 26, y + 8);
      gfx->print("*");
    }
  }
  gfx->fillRoundRect(GYMBTN_X, GYMBTN_Y, GYMBTN_W, GYMBTN_H, 11, UI_BG_DAY);
  gfx->drawRoundRect(GYMBTN_X, GYMBTN_Y, GYMBTN_W, GYMBTN_H, 11, UI_INK);
  gfx->setTextColor(UI_INK);
  gfx->setTextSize(2);
  gfx->setCursor(GYMBTN_X + (GYMBTN_W - (int)strlen(T(S_LAN)) * 12) / 2, GYMBTN_Y + 14);
  gfx->print(T(S_LAN));
  uiChrome();
  gfx->flush();
}

// ---------- level-up learn prompt ----------
void renderLearn() {
  gfx->fillScreen(RGB565_BLACK);
  gfx->fillCircle(CX, CY, 231, UI_BG_DAY);
  uint16_t mv = pet.learnOffer();
  char head[40];
  const char *nm = pet.nick[0] ? pet.nick : TS_DEX_TBL[pet.speciesId].name;
  snprintf(head, sizeof(head), T(S_LEARN_Q), nm);
  gfx->setTextColor(UI_INK);
  gfx->setTextSize(1);
  gfx->setCursor(CX - (int)strlen(head) * 3, 48);
  gfx->print(head);
  gfx->setTextColor(dexAccent(pet.speciesId));
  const char *move = moveName(mv);
  int moveSize = strlen(move) <= 17 ? 3 : (strlen(move) <= 26 ? 2 : 1);
  gfx->setTextSize(moveSize);
  gfx->setCursor(CX - (int)strlen(move) * moveSize * 3, moveSize == 3 ? 66 : 72);
  gfx->print(move);

  for (int i = 0; i < MOVE_SLOTS; i++) drawMoveRow(LEARN_ROW_Y(i), pet.moves[i], false, pet.speciesId);

  gfx->fillRoundRect(70, LEARN_SKIP_Y, 326, 44, 12, UI_TRACK);
  gfx->drawRoundRect(70, LEARN_SKIP_Y, 326, 44, 12, UI_INK);
  gfx->setTextColor(UI_INK);
  gfx->setTextSize(2);
  gfx->setCursor(CX - strlen(T(S_LEARN_SKIP)) * 6, LEARN_SKIP_Y + 14);
  gfx->print(T(S_LEARN_SKIP));
  gfx->flush();
}

// page 2: medals with a descriptive label
void renderCardMedals() {
  int got = 0;
  for (int i = 0; i < MED_COUNT; i++)
    if (pet.hasMedal(1 << i)) got++;
  char head[20];
  snprintf(head, sizeof(head), T(S_MEDALS_FMT), got, MED_COUNT);
  gfx->setTextColor(UI_INK);
  gfx->setTextSize(3);
  gfx->setCursor(CX - strlen(head) * 9, 48);
  gfx->print(head);

  for (int i = 0; i < MED_COUNT; i++) {
    int x = 28 + (i % 2) * 206, y = 104 + (i / 2) * 54;
    bool g = pet.hasMedal(1 << i);
    gfx->fillRoundRect(x, y, 196, 44, 10, g ? UI_BAR_OK : UI_TRACK);
    if (g) {  // earned mark
      gfx->fillCircle(x + 22, y + 22, 11, UI_BG_DAY);
      gfx->setTextColor(UI_BAR_OK);
      gfx->setTextSize(2);
      gfx->setCursor(x + 16, y + 13);
      gfx->print("v");
    }
    gfx->setTextColor(g ? UI_BG_DAY : 0x8410);
    gfx->setTextSize(2);
    gfx->setCursor(x + 44, y + 14);
    gfx->print(medalDesc(i));
  }
}

// page 3: progress (level, evolution, neglect) - brings to light mechanics
// that used to be invisible (how far to the next level/evolution and why)
void renderCardProgress() {
  gfx->setTextColor(UI_INK);
  gfx->setTextSize(3);
  gfx->setCursor(CX - strlen(T(S_PROGRESS)) * 9, 44);
  gfx->print(T(S_PROGRESS));

  // big level
  char lv[10];
  snprintf(lv, sizeof(lv), T(S_LVL_FMT), pet.level());
  gfx->setTextSize(5);
  gfx->setCursor(CX - strlen(lv) * 15, 86);
  gfx->print(lv);

  // progress bar to the next level (1 level = 60 min of play)
  uint8_t into = pet.ageMinutes % MINUTES_PER_LEVEL;
  int bx = 93, bw = 280, by = 158, bh = 22;
  gfx->fillRoundRect(bx, by, bw, bh, 6, UI_TRACK);
  int fw = (bw - 4) * into / MINUTES_PER_LEVEL;
  if (fw > 0) gfx->fillRoundRect(bx + 2, by + 2, fw, bh - 4, 5, UI_BAR_OK);
  char nx[26];
  snprintf(nx, sizeof(nx), T(S_NEXT_LVL_FMT), MINUTES_PER_LEVEL - into, pet.level() + 1);
  gfx->setTextColor(UI_INK);
  gfx->setTextSize(2);
  gfx->setCursor(CX - strlen(nx) * 6, by + 32);
  gfx->print(nx);

  // evolution status
  gfx->setTextColor(UI_INK_SOFT);
  gfx->setCursor(CX - strlen(T(S_EVO_LABEL)) * 6, 230);
  gfx->print(T(S_EVO_LABEL));
  char evoBuf[28];
  const char *evo;
  uint16_t evoCol = UI_INK;
  const uint8_t needed = pet.evoNextLevel();
  if (!needed) {
    evo = T(S_FINAL_FORM);
  } else if (pet.level() >= needed) {
    // The clock is done. Either a branch is open, or its stat or age minimums are
    // not met yet. routeMet() is what decides both, so this cannot promise a
    // digivolution that then does not happen.
    if (pet.digiTarget()) { evo = T(S_EVO_READY); evoCol = UI_BAR_OK; }
    else { evo = T(S_EVO_BLOCKED); evoCol = UI_BAR_WARN; }
  } else {
    snprintf(evoBuf, sizeof(evoBuf), T(S_EVO_IN_FMT), needed - pet.level());
    evo = evoBuf;
  }
  gfx->setTextColor(evoCol);
  gfx->setCursor(CX - strlen(evo) * 6, 256);
  gfx->print(evo);

  // the day inherited from an early retire, said out loud -- otherwise this
  // creature simply digivolves late and the player has no way to know why
  if (pet.evoPenalty()) {
    gfx->setTextSize(1);
    gfx->setTextColor(UI_BAR_WARN);
    gfx->setCursor(CX - (int)strlen(T(S_EVO_SLOW)) * 3, 286);
    gfx->print(T(S_EVO_SLOW));
    gfx->setTextSize(2);
  }

  // care mistakes this stage
  char ms[28];
  snprintf(ms, sizeof(ms), T(S_MISTAKES_FMT), pet.careMistakes);
  gfx->setTextColor(pet.careMistakes > 0 ? UI_BAR_BAD : UI_INK);
  gfx->setCursor(CX - strlen(ms) * 6, 312);
  gfx->print(ms);
  // ...and the training total, which is what opens the later branches
  char tt[28];
  snprintf(tt, sizeof(tt), T(S_TRAIN_TOTAL_FMT), pet.trainingTotal());
  gfx->setTextColor(UI_INK);
  gfx->setCursor(CX - strlen(tt) * 6, 338);
  gfx->print(tt);
}

void renderCard() {
  gfx->fillScreen(RGB565_BLACK);
  gfx->fillCircle(CX, CY, 231, UI_BG_DAY);
  if (cardPage == 0) renderCardProfile();
  else if (cardPage == 1) renderCardStats();
  else if (cardPage == 2) renderCardMoves();
  else renderCardProgress();

  // page indicator + help
  for (int i = 0; i < CARD_PAGES; i++) {
    int dx = CX - (CARD_PAGES - 1) * 13 + i * 26;
    if (i == cardPage) gfx->fillCircle(dx, 374, 5, UI_INK);
    else gfx->drawCircle(dx, 374, 4, UI_INK);
  }
  // De-digivolving into a form already in the Digidex. Declining moves this on to the
  // next earlier form, so one button reaches them all. It takes the back hint's place:
  // a tap anywhere else on the page still goes back.
  if (cardPage == CARD_PROGRESS_PAGE && devolveTarget()) {
    gfx->fillRoundRect(DEVO_BTN_X, DEVO_BTN_Y, DEVO_BTN_W, DEVO_BTN_H, 11, UI_TRACK);
    gfx->drawRoundRect(DEVO_BTN_X, DEVO_BTN_Y, DEVO_BTN_W, DEVO_BTN_H, 11, UI_INK);
    gfx->setTextColor(UI_INK);
    gfx->setTextSize(2);
    gfx->setCursor(CX - (int)strlen(T(S_DEVOLVE)) * 6, DEVO_BTN_Y + 14);
    gfx->print(T(S_DEVOLVE));
  } else {
    gfx->setTextColor(UI_INK_SOFT);
    gfx->setTextSize(2);
    gfx->setCursor(CX - strlen(T(S_BACK)) * 6, 398);
    gfx->print(T(S_BACK));
  }
  uiChrome();
  gfx->flush();
}

// ---------- menu overlay ----------

// Row labels are built fresh each frame because two of them carry live counts.
static void menuRowLabel(int i, char *out, size_t n) {
  switch (i) {
    case 0: snprintf(out, n, "%s", T(S_STATS)); break;
    case 1: snprintf(out, n, "%s", T(S_BAG)); break;
    case 2: snprintf(out, n, T(S_DIGIDEX_FMT), pet.registeredCount(), DEX_COUNT); break;
    case 3: snprintf(out, n, "%s", T(S_SETTINGS)); break;
    case 4: snprintf(out, n, "%s", T(S_RETIRE)); break;
    default: snprintf(out, n, "%s", T(S_CLOSE)); break;
  }
}

// Where a menu row is, asked of the firmware rather than restated.
//
// touch_test held the literal `104 + 16 + 22` next to a comment claiming it was
// MENU_ROW_Y(0) + 22 -- which it never was. It landed one pixel inside row 0
// and passed for that reason alone, until the panel gained a sixth row and the
// same tap started opening the BAG. A test that keeps its own copy of a layout
// proves the transcription; see CLAUDE.md on rpickPageCount() and
// uiButtonHeights(), which exist for exactly this.
int uiMenuRowCenterY(int i) { return MENU_ROW_Y(i) + MENU_ROW_H / 2; }

void drawMenu() {
  // dim the game behind the panel so the overlay reads as modal, and so it is
  // obvious that tapping the darkened area is a way out
  for (int y = 0; y < 466; y += 2)
    gfx->drawFastHLine(0, y, 466, gNight ? 0x0000 : 0x2104);

  gfx->fillRoundRect(MENU_X, MENU_Y, MENU_W, MENU_H, 18, UI_WHITE);
  gfx->drawRoundRect(MENU_X, MENU_Y, MENU_W, MENU_H, 18, UI_INK);

  for (int i = 0; i < MENU_ROWS; i++) {
    int y = MENU_ROW_Y(i);
    bool close = (i == MENU_ROWS - 1);
    bool dead = (i == 4 && !pet.canRetireNow());   // an egg or a companion
    gfx->fillRoundRect(MENU_X + 18, y, MENU_W - 36, MENU_ROW_H, 12,
                       close || dead ? UI_TRACK : UI_BG_DAY);
    gfx->drawRoundRect(MENU_X + 18, y, MENU_W - 36, MENU_ROW_H, 12, UI_INK);
    char lbl[28];
    menuRowLabel(i, lbl, sizeof(lbl));
    gfx->setTextColor(UI_INK);
    gfx->setTextSize(2);
    gfx->setCursor(CX - (int)strlen(lbl) * 6, y + MENU_ROW_H / 2 - 8);
    gfx->print(lbl);
  }
}


// ---------- the bag ----------

// How many pages the field bag needs. One even when empty, so the screen can
// say so instead of drawing nothing and reading as a crash.
uint8_t bagPages() {
  uint8_t n = bag.distinctCount();
  return n ? (uint8_t)((n + BAG_PER_PAGE - 1) / BAG_PER_PAGE) : 1;
}

int uiBagRowCenterY(int i) { return BAG_ROW_Y(i) + 25; }

// A toast over the bag: what the last item did. Not a dialog -- using a vitamin
// is not a decision, and a confirmation for every tap would make training worse
// than the punching bag it competes with.
static char bagMsg[40] = "";
static uint32_t bagMsgUntil = 0;

static void bagSay(const char *fmt, const char *arg) {
  snprintf(bagMsg, sizeof(bagMsg), fmt, arg);
  bagMsgUntil = millis() + 2200;
}

// Applies a field item to the live pet. Returns false when the item was valid
// but had nothing to do -- a fully trained stat, say -- which the caller reports
// rather than silently consuming the item.
static bool bagUseOnPet(ItemKey k) {
  const ItemEntry &e = itemEntry(k);
  if (e.category != IC_TRAIN) return false;
  // The ceiling applies here exactly as it does to the punching bag and to a boss
  // reward.
  uint8_t *cur;
  uint8_t cap;
  switch ((uint8_t)e.param) {
    case TRAIN_ATK: cur = &pet.trAtk; cap = pet.trMaxAtk(); break;
    case TRAIN_DEF: cur = &pet.trDef; cap = pet.trMaxDef(); break;
    default:        cur = &pet.trSpe; cap = pet.trMaxSpe(); break;
  }
  if (*cur >= cap) return false;
  uint16_t next = (uint16_t)*cur + e.amount;
  *cur = next > cap ? cap : (uint8_t)next;
  pet.saveNow();
  return true;
}

void renderBag() {
  gfx->fillScreen(RGB565_BLACK);
  gfx->fillCircle(CX, CY, 231, UI_BG_DAY);
  gfx->setTextColor(UI_INK);
  gfx->setTextSize(2);
  gfx->setCursor(CX - (int)strlen(T(S_BAG)) * 6, 40);
  gfx->print(T(S_BAG));

  uint8_t n = bag.distinctCount();
  uint8_t pages = bagPages();
  if (bagPage >= pages) bagPage = 0;
  if (!n) {
    gfx->setTextColor(UI_INK_SOFT);
    gfx->setCursor(CX - (int)strlen(T(S_BAG_EMPTY)) * 6, CY - 8);
    gfx->print(T(S_BAG_EMPTY));
  }
  for (uint8_t i = 0; i < BAG_PER_PAGE; i++) {
    uint8_t idx = (uint8_t)(bagPage * BAG_PER_PAGE + i);
    if (idx >= n) break;
    ItemKey k = bag.keyAt(idx);
    int y = BAG_ROW_Y(i);
    bool usable = itemUsableInField(k);
    gfx->fillRoundRect(76, y, 314, 50, 10, usable ? UI_WHITE : UI_TRACK);
    gfx->drawRoundRect(76, y, 314, 50, 10, UI_INK);
    gfx->setTextColor(usable ? UI_INK : 0x8410);
    gfx->setTextSize(2);
    gfx->setCursor(92, y + 17);
    gfx->print(itemEntry(k).name);
    char cnt[8];
    snprintf(cnt, sizeof(cnt), "x%u", bag.count(k));
    gfx->setCursor(374 - (int)strlen(cnt) * 12, y + 17);
    gfx->print(cnt);
  }
  // A page NUMBER, not a dot row: the catalogue is append-only and a dot per
  // page stopped fitting the round panel once the Digidex reached 25 of them.
  if (pages > 1) {
    char pg[12];
    snprintf(pg, sizeof(pg), "%u/%u", bagPage + 1, pages);
    gfx->setTextColor(UI_INK);
    gfx->setTextSize(2);
    gfx->setCursor(CX - (int)strlen(pg) * 6, 386);
    gfx->print(pg);
  }
  if (bagMsgUntil && millis() < bagMsgUntil) {
    gfx->fillRoundRect(66, CY - 26, 334, 52, 12, UI_WHITE);
    gfx->drawRoundRect(66, CY - 26, 334, 52, 12, UI_INK);
    gfx->setTextColor(UI_INK);
    gfx->setTextSize(2);
    gfx->setCursor(CX - (int)strlen(bagMsg) * 6, CY - 8);
    gfx->print(bagMsg);
  }
  gfx->setTextColor(UI_INK_SOFT);
  gfx->setTextSize(2);
  gfx->setCursor(CX - (int)strlen(T(S_BACK)) * 6, 414);
  gfx->print(T(S_BACK));
  uiChrome();
  gfx->flush();
}

void bagTap(int16_t x, int16_t y) {
  uint8_t n = bag.distinctCount();
  for (uint8_t i = 0; i < BAG_PER_PAGE; i++) {
    uint8_t idx = (uint8_t)(bagPage * BAG_PER_PAGE + i);
    if (idx >= n) break;
    int ry = BAG_ROW_Y(i);
    if (x < 76 || x > 390 || y < ry || y > ry + 50) continue;
    ItemKey k = bag.keyAt(idx);
    if (!itemUsableInField(k) || pet.isEgg()) { sfxPlay(SFX_DENY); return; }
    if (!bagUseOnPet(k)) { sfxPlay(SFX_DENY); bagSay("%s", T(S_ITEM_NOUSE)); return; }
    bag.consume(k);
    sfxPlay(SFX_TAP);
    bagSay(T(S_ITEM_USED), itemEntry(k).name);
    return;
  }
  bagOpen = false;   // anywhere else closes, like every other list screen
}

// ---------- wild encounters ----------

// Rolls a wild Digimon and opens the fight. The stand-in for phase 2's wild rules.
bool startWildBattle(bool hard) {
  if (pet.isEgg() || pet.ceremony != CER_NONE) return false;
  if (!gArtPack) return false;
  // The level first: it decides which STAGE can turn up. A level-10 encounter
  // is a Rookie, never a Champion that has not had time to exist.
  uint8_t lo = wildLevelMin(pet.level(), hard);
  uint8_t hi = wildLevelMax(pet.level(), hard);
  uint8_t lvl = (uint8_t)(lo + random(hi - lo + 1));
  uint8_t stage = wildStageFor(lvl, (uint8_t)random(100));
  int16_t dex = wildPickSpecies(stage, (uint32_t)random(65536) * 31u + random(31));
  // A stage can be empty (no Mega+ form has art): step down rather than refuse,
  // since "nothing happened" reads as a broken button.
  for (int st = (int)stage - 1; !dex && st >= TS_ST_IN_TRAINING_2; st--)
    dex = wildPickSpecies((uint8_t)st, random(65536));
  if (!dex) return false;
  wildDex = dex;
  wildLvl = lvl;
  // Bonus 0: nothing in this build earns one yet, so every wild variant is the
  // flat 1/4096. The parameter stays because it is where a farewell reward
  // would land, and wild_test already pins the curve it would follow.
  wildVariant = wildVariantForRoll((uint32_t)random(WILD_VARIANT_SCALE), 0);
  wildDropN = 0;

  if (!buildPartner(0)) return false;

  foeFromSpecies(btlFoe, dex, wildLvl, wildVariant);
  btlFoe.variant = wildVariant;

  btlWild = true;
  btlLink = false;
  btlTrainer = -1;
  btlHard = hard;
  btlMsgCount = 0;
  btlOver = false;
  btlWon = false;
  btlMenu = 0;
  btlBagPage = 0;
  btlWinUntil = 0;
  btlFaintUntil[0] = btlFaintUntil[1] = 0;
  btlHpShown[0] = btlYou.maxHp;
  btlHpShown[1] = btlFoe.maxHp;
  btlSyncSprite(0, btlYou);
  btlSyncSprite(1, btlFoe);
  audioMusic(MUS_BATTLE);
  btlLungeUntil[0] = btlLungeUntil[1] = 0;
  btlHitUntil[0] = btlHitUntil[1] = 0;
  battleOpen = true;
  btlSay(T(S_WILD_MET), TS_DEX_TBL[dex].name);
  return true;
}


// ---------- training submenu (5th icon) ----------

// Bars here show progress toward the IV-capped ceiling, not a raw stat: 100%
// means this individual cannot train the stat any higher, which is the whole
// point of trMaxFor() gating training by IV.
static uint8_t trainPct(uint8_t cur, uint8_t cap) {
  return cap ? (uint8_t)((uint16_t)cur * 100 / cap) : 0;
}

void renderTrain() {
  for (int y = 0; y < 466; y += 2)
    gfx->drawFastHLine(0, y, 466, gNight ? 0x0000 : 0x2104);

  gfx->fillRoundRect(TRAIN_X, TRAIN_Y, TRAIN_W, TRAIN_H, 18, UI_WHITE);
  gfx->drawRoundRect(TRAIN_X, TRAIN_Y, TRAIN_W, TRAIN_H, 18, UI_INK);

  gfx->setTextColor(UI_INK);
  gfx->setTextSize(2);
  gfx->setCursor(CX - (int)strlen(T(S_TRAIN)) * 6, TRAIN_Y + 20);
  gfx->print(T(S_TRAIN));

  const char *lbl[TRAIN_ROWS] = { T(S_TR_ATK), T(S_TR_SPE), T(S_TR_DEF), T(S_MEMO) };
  uint8_t cur[TRAIN_ROWS] = { pet.trAtk, pet.trSpe, pet.trDef, 0 };
  uint8_t cap[TRAIN_ROWS] = { pet.trMaxAtk(), pet.trMaxSpe(), pet.trMaxDef(), 0 };

  for (int i = 0; i < TRAIN_ROWS; i++) {
    int y = TRAIN_ROW_Y(i);
    gfx->fillRoundRect(TRAIN_X + 18, y, TRAIN_W - 36, TRAIN_ROW_H, 12, UI_BG_DAY);
    gfx->drawRoundRect(TRAIN_X + 18, y, TRAIN_W - 36, TRAIN_ROW_H, 12, UI_INK);
    gfx->setTextColor(UI_INK);
    gfx->setTextSize(2);
    gfx->setCursor(TRAIN_X + 32, y + 8);
    gfx->print(lbl[i]);

    // The MEMORY row has no bar, because it trains no stat -- it pays in joy and
    // bond. Drawing a progress bar for it would promise a ceiling to fill, and
    // there is none; the record goes there instead, which is what it does have.
    if (i == TRAIN_ROW_MEMO) {
      char r[22];
      snprintf(r, sizeof(r), T(S_REC_FMT), pet.memoHi);
      gfx->setTextColor(UI_INK_SOFT);
      gfx->setTextSize(1);
      gfx->setCursor(TRAIN_X + 32, y + 30);
      gfx->print(r);
      continue;
    }
    uint8_t pct = trainPct(cur[i], cap[i]);
    int bx = TRAIN_X + 32, bw = TRAIN_W - 64, bh = 10, by = y + 30;
    gfx->fillRoundRect(bx, by, bw, bh, 4, UI_TRACK);
    int fw = (bw - 4) * pct / 100;
    if (fw > 0)
      gfx->fillRoundRect(bx + 2, by + 2, fw, bh - 4, 3, pct >= 100 ? UI_BAR_OK : UI_BAR_WARN);
  }

  gfx->setTextColor(UI_INK);
  gfx->setTextSize(1);
  gfx->setCursor(CX - (int)strlen(T(S_TR_DEF_HINT)) * 3, TRAIN_Y + TRAIN_H - 22);
  gfx->print(T(S_TR_DEF_HINT));
  gfx->flush();   // without this the panel never updates and the screen freezes
}

// ---------- keyboard for renaming ----------

static const char KB_KEYS[] = "ABCDEFGHIJKLMNOPQRSTUVWXYZ.-";  // 28 + DEL + OK = 30
#define KB_COLS 6
#define KB_X 40
#define KB_Y 150
#define KB_W 64
#define KB_H 52

// The keyboard is shared, so it has to be told what it is naming. It used to
// hardcode pet.rename() on commit, which is why a second caller needed this.
void openKeyboardFor(uint8_t target) {
  kbTarget = target;
  kbOpen = true;
  const char *cur = (target == KB_TRAINER) ? pet.trainerName : pet.nick;
  strncpy(nameBuf, cur, sizeof(nameBuf) - 1);
  nameBuf[sizeof(nameBuf) - 1] = 0;
  nameLen = strlen(nameBuf);
}
void openKeyboard() { openKeyboardFor(KB_PET); }

void renderKeyboard() {
  gfx->fillScreen(RGB565_BLACK);
  gfx->fillCircle(CX, CY, 231, UI_BG_DAY);
  gfx->setTextColor(UI_INK);
  gfx->setTextSize(2);
  gfx->setCursor(CX - strlen(T(S_NAME)) * 6, 56);
  gfx->print(T(S_NAME));
  // buffer actual
  gfx->fillRoundRect(83, 84, 300, 40, 8, UI_WHITE);
  gfx->drawRoundRect(83, 84, 300, 40, 8, UI_INK);
  gfx->setTextSize(3);
  gfx->setCursor(95, 94);
  gfx->print(nameLen ? nameBuf : "_");

  for (int i = 0; i < 30; i++) {
    int x = KB_X + (i % KB_COLS) * KB_W, y = KB_Y + (i / KB_COLS) * KB_H;
    bool special = (i >= 28);
    gfx->fillRoundRect(x, y, KB_W - 6, KB_H - 6, 6, special ? UI_BAR_WARN : UI_WHITE);
    gfx->drawRoundRect(x, y, KB_W - 6, KB_H - 6, 6, UI_INK);
    gfx->setTextColor(UI_INK);
    gfx->setTextSize(2);
    if (i < 28) {
      gfx->setCursor(x + KB_W / 2 - 9, y + KB_H / 2 - 10);
      gfx->print(KB_KEYS[i]);
    } else {
      const char *lab = (i == 28) ? "<-" : "OK";
      gfx->setCursor(x + KB_W / 2 - 15, y + KB_H / 2 - 10);
      gfx->print(lab);
    }
  }
  gfx->flush();
}

void keyboardTap(int16_t x, int16_t y) {
  int col = (x - KB_X) / KB_W, row = (y - KB_Y) / KB_H;
  if (col < 0 || col >= KB_COLS || row < 0 || row >= 5) return;
  int i = row * KB_COLS + col;
  if (i >= 30) return;
  if (i == 28) {  // borrar
    if (nameLen) nameBuf[--nameLen] = 0;
  } else if (i == 29) {  // OK
    if (kbTarget == KB_TRAINER) pet.renameTrainer(nameBuf);
    else pet.rename(nameBuf);
    kbOpen = false;
  } else if (nameLen < sizeof(nameBuf) - 1) {
    nameBuf[nameLen++] = KB_KEYS[i];
    nameBuf[nameLen] = 0;
  }
}

// ---------- digidex gallery ----------

#define GAL_X 73
#define GAL_Y 84
#define GAL_CELL 80

// draws a thumbnail centred in its cell; sil=true paints it in ink
void drawThumb(const uint8_t *b, int x, int y, int s, bool sil) {
  uint8_t w = b[0], h = b[1], n = b[2];
  const uint8_t *pal = b + 3;
  const uint8_t *d = pal + n * 2;
  int ox = x + (GAL_CELL - w * s) / 2;
  int oy = y + (GAL_CELL - h * s) / 2;
  for (int r = 0; r < h; r++) {
    for (int c = 0; c < w; c++) {
      uint8_t idx = d[r * w + c];
      if (idx == 0xFF) continue;
      uint16_t col = sil ? INK_K : (uint16_t)(pal[idx * 2] | (pal[idx * 2 + 1] << 8));
      gfx->fillRect(ox + c * s, oy + r * s, s, s, col);
    }
  }
}

// ---------------------------------------------------------------------------
// The filter, as four small functions. THE draw path and THE tap path both go
// through galleryAt(), which is the whole point: with a filter on, the grid is no
// longer contiguous, so the cell arithmetic that used to be repeated in both
// places would put a tap on a different creature than the one drawn.

bool galleryPass(int16_t dex) {
  if (!speciesHasArt(dex)) return false;   // a form with no art has no entry yet
  switch (galleryFilter) {
    case GFILT_RAISED: return pet.isRegistered(dex);
    case GFILT_VARIANT:  return pet.isVariantRegistered(dex);
    default: return true;
  }
}

uint16_t galleryCount() {
  uint16_t n = 0;
  for (int16_t d = 1; d <= DEX_COUNT; d++)
    if (galleryPass(d)) n++;
  return n;
}

// The dex number at a visual grid position, or 0 past the end.
int16_t galleryAt(uint16_t visual) {
  uint16_t n = 0;
  for (int16_t d = 1; d <= DEX_COUNT; d++) {
    if (!galleryPass(d)) continue;
    if (n == visual) return d;
    n++;
  }
  return 0;
}

// At least one page even when the filter matches nothing, so the screen can SAY
// so rather than drawing an empty grid that reads as a crash.
uint8_t galleryPages() {
  const uint16_t n = galleryCount();
  const uint8_t p = (uint8_t)((n + GAL_PER_PAGE - 1) / GAL_PER_PAGE);
  return p ? p : 1;
}

const char *galleryFilterName() {
  switch (galleryFilter) {
    case GFILT_RAISED: return T(S_FILT_RAISED);
    case GFILT_VARIANT:  return T(S_FILT_VARIANT);
    default: return T(S_FILT_ALL);
  }
}

// Cycling the filter can leave the page past the end of a shorter result, and a
// page number beyond the count draws nothing at all. One place fixes it, called
// by everything that changes either the filter or the version.
void galleryClampPage() {
  const uint8_t n = galleryPages();
  if (galleryPage >= n) galleryPage = n - 1;
}

void renderGallery() {
  if (galleryDetail) {  // detail view: always redrawn (animated)
    gfx->fillScreen(RGB565_BLACK);
    gfx->fillCircle(CX, CY, 231, UI_BG_DAY);
    const TsDexEntry &d = TS_DEX_TBL[galleryDetail];
    bool reg = pet.isRegistered(galleryDetail);
    char head[24];
    snprintf(head, sizeof(head), "N.%03d %s%s", galleryDetail,
             pet.isVariantRegistered(galleryDetail) ? "*" : "", reg ? d.name : "???");
    gfx->setTextColor(reg ? dexAccent(galleryDetail) : UI_INK);
    int glen = strlen(head);
    int gts = (glen <= 13) ? 3 : 2;  // auto-encoge nombres largos (no caben a t3)
    gfx->setTextSize(gts);
    gfx->setCursor(CX - glen * (gts == 3 ? 9 : 6), gts == 3 ? 56 : 60);
    gfx->print(head);
    if (galleryPmd.loaded) {
      // animated and in colour if registered; a static silhouette if not ("?" style)
      drawPmdActM(galleryPmd, PMD_IDLE, CX, 300, reg ? millis() : 0, true, !reg, 6);
    } else {
      const uint8_t *t = thumbs.get(galleryDetail);
      if (t) drawThumb(t, CX - GAL_CELL, 135, 4, !reg);
    }
    gfx->setTextColor(UI_INK);
    gfx->setTextSize(2);
    gfx->setCursor(CX - strlen(T(S_DETAIL_BACK)) * 6, 408);
    gfx->print(T(S_DETAIL_BACK));
    uiChrome();
    gfx->flush();
    return;
  }

  if (!galleryDirty) return;  // the grid is static
  galleryDirty = false;

  gfx->fillScreen(RGB565_BLACK);
  gfx->fillCircle(CX, CY, 231, UI_BG_DAY);
  char head[32];
  snprintf(head, sizeof(head), T(S_DIGIDEX_FMT), pet.registeredCount(), DEX_COUNT - NO_ART_COUNT);
  gfx->setTextColor(UI_INK);
  gfx->setTextSize(3);
  gfx->setCursor(CX - strlen(head) * 9, 36);
  gfx->print(head);
  // The filter, under the tally and tappable -- it has to be VISIBLE, or a filter
  // left on reads as a Digidex that lost half its entries. Says what it is
  // showing and how many, since "ALL 151" and "VARIANT 3" answer different
  // questions and the count is the interesting half.
  {
    char fl[32];
    snprintf(fl, sizeof(fl), "%s %u", galleryFilterName(), (unsigned)galleryCount());
    gfx->setTextColor(galleryFilter == GFILT_ALL ? UI_INK_SOFT : UI_BAR_WARN);
    gfx->setTextSize(1);
    gfx->setCursor(CX - (int)strlen(fl) * 3, 66);
    gfx->print(fl);
  }

  if (galleryCount() == 0) {
    // SAY SO. An empty grid is indistinguishable from a crash, and the filter
    // that caused it is one tap away.
    gfx->setTextColor(UI_INK_SOFT);
    gfx->setTextSize(2);
    gfx->setCursor(CX - strlen(T(S_FILT_NONE)) * 6, 220);
    gfx->print(T(S_FILT_NONE));
  }
  for (int r = 0; r < 4; r++) {
    for (int c = 0; c < 4; c++) {
      const uint16_t visual = (uint16_t)galleryPage * GAL_PER_PAGE + r * 4 + c;
      const int16_t dex = galleryAt(visual);
      if (!dex) break;                 // past the end of the filtered list
      int x = GAL_X + c * GAL_CELL, y = GAL_Y + r * GAL_CELL;
      const uint8_t *t = thumbs.get(dex);
      if (t) {
        drawThumb(t, x, y, 2, !pet.isRegistered(dex));
        if (pet.isVariantRegistered(dex)) {
          gfx->setTextColor(UI_BAR_WARN);
          gfx->setTextSize(2);
          gfx->setCursor(x + 62, y + 4);
          gfx->print("*");
        }
      } else {
        char num[6];
        snprintf(num, sizeof(num), "%d", dex);
        gfx->setTextColor(UI_INK_SOFT);
        gfx->setTextSize(2);
        gfx->setCursor(x + 24, y + 32);
        gfx->print(num);
      }
    }
  }
  // A page number, not a row of dots. 25 dots do not fit across the bottom of
  // a round panel -- the chord at that height is only ~228 px -- and counting
  // them to find where you are is worse than reading the number.
  char pg[12];
  snprintf(pg, sizeof(pg), "%d/%d", galleryPage + 1, (int)galleryPages());
  gfx->setTextColor(UI_INK_SOFT);
  gfx->setTextSize(2);
  gfx->setCursor(CX - (int)strlen(pg) * 6, 410);
  gfx->print(pg);
  uiChrome();
  gfx->flush();
}

void galleryTap(int16_t x, int16_t y) {
  if (galleryDetail) {  // back to the grid
    galleryDetail = 0;
    galleryPmd.unload();
    galleryDirty = true;
    return;
  }
  // The filter strip, BEFORE the exit band. It sits at y 66 inside what used to
  // be "tap the header to leave", so the two are split by height: the title band
  // still exits, the strip under it cycles.
  if (y >= 58 && y < 80) {
    galleryFilter = (uint8_t)((galleryFilter + 1) % GFILT_COUNT);
    galleryClampPage();
    galleryDirty = true;
    sfxPlay(SFX_TAP);
    return;
  }
  if (y < 58) {  // tap the top = leave
    galleryOpen = false;
    galleryPmd.unload();
    return;
  }
  int c = (x - GAL_X) / GAL_CELL, r = (y - GAL_Y) / GAL_CELL;
  if (c < 0 || c > 3 || r < 0 || r > 3) return;
  // The SAME function the grid was drawn from, so a tap cannot land on a
  // different creature than the one under the finger.
  const int16_t dex = galleryAt((uint16_t)galleryPage * GAL_PER_PAGE + r * 4 + c);
  if (!dex) return;
  galleryDetail = dex;
  galleryPmd.load(dex, pet.isVariantRegistered(dex));
  // Only for an entry the player has actually filled in. Playing the cry of a
  // silhouette would hand over the one thing the "???" is withholding.
  if (pet.isRegistered(dex)) audioCry(dex);
}

void drawBattery() {
  int pc = batPercent();
  if (pc < 0) return;  // no battery connected
  int x = CX - 14, y = 12, w = 24, h = 11;
  bool charging = batCharging();
  uint16_t col = charging ? UI_BAR_OK
                 : (pc >= 40) ? inkColor()
                 : (pc >= 15) ? UI_BAR_WARN
                              : UI_BAR_BAD;
  gfx->drawRoundRect(x, y, w, h, 2, col);
  gfx->fillRect(x + w, y + 3, 3, 5, col);  // borne
  if (charging) {
    // charging bolt (zigzag) instead of the level bar
    uint16_t bolt = C565(0xff, 0xd9, 0x4a);
    int bx = x + w / 2;
    gfx->fillTriangle(bx + 3, y + 1, bx - 4, y + 6, bx + 1, y + 6, bolt);
    gfx->fillTriangle(bx - 1, y + 5, bx + 4, y + 5, bx - 3, y + 10, bolt);
  } else {
    int fw = (w - 4) * pc / 100;
    if (fw > 0) gfx->fillRect(x + 2, y + 2, fw, h - 4, col);
  }
}

// Drawn beside the battery when Pet::saveHealthy() goes false (NVS would not
// open, or it has refused three writes in a row) OR when gNvsLow is set (the
// partition itself is close to full).
//
// The low-space case matters just as much: a full partition is erased WHOLE by
// the Arduino core on the NEXT BOOT (see nvsinfo.cpp), so a save can still be
// succeeding right up until a restart wipes every badge and every save on the
// device. `nvsLowOnSpace()` existed only in the serial HEALTH log before this,
// which is exactly how a player found out: by getting wiped, with no earlier
// sign on the one screen they were actually looking at.
//
// Deliberately not a dialog. The condition persists, so a modal would be
// dismissed once and then forgotten, and it is not actionable in the moment --
// what the player needs is to know before they put in another week, so they can
// EXPORT. The firmware could not say this at all before: the only symptom was a
// line on a serial port no player has attached.
void drawSaveWarning() {
  if (pet.saveHealthy() && !gNvsLow) return;
  const int x = CX - 40, y = 11, w = 13, h = 13;
  gfx->fillTriangle(x + w / 2, y, x, y + h, x + w, y + h, UI_BAR_BAD);
  gfx->fillRect(x + w / 2, y + 5, 2, 4, RGB565_BLACK);   // the "!"
  gfx->fillRect(x + w / 2, y + 10, 2, 2, RGB565_BLACK);
}

void drawHeader(const char *name, uint16_t nameColor, const char *msg) {
  drawBattery();
  drawSaveWarning();
  gfx->setTextColor(nameColor);
  gfx->setTextSize(3);
  gfx->setCursor(CX - strlen(name) * 9, HEADER_NAME_Y);
  gfx->print(name);
  gfx->setTextColor(inkColor());
  gfx->setTextSize(2);
  gfx->setCursor(CX - strlen(msg) * 6, 90);
  gfx->print(msg);
}

// ceremony animation (10s): farewell = a bow with hearts, then it
// walks away; runaway = it gets scared and runs off. Replaces the idle.
void drawCeremony() {
  if (!pmd.loaded) { drawPet(); return; }  // fallback if there is no PMD sprite
  uint32_t now = millis();
  float t = pet.ceremonyT();               // 0..1 across the 10s
  bool panic = (pet.ceremony == CER_RUNAWAY);
  int x = CX, y = PET_GROUND;
  uint8_t act = PMD_IDLE;

  if (panic) {
    // final triste: penumbra azulada + lluvia
    for (int i = 0; i < 46; i++) {
      int rx = (i * 47 + now / 3) % 466;
      int ry = (i * 91 + now / 2) % 470;
      gfx->drawLine(rx, ry, rx - 3, ry + 12, C565(0x6a, 0x84, 0xb0));
    }
    bool fade = false;
    if (t < 0.30f) {                       // head down, trembling
      act = pmd.has(PMD_HURT) ? PMD_HURT : PMD_IDLE;
      x = CX + (int)(4 * sinf(now * 0.04f));
    } else {                               // walks slowly away and fades out
      act = pmd.has(PMD_WALKL) ? PMD_WALKL : PMD_IDLE;
      x = CX - (int)(((t - 0.30f) / 0.70f) * (CX + 120));
      fade = (t > 0.6f) && ((now / 160) % 2 == 0);  // flickers toward the silhouette
    }
    drawPmdAct(act, x, y, now, true, fade, 5);  // fade=silhouette: it blurs as it leaves
    // a tear falling from the creature
    if (t < 0.55f) {
      int ty = y - 150 + (int)((now / 6) % 40);
      gfx->fillRect(x + 6, ty, 3, 6, C565(0x9a, 0xc4, 0xe8));
    }
    return;
  }

  // epic farewell: a pulsing golden halo + rising sparks and hearts
  int gcy = PET_GROUND - 96;
  for (int k = 0; k < 4; k++) {
    int r = 60 + k * 34 + (int)(10 * sinf(now * 0.02f));
    gfx->drawCircle(CX, gcy, r, C565(0xff, 0xdf, 0x8a));
  }
  for (int i = 0; i < 16; i++) {
    int px = (i * 71 + 28) % 466;
    int py = 410 - (int)((now / 8 + i * 70) % 360);   // they rise and reappear at the bottom
    if (py < 30) continue;
    if (i % 4 == 0) drawMap(SPR_HEART, 32, px - 8, py - 8, 1, false);  // little heart
    else gfx->fillRect(px, py, 4, 4, (i % 2) ? C565(0xff, 0xe7, 0x9f) : C565(0xff, 0x9a, 0xc0));
  }

  if (t < 0.45f) {                         // bow / farewell pose
    act = pmd.has(PMD_POSE) ? PMD_POSE : (pmd.has(PMD_NOD) ? PMD_NOD : PMD_IDLE);
  } else {                                 // walks off to the right
    act = pmd.has(PMD_WALKR) ? PMD_WALKR : PMD_IDLE;
    x = CX + (int)(((t - 0.45f) / 0.55f) * (CX + 140));
  }
  drawPmdAct(act, x, y, now, true, false, 5);
  if (pet.showHeart())                     // a big heart following the creature
    drawMap(SPR_HEART, 32, x + 50, y - 190, 2, false);
}

// decision dialog (2 stacked buttons): evolve/keep or say goodbye/stay together
// The two confirm buttons' hit areas, so a test can hold them to UI_TAP_MIN and
// prove they do not overlap without restating the numbers.
void uiConfirmRects(int *b1Top, int *b1Bot, int *b2Top, int *b2Bot) {
  *b1Top = CONFIRM_B1_Y;
  *b1Bot = CONFIRM_B1_Y + CONFIRM_BTN_H;
  *b2Top = CONFIRM_B2_Y;
  *b2Bot = CONFIRM_B2_Y + CONFIRM_BTN_H;
}

// Draws the panel and its two buttons. sub1/sub2 are optional lines between the
// question and the buttons -- what the choice COSTS, which for anything
// irreversible has to be on screen before the tap, not after it.
void drawConfirmPanel(const char *q, const char *sub1, const char *sub2,
                      uint16_t subCol, const char *o1, uint16_t c1, uint16_t t1,
                      const char *o2, uint16_t c2, uint16_t t2) {
  gfx->fillRoundRect(CONFIRM_X, CONFIRM_Y, CONFIRM_W, CONFIRM_H, 16, UI_WHITE);
  gfx->drawRoundRect(CONFIRM_X, CONFIRM_Y, CONFIRM_W, CONFIRM_H, 16, UI_INK);
  gfx->setTextColor(UI_INK);
  gfx->setTextSize(2);
  gfx->setCursor(CX - (int)strlen(q) * 6, 176);
  gfx->print(q);
  if (sub1 || sub2) {
    gfx->setTextSize(1);
    gfx->setTextColor(subCol);
    if (sub1) {
      gfx->setCursor(CX - (int)strlen(sub1) * 3, sub2 ? 188 : 194);
      gfx->print(sub1);
    }
    if (sub2) {
      gfx->setCursor(CX - (int)strlen(sub2) * 3, 197);
      gfx->print(sub2);
    }
    gfx->setTextSize(2);
    gfx->setTextColor(UI_INK);
  }
  gfx->fillRoundRect(CONFIRM_BTN_X, CONFIRM_B1_Y, CONFIRM_BTN_W, CONFIRM_BTN_H, 12, c1);
  gfx->setTextColor(t1);
  gfx->setCursor(CX - (int)strlen(o1) * 6, CONFIRM_B1_Y + 18);
  gfx->print(o1);
  gfx->fillRoundRect(CONFIRM_BTN_X, CONFIRM_B2_Y, CONFIRM_BTN_W, CONFIRM_BTN_H, 12, c2);
  gfx->setTextColor(t2);
  gfx->setCursor(CX - (int)strlen(o2) * 6, CONFIRM_B2_Y + 18);
  gfx->print(o2);
}

void drawChoiceDialog() {
  const char *q, *o1, *o2;
  const char *sub1 = nullptr, *sub2 = nullptr;
  uint16_t c1, c2, t1, t2;
  if (choiceKind == 1) {  // evolution
    // Named, because "keep form" is how a player passes over this branch for the next.
    q = T(S_EVO_Q); o1 = T(S_EVO_TAP); o2 = T(S_EVO_KEEP);
    c1 = UI_BAR_BAD; t1 = UI_WHITE; c2 = UI_TRACK; t2 = UI_INK;
    int16_t to = pet.digiTarget();
    if (to) sub1 = TS_DEX_TBL[to].name;
  } else if (choiceKind == 4) {   // de-digivolution
    q = T(S_DEVOLVE); o1 = T(S_YES); o2 = T(S_NO);
    c1 = UI_BAR_WARN; t1 = UI_INK; c2 = UI_TRACK; t2 = UI_INK;
    int16_t to = devolveTarget();
    if (to) sub1 = TS_DEX_TBL[to].name;
  } else if (choiceKind == 3) {   // retirement on request
    q = T(S_RETIRE_Q); o1 = T(S_FAR_GO); o2 = T(S_FAR_STAY);
    c1 = UI_BAR_WARN; t1 = UI_INK; c2 = UI_BAR_OK; t2 = UI_WHITE;
    // The price, spelled out, and only when there is one: retiring a creature
    // that has already earned its farewell costs nothing and must not claim to.
    // (It used to add "it will not join your party"; there is no party now.)
    if (!pet.retireIsFree()) sub1 = T(S_RETIRE_COST);
  } else {                // farewell
    q = T(S_FAR_Q); o1 = T(S_FAR_GO); o2 = T(S_FAR_STAY);
    c1 = UI_BAR_WARN; t1 = UI_INK; c2 = UI_BAR_OK; t2 = UI_WHITE;
  }
  drawConfirmPanel(q, sub1, sub2, UI_BAR_BAD, o1, c1, t1, o2, c2, t2);
}

// big red CTA button to evolve (pulses to draw attention)
void drawEvolveButton() {
  uint32_t now = millis();
  int p = (int)(5 * sinf(now * 0.006f));  // late: -5..5
  int x = EVO_BTN_X - p, y = EVO_BTN_Y - p, w = EVO_BTN_W + 2 * p, h = EVO_BTN_H + 2 * p;
  gfx->fillRoundRect(x, y, w, h, 18, UI_BAR_BAD);
  gfx->drawRoundRect(x, y, w, h, 18, UI_WHITE);
  gfx->drawRoundRect(x + 2, y + 2, w - 4, h - 4, 16, UI_WHITE);
  gfx->setTextColor(UI_WHITE);
  gfx->setTextSize(3);
  const char *t = T(S_EVO_TAP);
  gfx->setCursor(CX - (int)strlen(t) * 9, y + h / 2 - 11);
  gfx->print(t);
}

// golden farewell CTA button: "<name> wants to tell you something..."
void drawFarewellButton() {
  uint32_t now = millis();
  int p = (int)(4 * sinf(now * 0.005f));
  int x = FAR_BTN_X - p, y = FAR_BTN_Y - p, w = FAR_BTN_W + 2 * p, h = FAR_BTN_H + 2 * p;
  gfx->fillRoundRect(x, y, w, h, 16, UI_BAR_WARN);
  gfx->drawRoundRect(x, y, w, h, 16, UI_INK);
  char buf[52];
  const char *nm = pet.nick[0] ? pet.nick : TS_DEX_TBL[pet.speciesId].name;
  snprintf(buf, sizeof(buf), T(S_FAREWELL_BTN), nm);
  gfx->setTextColor(UI_INK);
  gfx->setTextSize(2);
  gfx->setCursor(CX - (int)strlen(buf) * 6, y + h / 2 - 8);
  gfx->print(buf);
}

// grim CTA button for running away from neglect: "<name> feels abandoned..."
// (sad ending: dark blue-grey, a slow, faint heartbeat)
void drawRunawayButton() {
  uint32_t now = millis();
  int p = (int)(3 * sinf(now * 0.003f));
  int x = FAR_BTN_X - p, y = FAR_BTN_Y - p, w = FAR_BTN_W + 2 * p, h = FAR_BTN_H + 2 * p;
  gfx->fillRoundRect(x, y, w, h, 16, C565(0x3a, 0x44, 0x5a));
  gfx->drawRoundRect(x, y, w, h, 16, C565(0x70, 0x80, 0x98));
  char buf[52];
  const char *nm = pet.nick[0] ? pet.nick : TS_DEX_TBL[pet.speciesId].name;
  snprintf(buf, sizeof(buf), T(S_RUNAWAY_BTN), nm);
  gfx->setTextColor(C565(0xc8, 0xd2, 0xe0));
  gfx->setTextSize(2);
  gfx->setCursor(CX - (int)strlen(buf) * 6, y + h / 2 - 8);
  gfx->print(buf);
}

// epic evolution animation: radial halo + spinning rays + flicker of the
// sprite speeding up + sparks shooting out + final flash
void drawEvolveFX(uint32_t now) {
  float t = pet.evolveT();          // 0..1
  int cx = CX, cy = PET_GROUND - 96;

  // radial halo that grows and pulses
  int halo = 36 + (int)(t * 150) + (int)(8 * sinf(now * 0.02f));
  for (int k = 0; k < 4; k++) {
    int r = halo - k * 7;
    if (r > 0) gfx->drawCircle(cx, cy, r, UI_WHITE);
  }
  // rays spinning from the creature's centre
  float base = now * 0.004f;
  for (int i = 0; i < 12; i++) {
    float a = base + i * (float)(PI / 6);
    int len = 90 + (int)(70 * (0.5f + 0.5f * sinf(now * 0.012f + i)));
    gfx->drawLine(cx, cy, cx + (int)(cosf(a) * len), cy + (int)(sinf(a) * len), UI_WHITE);
  }
  // flicker between the PREVIOUS and the NEW form (silhouettes), speeding up; at
  // the end (t>0.9) it holds on the new one for the reveal flash
  int period = 60 + (int)(220 * (1.0f - t));
  bool showOld = t < 0.9f && evoPmd.loaded && ((now / period) % 2) == 0;
  if (showOld) drawPmdActM(evoPmd, PMD_IDLE, cx, PET_GROUND, 0, true, true, 5);
  else drawPmdAct(PMD_IDLE, cx, PET_GROUND, 0, true, true, 5);
  // sparks shooting out
  for (int i = 0; i < 10; i++) {
    float a = i * (float)(PI / 5) + t * 4.0f;
    int d = (int)((now / 14 + i * 33) % 200);
    int sx = cx + (int)(cosf(a) * d), sy = cy + (int)(sinf(a) * d);
    gfx->fillRect(sx - 2, sy - 2, 5, 5, (i & 1) ? C565(0xff, 0xe0, 0x70) : UI_WHITE);
  }
  // final flash before revealing the new form
  if (t > 0.9f) gfx->fillCircle(cx, cy, (int)(300 * (t - 0.9f) / 0.1f), UI_WHITE);
}

void drawPet() {
  if (pmd.loaded) {
    drawPetPMD();
    return;
  }
  if (mon.loaded) {
    drawPetSD();
    return;
  }
  // No sprite on the card: say so plainly. There is no built-in art -- every
  // Digimon comes from the SD.
  gfx->setTextColor(inkColor());
  gfx->setTextSize(6);
  gfx->setCursor(CX - 18, PET_CY - 80);
  gfx->print("?");
  gfx->setTextSize(2);
  const char *l1 = T(S_NO_SPRITES);
  gfx->setCursor(CX - (int)strlen(l1) * 6, PET_CY - 4);
  gfx->print(l1);
  const char *l2 = T(S_LOAD_SPRITES);
  gfx->setCursor(CX - (int)strlen(l2) * 6, PET_CY + 20);
  gfx->print(l2);
}

// ---------- bath scene ----------

void startBath() {
  if (pet.isEgg() || pet.sleeping || pet.ceremony || bathUntil) return;
  bathUntil = millis() + 3000;
  bathPending = true;
  int cx = (int)beh.x;
  for (auto &b : bubbles) {
    b.x = cx - 70 + random(140);
    b.y = PET_GROUND - random(150);
    b.r = 8 + random(16);
    b.ph = random(64);
  }
}

void drawBath() {
  uint32_t now = millis();
  if (now > bathUntil) {
    bathUntil = 0;
    if (bathPending) {
      bathPending = false;
      pet.clean();
      // happy pose once clean
      if (pmd.has(PMD_POSE)) {
        beh.mode = 2;
        beh.act = PMD_POSE;
        beh.t0 = now;
        beh.until = now + pmdActTotalMs(pmd.acts[PMD_POSE]) * 2;
      }
    }
    return;
  }
  uint32_t left = bathUntil - now;
  if (left > 800) {
    // foam: bubbles bobbing and rising little by little
    float t = now / 220.0f;
    for (auto &b : bubbles) {
      int bx = b.x + (int)(sinf(t + b.ph) * 6);
      int by = b.y - (int)((3000 - left) / 90);
      gfx->fillCircle(bx, by, b.r, UI_WHITE);
      gfx->drawCircle(bx, by, b.r, 0x7E3D);
      gfx->fillCircle(bx - b.r / 3, by - b.r / 3, b.r / 4, UI_BG_DAY);
    }
  } else {
    // the bubbles pop: sparkles
    for (int i = 0; i < 8; i++) {
      auto &b = bubbles[i];
      int sx = b.x + (i % 3) * 6 - 6, sy = b.y - 18;
      uint16_t col = (i % 2) ? UI_BAR_WARN : UI_WHITE;
      gfx->fillRect(sx - 6, sy - 1, 13, 3, col);
      gfx->fillRect(sx - 1, sy - 6, 3, 13, col);
    }
  }
}

// ---------- PMD pet: behaviour ----------

uint32_t pmdActTotalMs(const PmdAct &a) {
  uint32_t t = 0;
  for (uint8_t i = 0; i < a.frames; i++) t += a.ms[i];
  return t ? t : 100;
}

uint8_t pmdFrameAt(const PmdAct &a, uint32_t t, bool loop) {
  uint32_t total = pmdActTotalMs(a);
  if (!loop && t >= total) return a.frames - 1;
  t %= total;
  uint8_t i = 0;
  while (t >= a.ms[i]) {
    t -= a.ms[i];
    i = (i + 1) % a.frames;
  }
  return i;
}

// draws an action anchored at its base (centre-x, ground) and returns its scale
// draws an action of a specific PmdMon (m); drawPmdAct uses the global pmd
void drawPmdCore(PmdMon &m, uint8_t actId, int cx, int groundY, uint32_t t, bool loop, bool sil, uint8_t maxS, bool flip) {
  const PmdAct &a = m.acts[actId];
  if (!a.frames) return;
  uint8_t sBase = m.acts[PMD_IDLE].h ? 170 / m.acts[PMD_IDLE].h : 5;
  if (sBase < 2) sBase = 2;
  if (sBase > maxS) sBase = maxS;
  uint8_t s = sBase;
  while (s > 2 && a.h * s > 250) s--;  // actions with a large frame (attack)
  uint8_t fi = pmdFrameAt(a, t, loop);
  const uint8_t *fr = a.data + (uint32_t)fi * a.w * a.h;
  // anchor by the feet (a.base), not the canvas height: that way actions
  // with different padding (Hurt, Eat...) all stand on the same ground line
  int x0 = cx - a.w * s / 2, y0 = groundY - (a.base ? a.base : a.h) * s;
  for (int r = 0; r < a.h; r++) {
    const uint8_t *row = fr + r * a.w;
    for (int c = 0; c < a.w; c++) {
      uint8_t idx = row[flip ? a.w - 1 - c : c];
      if (idx == 0xFF) continue;
      gfx->fillRect(x0 + c * s, y0 + r * s, s, s, sil ? INK_K : m.pal[idx]);
    }
  }
}
void drawPmdActM(PmdMon &m, uint8_t actId, int cx, int groundY, uint32_t t, bool loop, bool sil, uint8_t maxS) {
  drawPmdCore(m, actId, cx, groundY, t, loop, sil, maxS, false);
}
// V-Pet sprites face LEFT. In a fight your own Digimon stands on the left, so
// it is mirrored to face the foe.
void drawPmdActFlip(PmdMon &m, uint8_t actId, int cx, int groundY, uint32_t t, bool loop, bool sil, uint8_t maxS) {
  drawPmdCore(m, actId, cx, groundY, t, loop, sil, maxS, true);
}
void drawPmdAct(uint8_t actId, int cx, int groundY, uint32_t t, bool loop, bool sil, uint8_t maxS) {
  drawPmdActM(pmd, actId, cx, groundY, t, loop, sil, maxS);
}

// picks the creature's next whim when it is happy
void behNext() {
  uint32_t now = millis();
  beh.t0 = now;
  int r = random(100);
  if (r < 35 && (pmd.has(PMD_WALKL) || pmd.has(PMD_WALKR))) {
    beh.mode = 1;  // paseo
    beh.targetX = 150 + random(176);
    beh.until = now + 15000;
  } else if (r < 60) {
    // a random gesture among those available
    // (Hop fuera: salta demasiado alto; Sit fuera: mira hacia atras)
    static const uint8_t flair[] = { PMD_POSE, PMD_NOD, PMD_BREATH };
    uint8_t pick[3], n = 0;
    for (uint8_t f : flair)
      if (pmd.has(f)) pick[n++] = f;
    if (n) {
      beh.mode = 2;
      beh.act = pick[random(n)];
      beh.until = now + pmdActTotalMs(pmd.acts[beh.act]);
      return;
    }
    beh.mode = 0;
    beh.until = now + 2000 + random(3000);
  } else {
    beh.mode = 0;  // look ahead
    beh.until = now + 2000 + random(3000);
  }
}

void drawPetPMD() {
  uint32_t now = millis();

  if (pet.evolving()) {
    drawEvolveFX(now);
    return;
  }
  if (evoPmd.loaded) evoPmd.unload();  // the evolution finished: free the previous form

  PetMood m = pet.mood();
  uint8_t act;
  bool loop = true;
  if (m == MOOD_SLEEPING && pmd.has(PMD_SLEEP)) {
    act = PMD_SLEEP;
    beh.mode = 0;
  } else if (m == MOOD_EATING && pmd.has(PMD_EAT)) {
    act = PMD_EAT;
    beh.t0 = 0;
  } else if (m == MOOD_SAD && pmd.has(PMD_HURT)) {
    act = PMD_HURT;
  } else {
    // happy: the scheduler decides (idle / stroll / gesture)
    if (now > beh.until) behNext();
    if (beh.mode == 1) {
      float d = beh.targetX - beh.x;
      if (fabsf(d) < 4) {
        behNext();
        act = PMD_IDLE;
      } else {
        beh.x += (d > 0 ? 3.0f : -3.0f);
        act = (d > 0) ? PMD_WALKR : PMD_WALKL;
      }
    } else {
      act = (beh.mode == 2) ? beh.act : PMD_IDLE;
      loop = false;
    }
    if (!pmd.has(act)) act = PMD_IDLE;
  }

  drawPmdAct(act, (int)beh.x, PET_GROUND, now - beh.t0, loop || act == PMD_IDLE, false, 5);

  if (pet.showHeart()) drawMap(SPR_HEART, 32, (int)beh.x + 50, PET_GROUND - 190, 2, false);
}

// animated sprite from the SD: whole-number zoom per pixel, frames at their own pace
void drawPetSD() {
  int s = mon.scale;
  int w = mon.w * s, h = mon.h * s;
  int x = CX - w / 2;
  int y = PET_CY - h / 2;

  bool sil = false;
  if (pet.evolving()) {
    sil = (millis() / 300) % 2;
  } else if (pet.mood() == MOOD_HAPPY && (millis() / 500) % 2) {
    y -= 6;  // saltito
  }

  uint16_t fm = mon.frameMs ? mon.frameMs : 100;
  uint16_t fi = pet.sleeping ? 0 : (millis() / fm) % mon.frames;
  const uint8_t *fr = mon.data + (uint32_t)fi * mon.w * mon.h;
  for (int r = 0; r < mon.h; r++) {
    const uint8_t *row = fr + r * mon.w;
    for (int c = 0; c < mon.w; c++) {
      uint8_t idx = row[c];
      if (idx == 0xFF) continue;
      gfx->fillRect(x + c * s, y + r * s, s, s, sil ? INK_K : mon.pal[idx]);
    }
  }

  // emotes instead of expressions (imported sprites have no anchors)
  if (pet.showHeart()) drawMap(SPR_HEART, 32, x + w - 30, y - 50, 2, false);
}

// closed eye: erase the 3x4 eye and draw the eyelid

void drawPoops() {
  for (int i = 0; i < pet.poops; i++) {
    drawMap(SPR_POOP, 32, 36 + i * 46, 244, 2, false);
  }
}

// The four care stats, on the panel's RIM.
//
// They were 2x2 bars across y 318..361 -- four 100 px tracks laid over the
// widest part of the circle, which is the one place a round panel has room to
// spare, while the home row below them had to make do with 60 px icons. An arc
// lives where no rectangular layout can put anything at all.
//
// Colour still means SEVERITY, exactly as the bars did; the label says which
// stat it is. The gap at 12 o'clock is for the name, and the arcs stop short of
// +-102 degrees so the ends stay clear of the poop row on the left.
#define CARE_R 216        // the track's radius
#define CARE_W 12         // and its thickness
#define CARE_LBL_R 190    // labels hug the track rather than floating mid-field
static const int16_t CARE_ARC[4][2] = {
  { -108, -82 }, { -78, -52 }, { 52, 78 }, { 82, 108 },
};
// One hue each. Four arcs in the same colour are four arcs you have to read the
// labels of; and the severity colours they used to share were 1.64:1 against
// their own groove, so the filled part barely differed from the empty part.
static const uint16_t CARE_COL[4] = {
  UI_CARE_FOOD, UI_CARE_JOY, UI_CARE_ENE, UI_CARE_HYG,
};
#define CARE_LOW 25       // below this the LABEL carries the warning

int uiCareArcTop(int i) {
  if (i < 0 || i >= 4) return -1;
  int top = 466;
  for (int a = CARE_ARC[i][0]; a <= CARE_ARC[i][1]; a++) {
    float rad = ((float)a - 90.0f) * 0.01745329f;
    int y = CY + (int)(sinf(rad) * CARE_R) - CARE_W / 2;
    if (y < top) top = y;
  }
  return top;
}

int uiHeaderNameBottom() { return HEADER_NAME_Y + HEADER_NAME_H; }

static void drawCareArc(int i, const char *label, uint8_t val) {
  int a0 = CARE_ARC[i][0], a1 = CARE_ARC[i][1];
  uiArc(CX, CY, CARE_R, a0, a1, CARE_W, UI_TRACK);
  if (val) uiArc(CX, CY, CARE_R, a0, a0 + (a1 - a0) * val / 100, CARE_W, CARE_COL[i]);
  float mid = ((float)(a0 + a1) / 2.0f - 90.0f) * 0.01745329f;
  int lx = CX + (int)(cosf(mid) * CARE_LBL_R);
  int ly = CY + (int)(sinf(mid) * CARE_LBL_R);
  gfx->setTextColor(val < CARE_LOW ? UI_BAR_BAD : inkColor());
  gfx->setTextSize(2);
  gfx->setCursor(lx - (int)strlen(label) * 6, ly - 8);
  gfx->print(label);
}

void drawBars() {
  drawCareArc(0, T(S_BAR_FOOD), pet.fullness);
  drawCareArc(1, T(S_BAR_JOY), pet.joy);
  drawCareArc(2, T(S_BAR_ENE), pet.energy);
  drawCareArc(3, T(S_BAR_HYG), pet.hygiene);
}

void drawButtons() {
  for (int i = 0; i < BTN_COUNT; i++) {
    bool off = uiButtonDisabled(i);   // while asleep only LIGHT works
    int bx = buttons[i].cx - BTN_HALF, by = buttons[i].cy - BTN_HALF;
    if (!pet.sleeping) gfx->fillRoundRect(bx, by, 2 * BTN_HALF, 2 * BTN_HALF, 16, UI_WHITE);
    gfx->drawRoundRect(bx, by, 2 * BTN_HALF, 2 * BTN_HALF, 16, inkColor());
    if (!off) drawMap(buttons[i].icon, 16, buttons[i].cx - 16, buttons[i].cy - 16, 2, false);
  }
}

const char *eggMsg() {
  switch (pet.eggCracks()) {
    case 0: return T(S_EGG_TOUCH);
    case 1: return T(S_EGG_MOVES);
    default: return T(S_EGG_ALMOST);
  }
}

const char *statusMsg() {
  if (pet.evolving()) return T(S_EVOLVING);
  if (bathUntil) return "Splish splash!";  // onomatopeya universal
  if (pet.sleeping) return "Zzz...";
  if (pet.eating()) return T(S_EATING);
  if (pet.showHeart()) return T(S_LIKES);
  if (pet.fullness < 25) return T(S_HUNGRY);
  if (pet.hygiene < 25) return T(S_NEEDS_BATH);
  if (pet.energy < 25) return T(S_EXHAUSTED);
  if (pet.joy < 25) return T(S_SAD);
  if (pet.weight > 60) return T(S_CHUBBY);
  if (pet.variant && pet.ageMinutes < 15) return T(S_IS_VARIANT);
  return T(S_HAPPY);
}

// draws an n x n pixel map, scaled; silhouette=true paints it in ink
// An 8bpp indexed avatar, same shape as the badge art: 0xFF is transparent.
void drawAvatar(uint8_t which, int x, int y, int s) {
  const AvatarArt &a = AVATARS[which % AVATAR_COUNT];
  for (int r = 0; r < AVATAR_PX; r++)
    for (int c = 0; c < AVATAR_PX; c++) {
      uint8_t v = a.idx[r * AVATAR_PX + c];
      if (v == 0xFF) continue;
      gfx->fillRect(x + c * s, y + r * s, s, s, a.pal[v]);
    }
}

void drawMap(const char *const *map, int n, int x, int y, int s, bool silhouette) {
  for (int r = 0; r < n; r++) {
    for (int c = 0; c < n; c++) {
      char ch = map[r][c];
      if (ch == '.') continue;
      gfx->fillRect(x + c * s, y + r * s, s, s, silhouette ? INK_K : spriteColor(ch));
    }
  }
}
